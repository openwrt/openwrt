## target/linux/generic/files/Documentation/devicetree/bindings/net/realtek,rtl8367b.yaml
```yaml
# SPDX-License-Identifier: (GPL-2.0-only OR BSD-2-Clause)
%YAML 1.2
---
$id: http://devicetree.org/schemas/net/realtek,rtl8367b.yaml#
$schema: http://devicetree.org/meta-schemas/core.yaml#

title: Realtek RTL8367B family Ethernet switches

maintainers:
  - Nickolay Savchenko <n.savchenko@axioma.lv>
  - Mieczyslaw Nalewaj <namiltd@yahoo.com>

properties:
  compatible:
    const: realtek,rtl8367b

  mii-bus:
    $ref: /schemas/types.yaml#/definitions/phandle
    description: MDIO bus used to access the switch registers.

  phy-id:
    $ref: /schemas/types.yaml#/definitions/uint32
    maximum: 31
    description: MDIO address used to access the switch registers.

  sda-gpios:
    maxItems: 1
    description: GPIO used for the proprietary SMI data signal.

  sck-gpios:
    maxItems: 1
    description: GPIO used for the proprietary SMI clock signal.

  resets:
    maxItems: 1

  reset-names:
    const: switch

  mdio-bus:
    $ref: /schemas/net/mdio.yaml#
    unevaluatedProperties: false
    description: Optional container for the switch-internal MDIO bus.

  realtek,extif:
    $ref: /schemas/types.yaml#/definitions/uint32-array
    minItems: 10
    maxItems: 10
    description:
      External interface configuration. The values select the CPU port,
      transmit and receive delays, interface mode, forced mode, pause,
      link, duplex and speed settings, in that order.

  realtek,init-regs:
    $ref: /schemas/types.yaml#/definitions/uint32-matrix
    minItems: 1
    maxItems: 32
    items:
      items:
        - description: Switch register address
          minimum: 0
          maximum: 0xffff
        - description: Value written to the register
          minimum: 0
          maximum: 0xffff
    description:
      Register/value pairs written after the chip-specific initialization
      table and before the external interface is configured. This permits
      board-specific post-initialization without changing other switches.

required:
  - compatible
  - realtek,extif

oneOf:
  - required:
      - mii-bus
  - required:
      - sda-gpios
      - sck-gpios

additionalProperties: false

examples:
  - |
    #include <dt-bindings/gpio/gpio.h>

    switch {
        compatible = "realtek,rtl8367b";
        sda-gpios = <&gpio0 1 GPIO_ACTIVE_HIGH>;
        sck-gpios = <&gpio0 2 GPIO_ACTIVE_HIGH>;
        realtek,extif = <6 1 2 1 1 1 1 1 1 2>;
        realtek,init-regs = <0x1301 0x0778>,
                            <0x1302 0x7777>;
    };
```

## target/linux/meson/image/Config.in
```kconfig
config MESON_SD_BOOT_PARTSIZE
	int "Boot (SD Card) filesystem partition size (in MB)"
	depends on TARGET_meson
	default 32
```

## target/linux/mvebu/files/Documentation/devicetree/bindings/misc/yamaha,rtx830-board.yaml
```yaml
# SPDX-License-Identifier: (GPL-2.0-only OR BSD-2-Clause)
%YAML 1.2
---
$id: http://devicetree.org/schemas/misc/yamaha,rtx830-board.yaml#
$schema: http://devicetree.org/meta-schemas/core.yaml#

title: Yamaha RTX830 board controller

maintainers:
  - Kosuke Shibuya <kakiringopcneko@gmail.com>

description: |
  The SPI board controller manages storage power, front-panel indicators,
  the buzzer, restart preparation and power-switch hold-up refresh.
  It is not the SPI NOR controller and does not program the FPGA.

allOf:
  - $ref: /schemas/spi/spi-peripheral-props.yaml#

properties:
  compatible:
    const: yamaha,rtx830-board
  reg:
    items:
      - const: 2
  spi-max-frequency:
    maximum: 15625000
  spi-cpol: true
  spi-cpha: true
  power-switch-gpios:
    maxItems: 1
    description: Active-high input indicating that the power switch is OFF.

required:
  - compatible
  - reg
  - spi-max-frequency
  - spi-cpol
  - spi-cpha
  - power-switch-gpios

unevaluatedProperties: false

examples:
  - |
    #include <dt-bindings/gpio/gpio.h>

    spi {
        #address-cells = <1>;
        #size-cells = <0>;

        board@2 {
            compatible = "yamaha,rtx830-board";
            reg = <2>;
            spi-max-frequency = <15625000>;
            spi-cpol;
            spi-cpha;
            power-switch-gpios = <&gpio1 12 GPIO_ACTIVE_HIGH>;
        };
    };
...
```

## target/linux/mvebu/files/Documentation/devicetree/bindings/power/reset/yamaha,rtx830-restart.yaml
```yaml
# SPDX-License-Identifier: (GPL-2.0-only OR BSD-2-Clause)
%YAML 1.2
---
$id: http://devicetree.org/schemas/power/reset/yamaha,rtx830-restart.yaml#
$schema: http://devicetree.org/meta-schemas/core.yaml#

title: Yamaha RTX830 private-watchdog restart controller

maintainers:
  - Kosuke Shibuya <kakiringopcneko@gmail.com>

description: |
  CPU0 private watchdog and the two system-controller registers used to
  route its reset on the RTX830. The private timer is not included.

properties:
  compatible:
    const: yamaha,rtx830-restart
  reg:
    items:
      - description: CPU0 private watchdog
      - description: Watchdog reset mask
      - description: Reset routing register
  reg-names:
    items:
      - const: private-watchdog
      - const: reset-mask
      - const: reset-route

required:
  - compatible
  - reg
  - reg-names

additionalProperties: false

examples:
  - |
    restart-controller@f100c620 {
        compatible = "yamaha,rtx830-restart";
        reg = <0xf100c620 0x20>, <0xf1018260 0x4>, <0xf1020704 0x4>;
        reg-names = "private-watchdog", "reset-mask", "reset-route";
    };
...
```

## target/linux/realtek/files-6.18/Documentation/devicetree/bindings/net/pcs/realtek,otto-pcs.yaml
```yaml
# SPDX-License-Identifier: (GPL-2.0-only OR BSD-2-Clause)
%YAML 1.2
---
$id: http://devicetree.org/schemas/net/pcs/realtek,otto-pcs.yaml#
$schema: http://devicetree.org/meta-schemas/core.yaml#

title: Realtek Otto Ethernet PCS

maintainers:
  - OpenWrt Realtek maintainers <openwrt-devel@lists.openwrt.org>

properties:
  compatible:
    oneOf:
      - items:
          - enum:
              - realtek,rtl8380-pcs
              - realtek,rtl8392-pcs
              - realtek,rtl9301-pcs
              - realtek,rtl9311-pcs
          - const: realtek,otto-pcs
      - const: realtek,otto-pcs

  mdio-parent-bus:
    $ref: /schemas/types.yaml#/definitions/phandle
    description: MDIO bus used to access the SerDes register pages.

  '#address-cells':
    const: 1

  '#size-cells':
    const: 0

patternProperties:
  '^serdes@[0-9a-f]+$':
    type: object
    $ref: /schemas/phy/phy-common-props.yaml#
    properties:
      reg:
        maximum: 13

      '#pcs-cells':
        const: 1

      realtek,sfp-dac-detect:
        type: boolean
        description:
          Enable module-aware SFP receiver recovery on this SerDes, including
          10GBASE-R direct-attach copper transmitter configuration and receiver
          calibration, plus bounded 1000BASE-X no-link recovery. Boards must
          opt in only after validating the affected analog settings and module
          lifecycle on their hardware.

    required:
      - reg
      - '#pcs-cells'

    unevaluatedProperties: false

required:
  - compatible
  - mdio-parent-bus
  - '#address-cells'
  - '#size-cells'

additionalProperties: false

examples:
  - |
    pcs {
        compatible = "realtek,rtl9311-pcs", "realtek,otto-pcs";
        #address-cells = <1>;
        #size-cells = <0>;
        mdio-parent-bus = <&mdio_serdes>;

        serdes@6 {
            reg = <6>;
            #pcs-cells = <1>;
            tx-polarity = <1>;
            realtek,sfp-dac-detect;
        };
    };
```

## target/linux/realtek/files-6.18/Documentation/devicetree/bindings/net/realtek,rtl9300-leds.yaml
```yaml
# SPDX-License-Identifier: (GPL-2.0-only OR BSD-2-Clause)
%YAML 1.2
---
$id: http://devicetree.org/schemas/net/realtek,rtl9300-leds.yaml#
$schema: http://devicetree.org/meta-schemas/core.yaml#

title: Realtek RTL93xx switch on-chip port LED engine

maintainers:
  - Kaloyan Naumov <knaumov@gmail.com>

description: >
  The Realtek RTL930x (Longan) and RTL931x (Mango) switch SoCs drive the
  front-panel port LEDs from an on-chip serial LED engine, independent of any
  per-PHY LED pins. Up to four "LED sets" describe the per-speed link/activity
  encoding; each port selects one set, and copper vs fibre ports select through
  separate copper/fibre set-select registers.

  This node configures the engine globally. Per-port set selection is expressed
  through the "led-set" property on each switch port node.

properties:
  compatible:
    const: realtek,rtl9300-leds

  clock-frequency:
    description:
      Serial LED shift clock. Selects the engine's LED_CLK_SEL divider.
    enum: [1250000, 2500000, 5000000, 10000000]

  active-low:
    type: boolean
    description: >
      Selects the LED output polarity. Documented here as the driver has long
      implemented it, for both RTL930x and RTL931x: the engine's ACTIVE_LOW bit
      is cleared when this property is present and set when it is absent. Boards
      that need the bit set therefore omit the property. Verify the resulting
      polarity against the board rather than assuming from the property name.

  active-high:
    type: boolean
    deprecated: true
    description:
      Not read by the driver; only active-low affects the polarity. Accepted
      so that existing device trees validate.

  realtek,led-mode:
    $ref: /schemas/types.yaml#/definitions/uint32
    description:
      RTL930x (Longan) LED interface mode written to LED_GLB_CTRL. Not used on
      RTL931x, which uses "realtek,led-scan-mode" instead.

  realtek,led-num-ctrl-direct:
    type: boolean
    description:
      RTL931x (Mango) only. Program the per-port LED_PORT_NUM_CTRL field as the
      DIRECT LED count (e.g. a 2-LED port -> 0b10) instead of the default
      (count - 1) encoding. Required on Mango silicon whose scan chain expects
      the direct count; boards that omit it keep the (count - 1) default.

  realtek,led-scan-mode:
    $ref: /schemas/types.yaml#/definitions/uint32
    description:
      RTL931x (Mango) only. LED interface/scan mode (LED_GLB_CTRL bits[1:0]).
      1 = serial (default), 2 = single-scan. Some Mango boards require
      single-scan or every per-port LED stays dark.
    enum: [1, 2]
    default: 1

  realtek,led-sys-enable:
    type: boolean
    description:
      RTL931x (Mango) only. Program the chassis SYS LED to steady-on at init
      (SYS_LED_MODE = light + SYS_LED_EN). The SYS LED policy is board-specific;
      boards that omit this leave the SYS LED at its bootloader-latched state.

required:
  - compatible

patternProperties:
  "^led_set[0-3]$":
    $ref: /schemas/types.yaml#/definitions/uint32-array
    minItems: 1
    maxItems: 4
    description:
      Per-speed link/activity encoding for one LED set. Each entry is one
      physical LED's 16-bit LED_SEL field (link/activity/speed selectors). A
      port on this set drives its LEDs from these entries.

  "^realtek,led-set[0-3]-force-port-mask$":
    $ref: /schemas/types.yaml#/definitions/uint32-array
    minItems: 1
    maxItems: 2
    description:
      Bitmask of ports forced onto the matching LED set even when the port has
      no PHY or PCS handle (e.g. ports whose LEDs are engine-driven but which
      auto-detect as absent). One cell (32 bits) on RTL930x; two cells, a
      64-bit value with the high word first, on RTL931x.

additionalProperties: false

examples:
  - |
    leds {
        compatible = "realtek,rtl9300-leds";
        realtek,led-num-ctrl-direct;
        realtek,led-scan-mode = <2>;
        realtek,led-sys-enable;

        /* copper set (entry[0]=sub-10G, entry[1]=10G link/act) */
        led_set1 = <0x0aaa 0x0a01>;
        /* fibre set (as copper but without the 5G bit) */
        led_set3 = <0x0aa8 0x0a01>;
    };
...
```

## target/linux/realtek/files-6.18/drivers/net/dsa/rtl960x/Kconfig
```kconfig
# SPDX-License-Identifier: GPL-2.0-only
config NET_DSA_RTL960X
	tristate "Realtek RTL960X ethernet switch support"
	depends on NET_DSA && RTL960X
	select NET_DSA_TAG_RTL_OTTO
	help
	  This enables support for the switch core built into the Realtek
	  RTL960x (RTL9607C family) SoCs. The switch is reached through the
	  memory-mapped switch-core registers and uses the RTL960x GMAC as
	  the DSA conduit with the rtl_otto tag protocol. The internal PHYs
	  are reached through the RTL960x MDIO driver
	  (MDIO_REALTEK_OTTO_RTL960X), which is enabled by default on these
	  SoCs.
```

## target/linux/realtek/files-6.18/drivers/soc/realtek/Kconfig
```kconfig
# SPDX-License-Identifier: GPL-2.0-only

config REALTEK_OTTO_TABLE
	bool
	depends on MACH_REALTEK_RTL
	select MFD_SYSCON
	help
	  Serialise access to the switch tables that the RTL83xx and RTL93xx
	  SoCs reach through a command register and a window of data
	  registers. Selected by the drivers that use them.
```

## target/linux/zx279128/files-6.12/drivers/mtd/spifc/Kconfig
```kconfig
config MTD_NAND_ZTE_SPIFC
	bool "ZTE ZX27912x SPIFC SPI-NAND controller"
	depends on MTD
	help
	  Support for the ZTE ZX27912x SPI Flash Controller (SPIFC) attached
	  to an SPI-NAND chip. This bring-up driver implements chip
	  identification and page reads only; program and erase are not
	  implemented, so the resulting MTD device is read-only.

	  If unsure, say N.
```

## target/linux/zx279128/files-6.12/drivers/net/ethernet/zx279128/Kconfig
```kconfig
config ZX279128_ETH
	bool "ZTE ZX279128S integrated Ethernet support"
	depends on OF && HAS_IOMEM && PHYLIB
	help
	  Say Y here to support the integrated Ethernet found on the ZTE
	  ZX279128S SoC (ZXHN E1600 router): four GEMAC ports bridged by
	  the on-chip packet processor, with the internal GEPHY PHYs at
	  MDIO addresses 10..13.

	  This driver exposes one netdev per front port: eth0 = LAN3,
	  eth1 = LAN2, eth2 = LAN1, eth3 = WAN on the ZXHN E1600.
```

## target/linux/zx279128/files-6.12/drivers/net/mdio/zx279128/Kconfig
```kconfig
config ZX279128_MDIO
	bool "ZTE ZX279128S MDIO bus controller"
	depends on OF && HAS_IOMEM
	help
	  Support for the MDIO bus controller in the ZTE ZX279128S SoC
	  (ZXHN E1600). The controller drives the management interface
	  to the four integrated GbE PHYs (GEPHY) at addresses 0-3.

	  If unsure, say N.
```
