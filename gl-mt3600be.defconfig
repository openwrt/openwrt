## package/kernel/en7571/src/Kconfig
```kconfig
# SPDX-License-Identifier: GPL-2.0
config EN7571
	tristate "Airoha EN7571 GPON Laser Transceiver"
	depends on I2C && HWMON && OF && GPIOLIB && NVMEM
	select REGULATOR
	help
	  Driver for the Airoha EN7571 GPON laser transceiver.
	  This driver handles the SFF-8472 digital diagnostic monitoring
	  interface (voltage, bias/modulation currents, optical power,
	  temperatures) and laser control (TX enable/disable, APD, RSSI).
	  The transmitter is driven through a GPIO pair and registered as
	  the "en7571-laser" regulator; the xPON half switches it through
	  that regulator.  Diagnostics are exposed through hwmon.
	  It also works with the an7552-gpon driver, which calls the few
	  remaining exported entry points (safe circuit reset, traffic
	  status, the MAC burst interface hook).

	  If unsure, say N.
```

## package/kernel/qca-nss-drv/Config.in
```kconfig
menu "Configuration"
   depends on PACKAGE_kmod-qca-nss-drv

comment "Build Options"

choice
  prompt "Memory Profile"
  # 256 MB boards. Anything but LOW hands the firmware an 8192-entry
  # empty-buffer pool, and each entry is a kmalloc-4k object on 64-bit:
  # 35 MB before a single packet, on a board with ~160 MB usable.
  # Single-device builds only: the profile is shared by every board in a
  # multi-device image, so such a build picks it by hand rather than
  # losing connection-table size on its 512 MB members the moment a
  # 256 MB board is ticked.
  default NSS_MEM_PROFILE_LOW if TARGET_qualcommax_ipq50xx_DEVICE_cudy_p5 || TARGET_qualcommax_ipq50xx_DEVICE_tplink_ex511-v2 || TARGET_qualcommax_ipq50xx_DEVICE_xiaomi_mi-router-ax3000t-v2
  default NSS_MEM_PROFILE_HIGH if TARGET_qualcommax_ipq807x
  default NSS_MEM_PROFILE_MEDIUM if (TARGET_qualcommax_ipq60xx || TARGET_qualcommax_ipq50xx)
  help
  	This option allows you to select the memory profile.
  	It should correspond to the total RAM of your board.

  config NSS_MEM_PROFILE_HIGH
  	bool "Use 1G memory profile"
  	depends on TARGET_qualcommax_ipq807x
  	help
  		This allows configuring NSS boards with 1GB+ memory.

  config NSS_MEM_PROFILE_MEDIUM
  	bool "Use 512MB memory profile"
  	help
  		This allows configuring NSS for boards with 512M memory.

  config NSS_MEM_PROFILE_LOW
  	bool "Use 256MB memory profile"
  	help
  		This allows configuring NSS for boards with 256M memory.
endchoice

config NSS_DRV_BRIDGE_ENABLE
	bool
	default n
	prompt "Enable BRIDGE"
	depends on TARGET_qualcommax_ipq807x || TARGET_qualcommax_ipq60xx

config NSS_DRV_CAPWAP_ENABLE
	bool
	default n
	prompt "Enable CAPWAP"
	depends on TARGET_qualcommax_ipq807x || TARGET_qualcommax_ipq60xx

config NSS_DRV_C2C_ENABLE
	bool
	default n
	prompt "Enable C2C"
	depends on TARGET_ipq806x || TARGET_qualcommax_ipq807x

config NSS_DRV_CLMAP_ENABLE
	bool
	default n
	prompt "Enable CLMAP"

config NSS_DRV_CRYPTO_ENABLE
	bool
	default n
	prompt "Enable CRYPTO"

config NSS_DRV_DTLS_ENABLE
	bool
	default n
	prompt "Enable DTLS"
	depends on TARGET_qualcommax_ipq807x || TARGET_qualcommax_ipq60xx

config NSS_DRV_GRE_ENABLE
	bool
	default n
	prompt "Enable GRE"

config NSS_DRV_GRE_REDIR_ENABLE
	bool
	default n
	depends on NSS_DRV_GRE_ENABLE
	prompt "Enable GRE_REDIR"

config NSS_DRV_GRE_TUNNEL_ENABLE
	bool
	default n
	depends on NSS_DRV_GRE_ENABLE
	prompt "Enable GRE_TUNNEL"

config NSS_DRV_IGS_ENABLE
	bool
	default n
	prompt "Enable IGS"

config NSS_DRV_IPSEC_ENABLE
	bool
	default n
	prompt "Enable IPSEC"

config NSS_DRV_IPV4_REASM_ENABLE
	bool
	default n
	prompt "Enable IPV4_REASM"

config NSS_DRV_IPV6_ENABLE
	bool
	default n
	prompt "Enable IPV6"

config NSS_DRV_IPV6_REASM_ENABLE
	bool
	default n
	depends on NSS_DRV_IPV6_ENABLE
	prompt "Enable IPV6_REASM"

config NSS_DRV_L2TP_ENABLE
	bool
	default n
	prompt "Enable L2TP"

config NSS_DRV_LAG_ENABLE
	bool
	default n
	prompt "Enable LAG"
	depends on TARGET_qualcommax_ipq807x || TARGET_qualcommax_ipq60xx

config NSS_DRV_MAPT_ENABLE
	bool
	default n
	prompt "Enable MAPT"

config NSS_DRV_MATCH_ENABLE
	bool
	default n
	prompt "Enable MATCH"

config NSS_DRV_MIRROR_ENABLE
	bool
	default n
	prompt "Enable MIRROR"

config NSS_DRV_OAM_ENABLE
	bool
	default n
	prompt "Enable OAM"
	depends on TARGET_ipq806x

config NSS_DRV_PORTID_ENABLE
	bool
	default n
	prompt "Enable PORTID"
	depends on TARGET_ipq806x

config NSS_DRV_LSO_RX_ENABLE
	bool
	default n
	prompt "Enable LSO RX"

config NSS_DRV_PPPOE_ENABLE
	bool
	default n
	prompt "Enable PPPOE"

config NSS_DRV_PPTP_ENABLE
	bool
	default n
	prompt "Enable PPTP"

config NSS_DRV_PVXLAN_ENABLE
	bool
	default n
	prompt "Enable PVXLAN"

config NSS_DRV_QRFS_ENABLE
	bool
	default n
	prompt "Enable QRFS"
	depends on TARGET_qualcommax_ipq807x

config NSS_DRV_QVPN_ENABLE
	bool
	default n
	prompt "Enable OpenVpn (QVPN)"
	depends on TARGET_qualcommax_ipq807x || TARGET_qualcommax_ipq60xx

config NSS_DRV_RMNET_ENABLE
	bool
	default n
	prompt "Enable RMNET"
	depends on TARGET_qualcommax_ipq807x || TARGET_qualcommax_ipq50xx
	select NSS_DRV_C2C_ENABLE
	help
	  Raw-IP WAN offload. The firmware carries the rmnet_rx nodes on
	  NSS core 1, so nss_rmnet_rx_create() points the host-to-NSS node
	  at the core-to-core transmit interface and C2C has to be built
	  for that nexthop to exist. Nothing binds on a board without a
	  raw-IP network device, and the allocation is answered by core 1
	  alone, so a device tree that leaves that core off binds nothing.

config NSS_DRV_SHAPER_ENABLE
	bool
	default n
	prompt "Enable SHAPER"

config NSS_DRV_SJACK_ENABLE
	bool
	default n
	prompt "Enable SJACK"

config NSS_DRV_TLS_ENABLE
	bool
	default n
	prompt "Enable TLS"
	depends on TARGET_qualcommax_ipq807x || TARGET_qualcommax_ipq60xx

config NSS_DRV_TRUSTSEC_ENABLE
	bool
	default n
	prompt "Enable TRUSTSEC"

config NSS_DRV_UDP_ST_ENABLE
	bool
	default n
	prompt "Enable UDP Speedtest"
	depends on TARGET_qualcommax_ipq807x || TARGET_qualcommax_ipq50xx

config NSS_DRV_TRUSTSEC_RX_ENABLE
	bool
	default n
	prompt "Enable TRUSTSEC_RX"
	depends on NSS_DRV_TRUSTSEC_ENABLE

config NSS_DRV_TSTAMP_ENABLE
	bool
	default n
	prompt "Enable TSTAMP"
	depends on TARGET_ipq806x

config NSS_DRV_TUN6RD_ENABLE
	bool
	default n
	prompt "Enable TUN6RD"

config NSS_DRV_TUNIPIP6_ENABLE
	bool
	default n
	prompt "Enable TUNIPIP6"

config NSS_DRV_VIRT_IF_ENABLE
	bool
	default n
	prompt "Enable VIRT_IF"

config NSS_DRV_VLAN_ENABLE
	bool
	default n
	prompt "Enable VLAN"
	depends on TARGET_qualcommax_ipq807x || TARGET_qualcommax_ipq60xx || TARGET_qualcommax_ipq50xx

config NSS_DRV_VXLAN_ENABLE
	bool
	default n
	prompt "Enable VXLAN"

config NSS_DRV_WIFIOFFLOAD_ENABLE
	bool
	default n
	prompt "Enable WIFI"

config NSS_DRV_WIFI_EXT_VDEV_ENABLE
	bool
	default n
	depends on NSS_DRV_WIFIOFFLOAD_ENABLE
	prompt "Enable WIFI EXT VDEV"

config NSS_DRV_WIFI_MESH_ENABLE
	bool
	default n
	depends on NSS_DRV_WIFIOFFLOAD_ENABLE
	prompt "Enable WIFI MESH"

config NSS_DRV_WIFI_LEGACY_ENABLE
	bool
	default n
	depends on TARGET_ipq806x
	prompt "Enable Legacy WIFI"
endmenu
```

## package/libs/mbedtls/Config.in
```kconfig
if PACKAGE_libmbedtls

comment "Option details in source code: include/mbedtls/mbedtls_config.h and tf-psa-crypto/include/psa/crypto_config.h"

comment "Ciphers - unselect old or less-used ciphers to reduce binary size"

config PSA_WANT_KEY_TYPE_AES
	bool "PSA_WANT_KEY_TYPE_AES"
	default y

config PSA_WANT_KEY_TYPE_ARIA
	bool "PSA_WANT_KEY_TYPE_ARIA"
	default n

config PSA_WANT_KEY_TYPE_CAMELLIA
	bool "PSA_WANT_KEY_TYPE_CAMELLIA"
	default n

config PSA_WANT_ALG_CCM
	bool "PSA_WANT_ALG_CCM"
	default n

config PSA_WANT_ALG_CMAC
	bool "PSA_WANT_ALG_CMAC (old but used by hostapd)"
	default y

config PSA_WANT_ALG_GCM
	bool "PSA_WANT_ALG_GCM"
	default y

config MBEDTLS_NIST_KW_C
	bool "MBEDTLS_NIST_KW_C (old but used by hostapd)"
	default y

config PSA_WANT_ALG_RIPEMD160
	bool "PSA_WANT_ALG_RIPEMD160"
	default n

config MBEDTLS_RSA_NO_CRT
	bool "MBEDTLS_RSA_NO_CRT"
	default y

config MBEDTLS_KEY_EXCHANGE_PSK_ENABLED
	bool "MBEDTLS_KEY_EXCHANGE_PSK_ENABLED"
	default y

config MBEDTLS_KEY_EXCHANGE_ECDHE_PSK_ENABLED
	bool "MBEDTLS_KEY_EXCHANGE_ECDHE_PSK_ENABLED"
	default y

config MBEDTLS_KEY_EXCHANGE_ECDHE_RSA_ENABLED
	bool "MBEDTLS_KEY_EXCHANGE_ECDHE_RSA_ENABLED"
	default y

config MBEDTLS_KEY_EXCHANGE_ECDHE_ECDSA_ENABLED
	bool "MBEDTLS_KEY_EXCHANGE_ECDHE_ECDSA_ENABLED"
	default y

config MBEDTLS_KEY_EXCHANGE_ECJPAKE_ENABLED
	bool "MBEDTLS_KEY_EXCHANGE_ECJPAKE_ENABLED"
	default n

comment "Curves - unselect old or less-used curves to reduce binary size"

config PSA_WANT_ECC_SECP_R1_256
	bool "PSA_WANT_ECC_SECP_R1_256"
	default y

config PSA_WANT_ECC_SECP_R1_384
	bool "PSA_WANT_ECC_SECP_R1_384"
	default y

config PSA_WANT_ECC_SECP_R1_521
	bool "PSA_WANT_ECC_SECP_R1_521"
	default y

config PSA_WANT_ECC_SECP_K1_256
	bool "PSA_WANT_ECC_SECP_K1_256"
	default y

config PSA_WANT_ECC_BRAINPOOL_P_R1_256
	bool "PSA_WANT_ECC_BRAINPOOL_P_R1_256"
	default n

config PSA_WANT_ECC_BRAINPOOL_P_R1_384
	bool "PSA_WANT_ECC_BRAINPOOL_P_R1_384"
	default n

config PSA_WANT_ECC_BRAINPOOL_P_R1_512
	bool "PSA_WANT_ECC_BRAINPOOL_P_R1_512"
	default n

config PSA_WANT_ECC_MONTGOMERY_255
	bool "PSA_WANT_ECC_MONTGOMERY_255"
	default y

config PSA_WANT_ECC_MONTGOMERY_448
	bool "PSA_WANT_ECC_MONTGOMERY_448"
	default n

comment "Build Options - unselect features to reduce binary size"

config PSA_WANT_ALG_OFB
	bool "PSA_WANT_ALG_OFB"
	default n

config MBEDTLS_DEBUG_C
	bool "MBEDTLS_DEBUG_C"
	default n

config PSA_WANT_ALG_HKDF
	bool "PSA_WANT_ALG_HKDF"
	default n

config MBEDTLS_PLATFORM_C
	bool "MBEDTLS_PLATFORM_C"
	default n

config MBEDTLS_SELF_TEST
	bool "MBEDTLS_SELF_TEST"
	default n

config MBEDTLS_THREADING_C
	bool "MBEDTLS_THREADING_C"
	default y

config MBEDTLS_THREADING_PTHREAD
	def_bool MBEDTLS_THREADING_C

config MBEDTLS_VERSION_C
	bool "MBEDTLS_VERSION_C"
	default n

config MBEDTLS_VERSION_FEATURES
	bool "MBEDTLS_VERSION_FEATURES"
	default n

config MBEDTLS_PSA_CRYPTO_CLIENT
	bool "MBEDTLS_PSA_CRYPTO_CLIENT"

config MBEDTLS_DEPRECATED_WARNING
	bool "MBEDTLS_DEPRECATED_WARNING"
	default n

config MBEDTLS_SSL_PROTO_TLS1_2
	bool "MBEDTLS_SSL_PROTO_TLS1_2"
	default y

config MBEDTLS_SSL_PROTO_TLS1_3
	bool "MBEDTLS_SSL_PROTO_TLS1_3"
	select MBEDTLS_PSA_CRYPTO_CLIENT
	select PSA_WANT_ALG_HKDF
	default y

config MBEDTLS_SSL_TLS1_3_COMPATIBILITY_MODE
	bool "MBEDTLS_SSL_TLS1_3_COMPATIBILITY_MODE"
	depends on MBEDTLS_SSL_PROTO_TLS1_3
	default y

config MBEDTLS_SSL_TLS1_3_KEY_EXCHANGE_MODE_PSK_ENABLED
	bool "MBEDTLS_SSL_TLS1_3_KEY_EXCHANGE_MODE_PSK_ENABLED"
	depends on MBEDTLS_SSL_PROTO_TLS1_3
	default y

config MBEDTLS_SSL_TLS1_3_KEY_EXCHANGE_MODE_EPHEMERAL_ENABLED
	bool "MBEDTLS_SSL_TLS1_3_KEY_EXCHANGE_MODE_EPHEMERAL_ENABLED"
	depends on MBEDTLS_SSL_PROTO_TLS1_3
	default y

config MBEDTLS_SSL_TLS1_3_KEY_EXCHANGE_MODE_PSK_EPHEMERAL_ENABLED
	bool "MBEDTLS_SSL_TLS1_3_KEY_EXCHANGE_MODE_PSK_EPHEMERAL_ENABLED"
	depends on MBEDTLS_SSL_PROTO_TLS1_3
	default y

comment "Build Options"

config MBEDTLS_SSL_RENEGOTIATION
	bool "MBEDTLS_SSL_RENEGOTIATION"
	depends on MBEDTLS_SSL_PROTO_TLS1_2
	default n

endif
```

## target/imagebuilder/Config.in
```kconfig
config IB
	bool "Build the OpenWrt Image Builder"
	depends on !EXTERNAL_TOOLCHAIN || EXTERNAL_TOOLCHAIN_IB
	default BUILDBOT
	help
	  This is essentially a stripped-down version of the buildroot
	  with precompiled packages, kernel image and image building tools.
	  You can use it to generate custom images without compiling anything

config IB_STANDALONE
	bool "Include package repositories"
	default y if !BUILDBOT
	depends on IB
	help
	  Disabling this option will cause the ImageBuilder to embed only
	  toolchain and kmod packages while all other ipk archives will be
	  fetched from online repositories.

config IB_ONLY_SELECTED_DEVICES
	bool "Only build selected devices"
	default n
	depends on IB
	help
	  By default, enabling the Image Builder causes the build system to
	  compile the kernel image of every device of the current
	  target/subtarget and embed it into the Image Builder archive, so
	  that any device profile can later be built from it with
	  'make image PROFILE=...'.

	  Enabling this option restricts the Image Builder to only compile
	  and embed the devices that are actually selected under
	  "Target Devices" in this configuration. This can significantly
	  reduce build time if the Image Builder is only ever going to be
	  used for a known, fixed set of devices.

	  Note: the resulting Image Builder archive will then only be able
	  to build images for the devices selected here, not for the full
	  set of devices of this target/subtarget.
```

## target/linux/alpine/files-6.18/drivers/mtd/nand/raw/al/Kconfig
```kconfig
config MTD_NAND_AL
	tristate "NAND support for Annapurna Labs NAND controller"
	help
	  Enable support for NAND Flash chips on Annapurna Labs NAND controllers.
```

## target/linux/alpine/files-6.18/drivers/net/ethernet/al/Kconfig
```kconfig
config NET_AL_ETH
	tristate "Annapurna Labs unified 1G/10G Ethernet driver"
	depends on PCI && INET && ARCH_ALPINE
	select PHYLIB
	help
	  This is the driver supports both standard and advanced Annapurna Labs
	  1G and 10G Ethernet controllers.
```

## target/linux/cortina/files/arch/arm/mach-cortina/Kconfig
```kconfig
# SPDX-License-Identifier: GPL-2.0
config ARCH_CORTINA_CS75XX
	bool "Cortina CS75xx (Goldengate G2)"
	depends on ARCH_MULTI_V7
	select ARM_AMBA
	select ARM_GIC
	select ARM_GLOBAL_TIMER
	select CLKSRC_ARM_GLOBAL_TIMER_SCHED_CLOCK
	select HAVE_ARM_SCU if SMP
	select HAVE_ARM_TWD if SMP
	select GOLDENGATE_CLK
	select GOLDENGATE_IRQ
	select PCI
	help
	  Cortina CS752x (Goldengate G2) dual Cortex-A9 SoCs (Securifi Almond+).
```

## target/linux/dspg/files/arch/arm/mach-dspg/Kconfig
```kconfig
# SPDX-License-Identifier: GPL-2.0-only
config ARCH_DSPG
	bool "DSP Group DVF SoC support"
	depends on ARCH_MULTI_V5
	depends on CPU_LITTLE_ENDIAN
	select ARM_TIMER_SP804
	select COMMON_CLK_DVF99
	select DSPG_PLICU
	select PINCTRL
	select PINCTRL_DVF99
	select TIMER_OF
	help
	  Support for the DSP Group DVF99 SoC family, used in Snom desk
	  phones.
```

## target/linux/dspg/files/drivers/gpu/drm/dvf99/Kconfig
```kconfig
# SPDX-License-Identifier: GPL-2.0-only
config DRM_DVF99_LCDC
	tristate "DRM support for the DSPG DVF99 LCD controller"
	depends on DRM && OF
	depends on ARCH_DSPG || COMPILE_TEST
	select DRM_BRIDGE
	select DRM_CLIENT_SELECTION
	select DRM_GEM_DMA_HELPER
	select DRM_KMS_HELPER
	select DRM_PANEL_BRIDGE
	help
	  Choose this option for DRM support of the parallel RGB LCD
	  controller of the DSP Group DVF99 SoC.
```

## target/linux/dspg/files/sound/soc/dspg/Kconfig
```kconfig
# SPDX-License-Identifier: GPL-2.0-only
config SND_SOC_DVF99_CSS
	tristate "DSPG DVF99 cordless subsystem PCM support"
	depends on ARCH_DSPG || COMPILE_TEST
	depends on RPMSG_DVF99_DUA && HAS_DMA
	help
	  Say Y or M to play and record audio through the firmware of the
	  cordless subsystem of the DSP Group DVF99 SoC. The PCM data goes
	  over its "alsa" coma channel. The driver provides seven PCM
	  devices, one for each stream that the firmware offers, and sets
	  up the DSP units of the audio path through the DSP unit API.
```
