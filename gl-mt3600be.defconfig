## toolchain/gcc/Config.in
```kconfig
# Choose gcc version.

choice
	prompt "GCC compiler Version" if TOOLCHAINOPTS
	default GCC_USE_VERSION_14
	help
	  Select the version of gcc you wish to use.

	config GCC_USE_VERSION_13
		bool "gcc 13.x"

	config GCC_USE_VERSION_14
		bool "gcc 14.x"

	config GCC_USE_VERSION_15
		bool "gcc 15.x"
endchoice

config GCC_USE_GRAPHITE
	bool
	prompt "Compile in support for the new Graphite framework in GCC 4.4+" if TOOLCHAINOPTS

config EXTRA_GCC_CONFIG_OPTIONS
	string
	prompt "Additional gcc configure options" if TOOLCHAINOPTS
	default ""
	help
	    Any additional gcc options you may want to include....

config GCC_DEFAULT_PIE
	bool
	prompt "Build executable with PIE enabled by default" if TOOLCHAINOPTS
	help
	    Use gcc configure option --enable-default-pie to turn on -fPIE and -pie by default.

config GCC_DEFAULT_SSP
	bool
	prompt "Build executable with Stack-Smashing Protection enabled by default" if TOOLCHAINOPTS
	help
	    Use gcc configure option --enable-default-ssp to turn on -fstack-protector-strong by default.

config GCC_BUILD_SANITIZERS
	bool
	prompt "Build the GCC sanitizer runtime libraries (ASan/HWASan/UBSan/...)" if TOOLCHAINOPTS
	help
	    Build GCC's libsanitizer runtimes (libasan, libhwasan, libubsan, ...).
	    These are not built for non-glibc C libraries by default; enable this
	    to build them anyway, e.g. to use HWAddressSanitizer on a musl target.
	    The individual runtime libraries then become selectable under Libraries.

config GCC_SANITIZER_DEFAULT_OPTIONS
	string
	prompt "Default HWASan runtime options" if TOOLCHAINOPTS && GCC_BUILD_SANITIZERS
	depends on GCC_BUILD_SANITIZERS
	default "halt_on_error=0:log_path=/tmp/hwasan"
	help
	    Baked into libhwasan as the default option string (same colon-separated
	    syntax as the HWASAN_OPTIONS env var, which still overrides at runtime).
	    Must contain no spaces. Empty = upstream defaults.

config SJLJ_EXCEPTIONS
	bool
	prompt "Use setjump()/longjump() exceptions" if TOOLCHAINOPTS
	help
	    Use old setjump()/longjump() exceptions instead of the newer
	    frame unwinding exceptions handling routines.  Warning: increases
	    code size and runtime memory usage.

config INSTALL_GFORTRAN
	bool
	prompt "Build/install fortran compiler?" if TOOLCHAINOPTS
	help
	    Build/install GNU fortran compiler ?

config INSTALL_GCCGO
	bool
	prompt "Build/install Go compiler?" if TOOLCHAINOPTS
	depends on USE_GLIBC || BROKEN
	help
	    Build/install GNU gccgo compiler ?
```
