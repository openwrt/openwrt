## openwrt/package/logrotate/Config.in
```kconfig
config BR2_PACKAGE_LOGROTATE
	prompt "logrotate......................... rotates, compresses, and mails system logs"
	tristate
	default m if CONFIG_DEVEL
	select BR2_PACKAGE_LIBPOPT
	help
		logrotate  is  designed to ease administration of systems that generate 
		large numbers of log files.  It allows auto-matic rotation, compression, 
		removal, and mailing of log files. Each  log  file  may  be  handled  
		daily,  weekly,monthly, or when it grows too large.
```

## openwrt/package/lua/Config.in
```kconfig
menu "lua............................... LUA programming language"

config BR2_COMPILE_LUA
	tristate
	default n
	depends BR2_PACKAGE_LIBLUA

config BR2_PACKAGE_LIBLUA
	prompt "liblua............................ LUA programming language shared libraries"
	tristate
	select BR2_COMPILE_LUA
	help
	  Lua is a powerful light-weight programming language designed for extending 
	  applications. Lua is also frequently used as a general-purpose, stand-alone 
	  language. Lua is free software.
	  
	  Lua combines simple procedural syntax with powerful data description 
	  constructs based on associative arrays and extensible semantics. Lua is 
	  dynamically typed, interpreted from bytecodes, and has automatic memory 
	  management with garbage collection, making it ideal for configuration, 
	  scripting, and rapid prototyping.
	  
	  Lua is implemented as a small library of C functions, written in ANSI C, and 
	  compiles unmodified in all known platforms. The implementation goals are 
	  simplicity, efficiency, portability, and low embedding cost. The result is a 
	  fast language engine with small footprint, making it ideal in embedded systems 
	  too.
	  
	  http://www.lua.org/
	  
	  This package contains the LUA shared libraries, needed by other programs.

config BR2_PACKAGE_LUA
	prompt "lua............................... LUA programming language interpreter"
	tristate
	default m if CONFIG_DEVEL
	select BR2_PACKAGE_LIBLUA
	help
	  Lua is a powerful light-weight programming language designed for extending 
	  applications. Lua is also frequently used as a general-purpose, stand-alone 
	  language. Lua is free software.
	  
	  Lua combines simple procedural syntax with powerful data description 
	  constructs based on associative arrays and extensible semantics. Lua is 
	  dynamically typed, interpreted from bytecodes, and has automatic memory 
	  management with garbage collection, making it ideal for configuration, 
	  scripting, and rapid prototyping.
	  
	  Lua is implemented as a small library of C functions, written in ANSI C, and 
	  compiles unmodified in all known platforms. The implementation goals are 
	  simplicity, efficiency, portability, and low embedding cost. The result is a 
	  fast language engine with small footprint, making it ideal in embedded systems 
	  too.
	  
	  http://www.lua.org/
	  
	  This package contains the LUA language interpreter.

config BR2_PACKAGE_LUAC
	prompt "luac.............................. LUA programming language compiler"
	tristate
	default m if CONFIG_DEVEL
	select BR2_PACKAGE_LIBLUA
	help
	  Lua is a powerful light-weight programming language designed for extending 
	  applications. Lua is also frequently used as a general-purpose, stand-alone 
	  language. Lua is free software.
	  
	  Lua combines simple procedural syntax with powerful data description 
	  constructs based on associative arrays and extensible semantics. Lua is 
	  dynamically typed, interpreted from bytecodes, and has automatic memory 
	  management with garbage collection, making it ideal for configuration, 
	  scripting, and rapid prototyping.
	  
	  Lua is implemented as a small library of C functions, written in ANSI C, and 
	  compiles unmodified in all known platforms. The implementation goals are 
	  simplicity, efficiency, portability, and low embedding cost. The result is a 
	  fast language engine with small footprint, making it ideal in embedded systems 
	  too.
	  
	  http://www.lua.org/
	  
	  This package contains the LUA language compiler.

config BR2_PACKAGE_LUA_EXAMPLES
	prompt "lua-examples...................... LUA programming language examples"
	tristate
	default m if CONFIG_DEVEL
	select BR2_PACKAGE_LUA
	help
	  Lua is a powerful light-weight programming language designed for extending 
	  applications. Lua is also frequently used as a general-purpose, stand-alone 
	  language. Lua is free software.
	  
	  Lua combines simple procedural syntax with powerful data description 
	  constructs based on associative arrays and extensible semantics. Lua is 
	  dynamically typed, interpreted from bytecodes, and has automatic memory 
	  management with garbage collection, making it ideal for configuration, 
	  scripting, and rapid prototyping.
	  
	  Lua is implemented as a small library of C functions, written in ANSI C, and 
	  compiles unmodified in all known platforms. The implementation goals are 
	  simplicity, efficiency, portability, and low embedding cost. The result is a 
	  fast language engine with small footprint, making it ideal in embedded systems 
	  too.
	  
	  http://www.lua.org/
	  
	  This package contains LUA language examples.

endmenu
```

## openwrt/package/lzo/Config.in
```kconfig
config BR2_COMPILE_LZO
	bool
	default n
	depends BR2_PACKAGE_LIBLZO

config BR2_PACKAGE_LIBLZO
	prompt "liblzo............................ Real-time data compression library"
	tristate
	default m if CONFIG_DEVEL
	select BR2_COMPILE_LZO
	help
	  A real-time data compression library
	  
	  http://www.oberhumer.com/opensource/lzo/
```

## openwrt/package/madplay/Config.in
```kconfig
config BR2_PACKAGE_MADPLAY
       tristate "madplay........................... MPEG audio player in fixed point"
       default m if CONFIG_DEVELOPER
       select BR2_PACKAGE_LIBID3TAG 
       select BR2_PACKAGE_LIBMAD
       help
         MAD is an MPEG audio decoder. It currently only supports the MPEG 1
         standard, but fully implements all three audio layers (Layer I, Layer II,
         and Layer III, the latter often colloquially known as MP3.).  There is also
         full support for ID3 tags.
```

## openwrt/package/madwifi-tools/Config.in
```kconfig
menu "madwifi........................... Utilities for the Atheros Wifi driver"

config BR2_COMPILE_MADWIFI_TOOLS
	tristate
	default n
	depends BR2_PACKAGE_MADWIFI_TOOLS_BASE || BR2_PACKAGE_MADWIFI_TOOLS_STATS

config BR2_PACKAGE_MADWIFI_TOOLS_BASE
	prompt "madwifi-tools-base................ Utilities for configuring the Atheros Wifi driver"
	tristate
	select BR2_COMPILE_MADWIFI_TOOLS
	default y if BR2_LINUX_2_6_BRCM
	default m if CONFIG_DEVEL
	help
	  Driver utilities for Atheros 802.11a/b/g MiniPCI cards
	  
	  http://www.madwifi.org/

config BR2_PACKAGE_MADWIFI_TOOLS_STATS
	prompt "madwifi-tools-stats............... Debug and stat tools for the Atheros Wifi driver"
	tristate
	select BR2_COMPILE_MADWIFI_TOOLS
	default m if CONFIG_DEVEL
	help
	  Driver utilities for Atheros 802.11a/b/g MiniPCI cards
	  
	  http://www.madwifi.org/

endmenu
```

## openwrt/package/maradns/Config.in
```kconfig
config BR2_PACKAGE_MARADNS
	prompt "maradns........................... Small and secure DNS Server"
	tristate
	default m if CONFIG_DEVEL
	help
	  A small and secure DNS server
	  
	  http://www.maradns.org/
```

## openwrt/package/matrixssl/Config.in
```kconfig
config BR2_PACKAGE_MATRIXSSL
	select BR2_PACKAGE_LIBPTHREAD
	tristate "matrixssl"
	default m if CONFIG_DEVEL
	help
	  an embedded SSL implementation
	  
	  http://www.matrixssl.org/
	  
	  Depends: libpthread
	  
```

## openwrt/package/matrixtunnel/Config.in
```kconfig
config BR2_PACKAGE_MATRIXTUNNEL
	prompt "matrixtunnel...................... stunnel based on matrixssl"
	tristate
	default m if CONFIG_DEVEL
	select BR2_PACKAGE_LIBMATRIXSSL
	help
		matrixtunnel is a stripped down version of stunnel
		based on matrixssl library
		
		Depends: libmatrixssl
```

## openwrt/package/mgetty/Config.in
```kconfig
config BR2_PACKAGE_MGETTY
	prompt "mgetty+sendfax.................... the data/fax solution for your analog modem"
	tristate
	default m if CONFIG_DEVEL
	help
	 mgetty now includes sendfax (and AutoPPP)
	 using pppd for data and doing fax/login by itself.
```

## openwrt/package/miax/Config.in
```kconfig
config BR2_PACKAGE_MIAX
	prompt "miax.............................. A console iax (asterisk) client"
	tristate
	default m if CONFIG_DEVEL
	select BR2_PACKAGE_BLUEZ_LIBS
	select BR2_PACKAGE_LIBPTHREAD
	help
	  miax is a console iax (asterisk) client, it can work with
	  a soundcard as a normal voip phone, taking input/output from
	  keyboard, analog/gsm/isdn modem or bluetooth phones.
	  
	  http://www.eja.it/?l=gpl&testo=miax
```

## openwrt/package/microcom/Config.in
```kconfig
config BR2_PACKAGE_MICROCOM
	tristate "microcom (serial terminal)"
	default m if CONFIG_DEVEL
	help
	  microcom is a minicom-like serial terminal emulator with scripting 
	  support.
```

## openwrt/package/microperl/Config.in
```kconfig
config BR2_PACKAGE_MICROPERL
	tristate "microperl"
	default m if CONFIG_DEVEL
	help
	  Perl without operating-specific functions such as readdir.
```

## openwrt/package/mini_httpd/Config.in
```kconfig
menu "mini-httpd........................ A small web server"

config BR2_COMPILE_MINI_HTTPD
	tristate
	default n
	depends BR2_PACKAGE_MINI_HTTPD || BR2_PACKAGE_MINI_HTTPD_MATRIXSSL || BR2_PACKAGE_MINI_HTTPD_OPENSSL

config BR2_PACKAGE_MINI_HTTPD
	prompt "mini-httpd........................ A small web server"
	tristate
	default m if CONFIG_DEVEL
	select BR2_COMPILE_MINI_HTTPD
	help
	  mini_httpd is a small HTTP server. Its performance is not great, but for 
	  low or medium traffic sites it's quite adequate. It implements all the 
	  basic features of an HTTP server, including:
	  
	     * GET, HEAD, and POST methods.
	     * CGI.
	     * Basic authentication.
	     * Security against ".." filename snooping.
	     * The common MIME types.
	     * Trailing-slash redirection.
	     * index.html, index.htm, index.cgi
	     * Directory listings.
	     * Multihoming / virtual hosting.
	     * Standard logging.
	     * Custom error pages. 
	  
	  It can also be configured to do IPv6. 
	  
	  http://www.acme.com/software/mini_httpd/

config BR2_PACKAGE_MINI_HTTPD_HTPASSWD
	prompt "mini-httpd-htpasswd............... Utility to generate HTTP access files"
	tristate
	default m if CONFIG_DEVEL
	select BR2_PACKAGE_MINI_HTTPD
	help
		This file generates .htaccess/.htpasswd files to use HTTP access		authentication

config BR2_PACKAGE_MINI_HTTPD_MATRIXSSL
	prompt "mini-httpd-matrixssl.............. A small web server, built with SSL support using MatrixSSL"
	tristate
	default m if CONFIG_DEVEL
	select BR2_COMPILE_MINI_HTTPD
	select BR2_PACKAGE_LIBMATRIXSSL
	help
	  mini_httpd is a small HTTP server. Its performance is not great, but for 
	  low or medium traffic sites it's quite adequate. It implements all the 
	  basic features of an HTTP server, including:
	  
	     * GET, HEAD, and POST methods.
	     * CGI.
	     * Basic authentication.
	     * Security against ".." filename snooping.
	     * The common MIME types.
	     * Trailing-slash redirection.
	     * index.html, index.htm, index.cgi
	     * Directory listings.
	     * Multihoming / virtual hosting.
	     * Standard logging.
	     * Custom error pages. 
	  
	  It can also be configured to do SSL/HTTPS and IPv6. 
	  
	  http://www.acme.com/software/mini_httpd/

config BR2_PACKAGE_MINI_HTTPD_OPENSSL
	prompt "mini-httpd-openssl................ A small web server, built with SSL support using OpenSSL"
	tristate
	default m if CONFIG_DEVEL
	select BR2_COMPILE_MINI_HTTPD
	select BR2_PACKAGE_LIBOPENSSL
	help
	  mini_httpd is a small HTTP server. Its performance is not great, but for 
	  low or medium traffic sites it's quite adequate. It implements all the 
	  basic features of an HTTP server, including:
	  
	     * GET, HEAD, and POST methods.
	     * CGI.
	     * Basic authentication.
	     * Security against ".." filename snooping.
	     * The common MIME types.
	     * Trailing-slash redirection.
	     * index.html, index.htm, index.cgi
	     * Directory listings.
	     * Multihoming / virtual hosting.
	     * Standard logging.
	     * Custom error pages. 
	  
	  It can also be configured to do SSL/HTTPS and IPv6. 
	  
	  http://www.acme.com/software/mini_httpd/

endmenu
```

## openwrt/package/mini_sendmail/Config.in
```kconfig
config BR2_PACKAGE_MINI_SENDMAIL
	prompt "mini-sendmail..................... A small sendmail-compatible mail forwarder"
	tristate
	default m if CONFIG_DEVEL
	help
	  mini_sendmail reads its standard input up to an end-of-file and sends a 
	  copy of the message found there to all of the addresses listed.
	  The message is sent by connecting to a local SMTP server. This means 
	  mini_sendmail can be used to send email from inside a chroot(2) area. 
	  
	  http://www.acme.com/software/mini_sendmail/
```

## openwrt/package/miredo/Config.in
```kconfig
config BR2_COMPILE_MIREDO
	tristate
	default n
	depends BR2_PACKAGE_MIREDO || BR2_PACKAGE_MIREDO_SERVER

config BR2_PACKAGE_MIREDO
	prompt "miredo............................ Teredo (IPv6 tunneling over UDP through NAT) client and relay daemon"
	tristate
	default m if CONFIG_DEVEL
	select BR2_COMPILE_MIREDO
	select BR2_PACKAGE_KMOD_IPV6
	select BR2_PACKAGE_KMOD_TUN
	select BR2_PACKAGE_LIBPTHREAD
	select BR2_PACKAGE_UCLIBCXX
	help
	  A Teredo (IPv6 tunneling over UDP through NAT) client and relay daemon.
	  
	  http://www.simphalempin.com/dev/miredo/
	  
	  Depends:
	    - kmod-ipv6
	    - kmod-tun
	    - libpthread
	    - uClibc++

config BR2_PACKAGE_MIREDO_SERVER
	prompt "miredo-server..................... Teredo (IPv6 tunneling over UDP through NAT) server daemon"
	tristate
	default m if CONFIG_DEVEL
	select BR2_COMPILE_MIREDO
	select BR2_PACKAGE_KMOD_IPV6
	select BR2_PACKAGE_KMOD_TUN
	select BR2_PACKAGE_LIBPTHREAD
	select BR2_PACKAGE_UCLIBCXX
	help
	  A Teredo (IPv6 tunneling over UDP through NAT) server daemon.
	  
	  http://www.simphalempin.com/dev/miredo/
	  
	  Depends:
	    - kmod-ipv6
	    - kmod-tun
	    - libpthread
	    - uClibc++
```

## openwrt/package/monit/Config.in
```kconfig
#menu "monit............................. System services monitoring utility"

config BR2_COMPILE_MONIT
	tristate
	default n
	depends BR2_PACKAGE_MONIT || BR2_PACKAGE_MONIT_NOSSL

config BR2_PACKAGE_MONIT
	prompt "monit............................. System services monitoring utility, with SSL support"
	tristate
	select BR2_COMPILE_MONIT
	select BR2_PACKAGE_LIBPTHREAD
	select BR2_PACKAGE_LIBOPENSSL
	default m if CONFIG_DEVEL
	help
	  An utility for monitoring services on a Unix system
	  
	  This package is built with SSL support.
	  
	  http://www.tildeslash.com/monit/

config BR2_PACKAGE_MONIT_NOSSL
	prompt "monit-nossl....................... System services monitoring utility, without SSL support"
	tristate
	select BR2_COMPILE_MONIT
	select BR2_PACKAGE_LIBPTHREAD
	default m if CONFIG_DEVEL
	help
	  An utility for monitoring services on a Unix system.
	  
	  This package is built without SSL support.
	  
	  http://www.tildeslash.com/monit/

#endmenu
```

## openwrt/package/motion/Config.in
```kconfig
config BR2_PACKAGE_MOTION
	prompt "motion............................ webcam motion sensing and logging"
	tristate
	default m if CONFIG_DEVEL
	select BR2_PACKAGE_LIBJPEG
	help
	  Motion is a software motion detector

	  http://www.lavrsen.dk/twiki/bin/view/Motion/WebHome
```
