## openwrt/package/mpd/Config.in
```kconfig
menu "mpd............................... Music Player Daemon"

config BR2_PACKAGE_MPD
	prompt "mpd............................... Music Player Daemon"
	tristate
	default m if CONFIG_DEVEL
	help
	  MPD is a music player supporting flac, mp3 and ogg files.
	  It is typically controlled over a network using one of it's many
	  clients including mpc(console), gmpc(gnome), phpmp(php) etc.
	  
	  http://www.musicpd.org/

config BR2_COMPILE_MPD_WITH_MP3
	prompt   "MP3 support"
	bool
	default y
	depends BR2_PACKAGE_MPD
	select BR2_PACKAGE_LIBMAD
	select BR2_PACKAGE_LIBID3TAG
	help
	  Enable mp3 support (libmad).

config BR2_COMPILE_MPD_WITH_OGG
	prompt   "Ogg Support"
	bool
	default y
	depends BR2_PACKAGE_MPD
	select BR2_PACKAGE_LIBVORBISIDEC
	help
	  Enable ogg support (tremor).

config BR2_COMPILE_MPD_WITH_FLAC
	prompt   "FLAC Support"
	bool
	default y
	depends BR2_PACKAGE_MPD
	select BR2_PACKAGE_LIBFLAC
	help
	  Enable flac support (libflac).

endmenu
```

## openwrt/package/mrd6/Config.in
```kconfig
config BR2_PACKAGE_MRD6
	prompt "mrd6.............................. IPv6 multicast routing daemon"
	tristate
	default m if CONFIG_DEVEL
	help
		Multicast is becoming a major component in next generation 
		networks, used in several scenarios, from video broadcasting 
		to multimedia conferencing. In order to be implemented, new 
		technology needs supporting hardware and software across a set 
		of devices and systems. MRD6 is an implementation of a modular 
		IPv6 Multicast Routing Framework for the Linux operating system 
		and provides MLDv2 (as well as MLDv1), PIM-SM and MBGP support.

		http://artemis.av.it.pt/mrd6/
```

## openwrt/package/mtd/Config.in
```kconfig
config BR2_PACKAGE_MTD
	tristate "mtd - update utility for trx firmware images"
	default y
	help
	 update utility for trx firmware images.

config BR2_PACKAGE_MTD_STATIC
	tristate "mtd - update utility for trx firmware images (statically linked)"
	default n
	help
	 update utility for trx firmware images (statically linked). To update
	 from other firmware or older OpenWrt releases.
```

## openwrt/package/mysql/Config.in
```kconfig
config BR2_COMPILE_MYSQL
	tristate
	default n
	depends BR2_PACKAGE_LIBMYSQLCLIENT

config BR2_PACKAGE_LIBMYSQLCLIENT
	prompt "libmysqlclient.................... MySQL client library"
	tristate
	default m if CONFIG_DEVEL
	select BR2_COMPILE_MYSQL
	help
	  MySQL client library.
	  
	  http://dev.mysql.com/
```

## openwrt/package/nano/Config.in
```kconfig
config BR2_PACKAGE_NANO
	prompt "nano.............................. An enhanced clone of the Pico text editor"
	tristate
	default m if CONFIG_DEVEL
	select BR2_PACKAGE_LIBNCURSES
	help
	  GNU nano (Nano's ANOther editor, or Not ANOther editor) is an enhanced clone of the Pico text editor..
	  
	  http://www.nano-editor.org/
```

## openwrt/package/ncurses/Config.in
```kconfig
config BR2_COMPILE_NCURSES
	tristate
	depends BR2_PACKAGE_LIBNCURSES

config BR2_PACKAGE_LIBNCURSES
	prompt "libncurses........................ Terminal handling library"
	tristate
	default m if CONFIG_DEVEL
	select BR2_COMPILE_NCURSES
	help
	  A terminal handling library
	  
	  http://www.gnu.org/software/ncurses/
```

## openwrt/package/ndisc/Config.in
```kconfig
menu "ndisc6............................ IPv6 discovery tools"

config BR2_COMPILE_NDISC6
	tristate
	default n
	depends BR2_PACKAGE_NDISC6 || BR2_PACKAGE_RDISC6 || BR2_PACKAGE_TCPTRACEROUTE6

config BR2_PACKAGE_NDISC6
	prompt "ndisc6............................ An ICMPv6 neighbour discovery tool"
	tristate
	default m if CONFIG_DEVEL
	select BR2_COMPILE_NDISC6
	help
	  
	  An ICMPv6 neighbour discovery tools
	  
	  http://people.via.ecp.fr/~rem/ndisc6/

config BR2_PACKAGE_RDISC6
	prompt "rdisc6............................ An ICMPv6 router discovery tool"
	tristate
	default m if CONFIG_DEVEL
	select BR2_COMPILE_NDISC6
	help
	  
	  An ICMPv6 router discovery tool
	  
	  http://people.via.ecp.fr/~rem/ndisc6/

config BR2_PACKAGE_TCPTRACEROUTE6
	prompt "tcptraceroute6.................... A TCP/IPv6-based traceroute implementation"
	tristate
	default m if CONFIG_DEVEL
	select BR2_COMPILE_NDISC6
	help
	  
	  A TCP/IPv6-based traceroute implementation
	  
	  http://people.via.ecp.fr/~rem/ndisc6/

endmenu
```

## openwrt/package/net-snmp/Config.in
```kconfig
menu "net-snmp.......................... Open source SNMP (Simple Network Management Protocol) implementation"

config BR2_COMPILE_NET_SNMP
	tristate
	default n
	depends BR2_PACKAGE_LIBNETSNMP || BR2_PACKAGE_SNMPD_STATIC

config BR2_PACKAGE_LIBNETSNMP
	prompt "libnetsnmp........................ SNMP shared libraries"
	tristate
	default m if CONFIG_DEVEL
	select BR2_COMPILE_NET_SNMP
	select BR2_PACKAGE_LIBELF
	help
	  Simple Network Management Protocol (SNMP) is a widely used 
	  protocol for monitoring the health and welfare of network 
	  equipment (eg. routers), computer equipment and even devices 
	  like UPSs. Net-SNMP is a suite of applications used to implement 
	  SNMP v1, SNMP v2c and SNMP v3 using both IPv4 and IPv6.
	  
	  http://www.net-snmp.org/
	  
	  This package contains shared libraries, needed by other programs.

config BR2_PACKAGE_SNMP_UTILS
	prompt   "snmp-utils...................... SNMP client utilities"
	tristate
	default m if CONFIG_DEVEL
	depends BR2_PACKAGE_LIBNETSNMP
	help
	  Simple Network Management Protocol (SNMP) is a widely used 
	  protocol for monitoring the health and welfare of network 
	  equipment (eg. routers), computer equipment and even devices 
	  like UPSs. Net-SNMP is a suite of applications used to implement 
	  SNMP v1, SNMP v2c and SNMP v3 using both IPv4 and IPv6.
	  
	  http://www.net-snmp.org/
	  
	  This package contains the SNMP client utilities.

config BR2_PACKAGE_SNMPD
	prompt "snmpd............................. SNMP agent"
	tristate
	default m if CONFIG_DEVEL
	select BR2_COMPILE_NET_SNMP
	select BR2_PACKAGE_LIBNETSNMP
	help
	  Simple Network Management Protocol (SNMP) is a widely used 
	  protocol for monitoring the health and welfare of network 
	  equipment (eg. routers), computer equipment and even devices 
	  like UPSs. Net-SNMP is a suite of applications used to implement 
	  SNMP v1, SNMP v2c and SNMP v3 using both IPv4 and IPv6.
	  
	  http://www.net-snmp.org/
	  
	  This package contains the SNMP agent, dynamically linked.

config BR2_PACKAGE_SNMPD_STATIC
	prompt "snmpd-static...................... SNMP agent (statically linked)"
	tristate
	default m if CONFIG_DEVEL
	select BR2_COMPILE_NET_SNMP
	select BR2_PACKAGE_LIBELF
	help
	  Simple Network Management Protocol (SNMP) is a widely used 
	  protocol for monitoring the health and welfare of network 
	  equipment (eg. routers), computer equipment and even devices 
	  like UPSs. Net-SNMP is a suite of applications used to implement 
	  SNMP v1, SNMP v2c and SNMP v3 using both IPv4 and IPv6.
	  
	  http://www.net-snmp.org/
	  
	  This package contains the SNMP agent, statically linked.

endmenu
```
