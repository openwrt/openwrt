## openwrt/package/libelf/Config.in
```kconfig
config BR2_PACKAGE_LIBELF
	tristate "libelf - ELF object file access library"
	default m if CONFIG_DEVEL
	help
	  This is the public release of libelf-0.8.5, a free ELF object
	  file access library.
	  
	  http://www.stud.uni-hannover.de/~michael/software/
	  
```

## openwrt/package/libgd/Config.in
```kconfig
config BR2_PACKAGE_LIBGD
	prompt "libgd............................. The GD Graphics Library"
	tristate
	default m if CONFIG_DEVEL
	select BR2_PACKAGE_LIBJPEG
	select BR2_PACKAGE_LIBPNG
	help
	  The GD Graphics Library
	  
	  http://www.boutell.com/gd/
```

## openwrt/package/libgdbm/Config.in
```kconfig
config BR2_PACKAGE_LIBGDBM
	prompt "libgdbm........................... The GNU database manager"
	tristate
	default m if CONFIG_DEVEL
	help
	  disk file format database which stores key/data-pairs in single files.  
	  
	  http://www.gnu.org
```

## openwrt/package/liblzo/Config.in
```kconfig
config BR2_PACKAGE_LIBLZO
	prompt "liblzo............................ Real-time data compression library"
	tristate
	default m if CONFIG_DEVEL
	help
	  A real-time data compression library
	  
	  http://www.oberhumer.com/opensource/lzo/
```

## openwrt/package/libmcrypt/Config.in
```kconfig
config BR2_PACKAGE_LIBMCRYPT
        prompt "libmcrypt....................... Cryptographic library"
	tristate
        default m if CONFIG_DEVEL
        help
	  libmcrypt is a cryptographic library that conveniently brings 
	  together a variety of ciphers for convenient use.

	  http://mcrypt.sourceforge.net/
```

## openwrt/package/libnet/Config.in
```kconfig
config BR2_PACKAGE_LIBNET
	tristate "libnet - Low-level packet creation library"
	default m if CONFIG_DEVEL
	select BR2_PACKAGE_LIBPCAP
	help
	  A low-level packet creation library.
	  
	  http://www.packetfactory.net/libnet/
	  
	  Depends: libpcap
	  
```

## openwrt/package/libnids/Config.in
```kconfig
config BR2_PACKAGE_LIBNIDS
	prompt "libnids........................... A network intrusion detection library"
	tristate
	select BR2_PACKAGE_LIBPCAP
	select BR2_PACKAGE_LIBNET
	default m if CONFIG_DEVEL
	help
	  An implementation of an E-component of Network Intrusion Detection System.
	  
	  http://www.packetfactory.net/projects/libnids/
```

## openwrt/package/libogg/Config.in
```kconfig
config BR2_PACKAGE_LIBOGG
	prompt "libogg............................ The Ogg bitstream handling library"
	tristate
	default n
	help
	  The Ogg bitstream handling library.
	  
	  http://www.vorbis.com/
```

## openwrt/package/libol/Config.in
```kconfig
config BR2_PACKAGE_LIBOL
	prompt "libol............................. Support library for syslog-ng"
	tristate
	default n 
	help
	  Support library for syslog-ng

	  http://www.balabit.com
```

## openwrt/package/libosip2/Config.in
```kconfig
config BR2_PACKAGE_LIBOSIP2
	prompt "libosip2.......................... The GNU oSIP library"
	tristate
	default m if CONFIG_DEVEL
	select BR2_PACKAGE_LIBPTHREAD
	help
	  GNU oSIP library, a Session Initiation Protocol (SIP) implementation
	  
	  http://www.gnu.org/software/osip/
```

## openwrt/package/libpcap/Config.in
```kconfig
config BR2_PACKAGE_LIBPCAP
	bool "libpcap"
	default n
	help
	  A system-independent library for user-level network packet capture.

	  http://www.tcpdump.org/
```

## openwrt/package/libpng/Config.in
```kconfig
config BR2_PACKAGE_LIBPNG
	tristate "libpng"
	default m if CONFIG_DEVEL
	select BR2_PACKAGE_ZLIB
	help
	  A library for reading/writing PNG files
```

## openwrt/package/libpthread/Config.in
```kconfig
config BR2_PACKAGE_LIBPTHREAD
	prompt "libpthread........................ POSIX threads library"
	tristate
	default m if CONFIG_DEVEL
	help
	  POSIX threads library
```

## openwrt/package/libtool/Config.in
```kconfig
config BR2_COMPILE_LIBTOOL
	tristate
	depends BR2_PACKAGE_LIBLTDL

config BR2_PACKAGE_LIBLTDL
	prompt "libltdl........................... A generic dynamic object loading library"
	tristate
	default m if CONFIG_DEVEL
	select BR2_COMPILE_LIBTOOL
	help
	  A generic dynamic object loading library.
	  
	  http://www.gnu.org/software/libtool/
```

## openwrt/package/libupnp/Config.in
```kconfig
config BR2_PACKAGE_LIBUPNP
	prompt "libupnp........................... Universal Plug and Play (UPnP) SDK library"
	tristate
	default m if CONFIG_DEVEL
	help
	  The Universal Plug and Play (UPnP) SDK for Linux provides support 
	  for building UPnP-compliant control points, devices, and bridges 
	  on Linux.
	  
	  http://upnp.sourceforge.net/
	  
	  Depends: libpthread
```

## openwrt/package/libusb/Config.in
```kconfig
config BR2_PACKAGE_LIBUSB
	tristate "libusb"
	default m if CONFIG_DEVEL
	help
	  A library for accessing Linux USB devices
```

## openwrt/package/libvorbis/Config.in
```kconfig
config BR2_PACKAGE_LIBVORBIS
	prompt "libvorbis......................... The Vorbis General Audio Compression Codec library"
	tristate
	default n
	select BR2_PACKAGE_LIBOGG
	help
	  The Vorbis General Audio Compression Codec library.
	  
	  http://www.vorbis.com/
```

## openwrt/package/libxml2/Config.in
```kconfig
config BR2_PACKAGE_LIBXML2
	prompt "libxml2........................... Gnome XML library"
	tristate
	default m if CONFIG_DEVEL
	select BR2_PACKAGE_LIBPTHREAD
	select BR2_PACKAGE_ZLIB
	help
	  A library for manipulating XML and HTML resources.
	  
	  http://xmlsoft.org/
```

## openwrt/package/libxslt/Config.in
```kconfig
config BR2_PACKAGE_LIBXSLT
	prompt "libxslt........................... Gnome XSLT library"
	tristate
	default m if CONFIG_DEVEL
	select BR2_PACKAGE_LIBXML2
	help
	  A library for XML transformation using XSLT.
	  
	  http://xmlsoft.org/XSLT/
```

## openwrt/package/lighttpd/Config.in
```kconfig
config BR2_PACKAGE_LIGHTTPD
	prompt "lighttpd - a flexible and lightweight web server"
	tristate 
	default m if CONFIG_DEVEL
	help
	  A flexible and lightweight web server.
	  
	  http://www.lighttpd.net/
	  
	  Depends: libopenssl, libpcre
	  

config BR2_PACKAGE_LIGHTTPD_MOD_ALIAS
	depends BR2_PACKAGE_LIGHTTPD
	prompt "mod-alias - a directory alias module"
	tristate 
	default m if CONFIG_DEVEL

config BR2_PACKAGE_LIGHTTPD_MOD_AUTH
	depends BR2_PACKAGE_LIGHTTPD
	prompt "mod-auth - an authentication module"
	tristate 
	default m if CONFIG_DEVEL

config BR2_PACKAGE_LIGHTTPD_MOD_CGI
	depends BR2_PACKAGE_LIGHTTPD
	prompt "mod-cgi - a CGI module"
	tristate 
	default m if CONFIG_DEVEL

config BR2_PACKAGE_LIGHTTPD_MOD_PROXY
	depends BR2_PACKAGE_LIGHTTPD
	prompt "mod-proxy - a proxy module"
	tristate 
	default m if CONFIG_DEVEL

config BR2_PACKAGE_LIGHTTPD_MOD_REDIRECT
	depends BR2_PACKAGE_LIGHTTPD
	prompt "mod-redirect - an url redirection module"
	tristate 
	default m if CONFIG_DEVEL

config BR2_PACKAGE_LIGHTTPD_MOD_REWRITE
	depends BR2_PACKAGE_LIGHTTPD
	prompt "mod-rewrite - an url rewriting module"
	tristate 
	default m if CONFIG_DEVEL

config BR2_PACKAGE_LIGHTTPD_MOD_SETENV
	depends BR2_PACKAGE_LIGHTTPD
	prompt "mod-setenv - an environment variable setting module"
	tristate 
	default m if CONFIG_DEVEL

config BR2_PACKAGE_LIGHTTPD_MOD_SIMPLE_VHOST
	depends BR2_PACKAGE_LIGHTTPD
	prompt "mod-simple-vhost - a simple virtual hosting module"
	tristate 
	default m if CONFIG_DEVEL

config BR2_PACKAGE_LIGHTTPD_MOD_STATUS
	depends BR2_PACKAGE_LIGHTTPD
	prompt "mod-status - a server status display module"
	tristate 
	default m if CONFIG_DEVEL

config BR2_PACKAGE_LIGHTTPD_MOD_USERTRACK
	depends BR2_PACKAGE_LIGHTTPD
	prompt "mod-usertrack - an user tracking module"
	tristate 
	default m if CONFIG_DEVEL
```

## openwrt/package/linksys-utils/Config.in
```kconfig
config BR2_PACKAGE_LINKSYS_UTILS
	tristate "Linksys binary utilites"
	default y
	help
	  Binary-only utilities from Linksys (et, wl, nas)
```

## openwrt/package/linux-atm/Config.in
```kconfig
config PACKAGE_LINUX_ATM
	prompt "linux-atm......................... ATM Library/Utilities for Linux"
	tristate
	default y if LINUX_2_4_AR7
	default n
	help
	  ATM Library for linux
	  
	  http://ftp.debian.org/debian/pool/main/l/linux-atm/

config PACKAGE_BR2684CTL
	prompt   "br2684ctl....................... RFC2684 bridging utility"
	tristate
	default y if LINUX_2_4_AR7
	default n
	depends PACKAGE_LINUX_ATM
	help
	  Utility for setting up ATM RFC2684 bridging mode
	  Useful for PPPoE
	  
	  http://ftp.debian.org/debian/pool/main/l/linux-atm/
```

## openwrt/package/linux/Config.in
```kconfig
config BR2_PACKAGE_KMOD_ARPT
	tristate "ARP firewalling support"
	default m
	help
	  Kernel modules for ARP firewalling

config BR2_PACKAGE_KMOD_EBT
	tristate "Ethernet Bridge firewalling support"
	default m
	help
	  Kernel modules for bridge firewalling

config BR2_PACKAGE_KMOD_IPT4
	tristate "Extra modules for iptables"
	default m
	help
	  Extra kernel modules for IPv4 firewalling

config BR2_PACKAGE_KMOD_IPV6
	tristate "IPv6 support"
	default m
	help
	  Kernel modules for IPv6 protocol support
	  
config BR2_PACKAGE_KMOD_IPT6
	tristate "Kernel modules for ip6tables"
	default m
	depends BR2_PACKAGE_KMOD_IPV6
	help
	  IPv6 firewalling support

config BR2_PACKAGE_KMOD_NFS
	tristate "NFS support"
	default m
	help
	  Kernel modules for NFS support
	  Includes lockd, nfs and sunrpc

config BR2_PACKAGE_KMOD_CIFS
	tristate "CIFS support"
	default m
	help
	  Kernel modules for CIFS support

config BR2_PACKAGE_KMOD_USB
	tristate "USB/SCSI support"
	default m
	help
	  Kernel modules for USB/SCSI support
	  Includes usb-storage and printer

config BR2_PACKAGE_KMOD_VFAT
	tristate "VFAT filesystem support"
	default m
	help
	  Kernel modules for VFAT filesystem support
	  useful for usb mass storage devices

config BR2_PACKAGE_KMOD_LP
	tristate "parallel port and lp support"
	default m
	help
	  Kernel modules for line printer and parallel port support

config BR2_PACKAGE_KMOD_CRYPTO
	tristate "CryptoAPI modules"
	default m
	select BUSYBOX_CONFIG_FEATURE_CHECK_TAINTED_MODULE
	help
	  Kernel modules for cryptographic algorithms

config BR2_PACKAGE_KMOD_PPP
	tristate "PPP support"
	default m
	help
	  Kernel support for PPP

config BR2_PACKAGE_KMOD_MPPE
	tristate "PPP MPPE/MPPC module"
	default m
	select BR2_PACKAGE_KMOD_CRYPTO
	depends BR2_PACKAGE_KMOD_PPP
	help
	  Support for Microsoft PPP Encryption/Compression

config BR2_PACKAGE_KMOD_PPPOE
	tristate "PPPoE modules"
	default m
	depends BR2_PACKAGE_KMOD_PPP
	help
	  Support for PPP over Ethernet

config BR2_PACKAGE_KMOD_TUN
	tristate "Universal TUN/TAP driver"
	default m
	help
	  Kernel support for the TUN/TAP tunneling device

config BR2_PACKAGE_KMOD_GRE
	tristate "GRE tunneling driver"
	default m
	help
	  Kernel support for GRE tunnels

config BR2_PACKAGE_KMOD_SCHED
	tristate "Traffic schedulers"
	default m
	help
	  Kernel schedulers for IP traffic
```

## openwrt/package/loader/Config.in
```kconfig
config BR2_PACKAGE_LOADER
	bool "LZMA compressed kernel loader"
	default y
	help
	  LZMA compressed kernel loader (saves much space in the flash)
	 
```
