## openwrt/package/busybox/config/networking/udhcp/Config.in
```kconfig
#
# For a description of the syntax of this configuration file,
# see scripts/kbuild/config-language.txt.
#

menu "udhcp Server/Client"

config BUSYBOX_CONFIG_UDHCPD
	bool "udhcp Server (udhcpd)"
	default n
	help
	  uDHCPd is a DHCP server geared primarily toward embedded systems,
	  while striving to be fully functional and RFC compliant.

	  See http://udhcp.busybox.net for further details.

config BUSYBOX_CONFIG_UDHCPC
	bool "udhcp Client (udhcpc)"
	default y
	help
	  uDHCPc is a DHCP client geared primarily toward embedded systems,
	  while striving to be fully functional and RFC compliant.

	  The udhcp client negotiates a lease with the DHCP server and
	  notifies a set of scripts when a lease is obtained or lost.

	  See http://udhcp.busybox.net for further details.

config BUSYBOX_CONFIG_DUMPLEASES
	bool "Lease display utility (dumpleases)"
	default n
	depends on BUSYBOX_CONFIG_UDHCPD
	help
	  dumpleases displays the leases written out by the udhcpd server.
	  Lease times are stored in the file by time remaining in lease, or
	  by the absolute time that it expires in seconds from epoch.

	  See http://udhcp.busybox.net for further details.

config BUSYBOX_CONFIG_FEATURE_UDHCP_SYSLOG
	bool "  Log udhcp messages to syslog (instead of stdout)"
	default n
	depends on BUSYBOX_CONFIG_UDHCPD || BUSYBOX_CONFIG_UDHCPC
	help
	  If selected, udhcpd will log all its messages to syslog, otherwise,
	  it will attempt to log them to stdout.

	  See http://udhcp.busybox.net for further details.

config BUSYBOX_CONFIG_FEATURE_UDHCP_DEBUG
	bool "  Compile udhcp with noisy debugging messages"
	default n
	depends on BUSYBOX_CONFIG_UDHCPD || BUSYBOX_CONFIG_UDHCPC
	help
	  If selected, udhcpd will output extra debugging output.  If using
	  this option, compile uDHCP with "-g", and do not fork the daemon to
	  the background.

	  See http://udhcp.busybox.net for further details.

endmenu
```

## openwrt/package/busybox/config/shell/Config.in
```kconfig
#
# For a description of the syntax of this configuration file,
# see scripts/kbuild/config-language.txt.
#

menu "Shells"

choice
	prompt "Choose your default shell"
	default BUSYBOX_CONFIG_FEATURE_SH_IS_ASH
	help
	  Choose a shell. The ash shell is the most bash compatible
	  and full featured one.

config BUSYBOX_CONFIG_FEATURE_SH_IS_ASH
	select BUSYBOX_CONFIG_ASH
	bool "ash"

config BUSYBOX_CONFIG_FEATURE_SH_IS_HUSH
	select BUSYBOX_CONFIG_HUSH
	bool "hush"

config BUSYBOX_CONFIG_FEATURE_SH_IS_LASH
	select BUSYBOX_CONFIG_LASH
	bool "lash"

config BUSYBOX_CONFIG_FEATURE_SH_IS_MSH
	select BUSYBOX_CONFIG_MSH
	bool "msh"

config BUSYBOX_CONFIG_FEATURE_SH_IS_NONE
	bool "none"

endchoice

config BUSYBOX_CONFIG_ASH
	bool "ash"
	default y
	select BUSYBOX_CONFIG_TEST
	help
	  Tha 'ash' shell adds about 60k in the default configuration and is
	  the most complete and most pedantically correct shell included with
	  busybox.  This shell is actually a derivative of the Debian 'dash'
	  shell (by Herbert Xu), which was created by porting the 'ash' shell
	  (written by Kenneth Almquist) from NetBSD.

comment "Ash Shell Options"
	depends on BUSYBOX_CONFIG_ASH

config BUSYBOX_CONFIG_ASH_JOB_CONTROL
	bool "  Enable Job control"
	default y
	depends on BUSYBOX_CONFIG_ASH
	help
	  Enable job control in the ash shell.

config BUSYBOX_CONFIG_ASH_READ_NCHARS
	bool "  Enable 'read -n N' and 'read -s' support"
	default n
	depends on BUSYBOX_CONFIG_ASH
	help
	  'read -n N' will return a value after N characters have been read.
	  'read -s' will read without echoing the user's input.

config BUSYBOX_CONFIG_ASH_READ_TIMEOUT
	bool "  Enable 'read -t S' support."
	default y
	depends on BUSYBOX_CONFIG_ASH
	help
	  'read -t S' will return a value after S seconds have passed.
	  This implementation will allow fractional seconds, expressed
	  as a decimal fraction, e.g. 'read -t 2.5 foo'.

config BUSYBOX_CONFIG_ASH_ALIAS
	bool "  Enable alias support"
	default y
	depends on BUSYBOX_CONFIG_ASH
	help
	  Enable alias support in the ash shell.

config BUSYBOX_CONFIG_ASH_MATH_SUPPORT
	bool "  Enable Posix math support"
	default y
	depends on BUSYBOX_CONFIG_ASH
	help
	  Enable math support in the ash shell.

config BUSYBOX_CONFIG_ASH_MATH_SUPPORT_64
	bool "    Extend Posix math support to 64 bit"
	default n
	depends on BUSYBOX_CONFIG_ASH_MATH_SUPPORT
	help
	  Enable 64-bit math support in the ash shell.  This will make
	  the shell slightly larger, but will allow computation with very
	  large numbers.

config BUSYBOX_CONFIG_ASH_GETOPTS
	bool "  Enable getopts builtin to parse positional parameters"
	default y
	depends on BUSYBOX_CONFIG_ASH
	help
	  Enable getopts builtin in the ash shell.

config BUSYBOX_CONFIG_ASH_CMDCMD
	bool "  Enable cmdcmd to override shell builtins"
	default y
	depends on BUSYBOX_CONFIG_ASH
	help
	  Enable support for the ash 'command' builtin, which allows
	  you to run the specified command with the specified arguments,
	  even when there is an ash builtin command with the same name.

config BUSYBOX_CONFIG_ASH_BUILTIN_ECHO
	bool "  Enable builtin version of 'echo'"
	default y
	depends on BUSYBOX_CONFIG_ASH
	help
	  Enable support for echo, built in to ash.

# this entry also appears in coreutils/Config.in, next to the echo applet
config BUSYBOX_CONFIG_FEATURE_FANCY_ECHO
	bool "  Enable echo options (-n and -e)"
	default y
	depends on BUSYBOX_CONFIG_ASH_BUILTIN_ECHO
	help
	  This adds options (-n and -e) to echo.

config BUSYBOX_CONFIG_ASH_MAIL
	bool "  Check for new mail on interactive shells"
	default n
	depends on BUSYBOX_CONFIG_ASH
	help
	  Enable "check for new mail" in the ash shell.

config BUSYBOX_CONFIG_ASH_OPTIMIZE_FOR_SIZE
	bool "  Optimize for size instead of speed"
	default y
	depends on BUSYBOX_CONFIG_ASH
	help
	  Compile ash for reduced size at the price of speed.

config BUSYBOX_CONFIG_ASH_RANDOM_SUPPORT
	bool "  Enable pseudorandom generator and variable $RANDOM"
	default n
	depends on BUSYBOX_CONFIG_ASH
	help
	  Enable pseudorandom generator and dynamic variable "$RANDOM".
	  Each read of "$RANDOM" will generate a new pseudorandom value.
	  You can reset the generator by using a specified start value.
	  After "unset RANDOM" then generator will switch off and this
	  variable will no longer have special treatment.

config BUSYBOX_CONFIG_ASH_EXPAND_PRMT
	bool "  Expand prompt string"
	default n
	depends on BUSYBOX_CONFIG_ASH
	help
	  "PS#" may be contain volatile content, such as backquote commands.
	  This option recreates the prompt string from the environment
	  variable each time it is displayed.

config BUSYBOX_CONFIG_HUSH
	bool "hush"
	default n
	select BUSYBOX_CONFIG_TRUE
	select BUSYBOX_CONFIG_FALSE
	select BUSYBOX_CONFIG_TEST
	help
	  hush is a very small shell (just 18k) and it has fairly complete
	  Bourne shell grammar.  It even handles all the normal flow control
	  options such as if/then/elif/else/fi, for/in/do/done, while loops,
	  etc.

	  It does not handle case/esac, select, function, here documents ( <<
	  word ), arithmetic expansion, aliases, brace expansion, tilde
	  expansion, &> and >& redirection of stdout+stderr, etc.


config BUSYBOX_CONFIG_LASH
	bool "lash"
	default n
	select BUSYBOX_CONFIG_TRUE
	select BUSYBOX_CONFIG_FALSE
	select BUSYBOX_CONFIG_TEST
	help
	  lash is the very smallest shell (adds just 10k) and it is quite
	  usable as a command prompt, but it is not suitable for any but the
	  most trivial scripting (such as an initrd that calls insmod a few
	  times) since it does not understand any Bourne shell grammar.  It
	  does handle pipes, redirects, and job control though.  Adding in
	  command editing makes it a very nice lightweight command prompt.


config BUSYBOX_CONFIG_MSH
	bool "msh"
	default n
	select BUSYBOX_CONFIG_TRUE
	select BUSYBOX_CONFIG_FALSE
	select BUSYBOX_CONFIG_TEST
	help
	  The minix shell (adds just 30k) is quite complete and handles things
	  like for/do/done, case/esac and all the things you expect a Bourne
	  shell to do.  It is not always pedantically correct about Bourne
	  shell grammar (try running the shell testscript "tests/sh.testcases"
	  on it and compare vs bash) but for most things it works quite well.
	  It also uses only vfork, so it can be used on uClinux systems.

comment "Bourne Shell Options"
	depends on BUSYBOX_CONFIG_MSH || BUSYBOX_CONFIG_LASH || BUSYBOX_CONFIG_HUSH || BUSYBOX_CONFIG_ASH

config BUSYBOX_CONFIG_FEATURE_SH_EXTRA_QUIET
	bool "Hide message on interactive shell startup"
	default n
	depends on BUSYBOX_CONFIG_MSH || BUSYBOX_CONFIG_LASH || BUSYBOX_CONFIG_HUSH || BUSYBOX_CONFIG_ASH
	help
	  Remove the busybox introduction when starting a shell.

config BUSYBOX_CONFIG_FEATURE_SH_STANDALONE_SHELL
	bool "Standalone shell"
	default n
	depends on BUSYBOX_CONFIG_MSH || BUSYBOX_CONFIG_LASH || BUSYBOX_CONFIG_HUSH || BUSYBOX_CONFIG_ASH
	help
	  This option causes the selected busybox shell to use busybox applets
	  in preference to executables in the PATH whenever possible.  For
	  example, entering the command 'ifconfig' into the shell would cause
	  busybox to use the ifconfig busybox applet.  Specifying the fully
	  qualified executable name, such as '/sbin/ifconfig' will still
	  execute the /sbin/ifconfig executable on the filesystem.  This option
	  is generally used when creating a statically linked version of busybox
	  for use as a rescue shell, in the event that you screw up your system.

	  Note that when using this option, the shell will attempt to directly
	  run '/bin/busybox'.  If you do not have the busybox binary sitting in
	  that exact location with that exact name, this option will not work at
	  all.

config BUSYBOX_CONFIG_FEATURE_COMMAND_EDITING
	bool "command line editing"
	default y
	depends on BUSYBOX_CONFIG_MSH || BUSYBOX_CONFIG_LASH || BUSYBOX_CONFIG_HUSH || BUSYBOX_CONFIG_ASH
	help
	  Enable command editing in shell.

config BUSYBOX_CONFIG_FEATURE_COMMAND_EDITING_VI
	bool "vi-style line editing commands"
	default n
	depends on BUSYBOX_CONFIG_FEATURE_COMMAND_EDITING
	help
	  Enable vi-style line editing in the shell.  This mode can be
	  turned on and off with "set -o vi" and "set +o vi".

config BUSYBOX_CONFIG_FEATURE_COMMAND_HISTORY
	int "history size"
	default 15
	depends on BUSYBOX_CONFIG_FEATURE_COMMAND_EDITING
	help
	  Specify command history size in shell.

config BUSYBOX_CONFIG_FEATURE_COMMAND_SAVEHISTORY
	bool "history saving"
	default n
	depends on BUSYBOX_CONFIG_ASH && BUSYBOX_CONFIG_FEATURE_COMMAND_EDITING
	help
	  Enable history saving in ash shell.

config BUSYBOX_CONFIG_FEATURE_COMMAND_TAB_COMPLETION
	bool "tab completion"
	default y
	depends on BUSYBOX_CONFIG_FEATURE_COMMAND_EDITING
	help
	  Enable tab completion in shell.

config BUSYBOX_CONFIG_FEATURE_COMMAND_USERNAME_COMPLETION
	bool "username completion"
	default n
	depends on BUSYBOX_CONFIG_FEATURE_COMMAND_TAB_COMPLETION
	help
	  Enable username completion in shell.

config BUSYBOX_CONFIG_FEATURE_SH_FANCY_PROMPT
	bool "Fancy shell prompts"
	default y
	depends on BUSYBOX_CONFIG_FEATURE_COMMAND_EDITING
	help
	  Setting this option allows for prompts to use things like \w and
	  \$ and also using escape codes.

endmenu
```
