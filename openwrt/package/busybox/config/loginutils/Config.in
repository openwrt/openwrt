## openwrt/package/bwm/Config.in
```kconfig
config BR2_PACKAGE_BWM
	prompt "bwm............................... A very tiny BandWidth Monitor"
	tristate
	default m if CONFIG_DEVEL
	help
	 Continually displays data transfer rates (received, transmitted, and
	 total) for each interface, measured in KiB/sec. Works by sampling
	 values from /proc/net/dev and calculating deltas.
```

## openwrt/package/cbtt/Config.in
```kconfig
config BR2_PACKAGE_CBTT
	prompt "cbtt.............................. a C BitTorrent Tracker"
	tristate
	default m if CONFIG_DEVEL
	help
	 A C BitTorrent Tracker
	  
config BR2_PACKAGE_CBTT_MYSQL
	prompt "cbtt-mysql........................ a C BitTorrent Tracker (mysql)"
	tristate
	default m if CONFIG_DEVEL
	help
	 A C BitTorrent Tracker 
```

## openwrt/package/cifsmount/Config.in
```kconfig
config BR2_PACKAGE_CIFSMOUNT
	prompt "cifsmount......................... Helper utility for mounting remote CIFS shares"
	tristate
	default m if CONFIG_DEVEL
	help
	  An user space helper for mounting remote CIFS shares
```

## openwrt/package/clinkc/Config.in
```kconfig
config BR2_PACKAGE_CLINKC
	prompt "clinkc............................ Embedded UPnP library"
	tristate
	default m if CONFIG_DEVEL
	select BR2_PACKAGE_LIBEXPAT
	help
		CyberLink for C is a UPnP library using C for small and embedded platforms.

		http://sourceforge.net/projects/clinkc
```

## openwrt/package/config/Config.in
```kconfig
#

config BR2_PACKAGE_CONFIG
	bool"config"
	default n
	help
	  Add help text here.
```

## openwrt/package/ctorrent/Config.in
```kconfig
config BR2_PACKAGE_CTORRENT
	prompt "ctorrent.......................... console-based BitTorrent client"
	tristate
	default m if CONFIG_DEVEL
	help
	  CTorrent is a BitTorrent client written in the C programming language, known to 
	  be a very robust and mature programming language, which produces fast and 
	  optimized application.

	  http://www.rahul.net/dholmes/ctorrent/
```

## openwrt/package/cups/Config.in
```kconfig
config BR2_PACKAGE_CUPS
	prompt "cups.............................. Common UNIX Printing System"
	tristate
	default m if CONFIG_DEVEL
	help
	  A printer spooling system for devices with USB or LP support
	  
	  http://www.cups.org/
```

## openwrt/package/curl/Config.in
```kconfig
config BR2_COMPILE_CURL
	tristate
	default n
	depends BR2_PACKAGE_LIBCURL

config BR2_PACKAGE_LIBCURL
	prompt "libcurl........................... A client-side URL transfer library"
	tristate
	default m if CONFIG_DEVEL
	select BR2_COMPILE_CURL
	select BR2_PACKAGE_LIBOPENSSL
	select BR2_PACKAGE_ZLIB
	help
	  A client-side URL transfer library.
	  
	  http://curl.haxx.se/

config BR2_PACKAGE_CURL
	prompt   "curl............................ A client-side URL transfer tool"
	tristate
	default m if CONFIG_DEVEL
	depends BR2_PACKAGE_LIBCURL
	help
	  A client-side URL transfer tool.
	  
	  http://curl.haxx.se/
```

## openwrt/package/deco/Config.in
```kconfig
config BR2_PACKAGE_DECO
	prompt "deco.............................. Text-based full featured file manager"
	tristate
	default m if CONFIG_DEVEL
	select BR2_PACKAGE_LIBNCURSES
	help
	  A clone of Norton Commander for Unix. Text-based, full featured
	  file manager.
	  
	  http://deco.sourceforge.net/
```

## openwrt/package/dhcp-forwarder/Config.in
```kconfig
config BR2_PACKAGE_DHCP_FORWARDER
	tristate "dhcp-forwarder - DHCP relay agent"
	default m if CONFIG_DEVEL
	help
	  A DHCP relay agent
	  
	  http://www.nongnu.org/dhcp-fwd/
	  
```

## openwrt/package/dhcp/Config.in
```kconfig
config BR2_PACKAGE_DHCP
	tristate "dhcp"
	default m if CONFIG_DEVEL
	help
	dhcp server

	http://www.isc.org
```

## openwrt/package/dhcp6/Config.in
```kconfig
config BR2_PACKAGE_DHCP6
	prompt "dhcp6............................. IPv6 DHCP server and client"
	tristate
	default m if CONFIG_DEVEL
	select BR2_PACKAGE_LIBNCURSES
	help
		This is the first ever open source implementation of Dynamic Host Configuration Protocol for IPv6 (DHCPv6) server and client on Linux Operating System. The server provides leases (durations or lifetimes) on IPv6 addresses to the clients who request for it
```

## openwrt/package/dnsmasq/Config.in
```kconfig
config BR2_PACKAGE_DNSMASQ
	prompt "dnsmasq........................... Lightweight DNS and DHCP server"
	tristate
	default y
	help
	  A lightweight DNS and DHCP server.  It is intended to provide 
	  coupled DNS and DHCP service to a LAN.
	  
	  http://www.thekelleys.org.uk/dnsmasq/
```

## openwrt/package/dosfstools/Config.in
```kconfig
config BR2_PACKAGE_DOSFSTOOLS
	tristate "dosfstools - Utilities to create and check MS-DOS FAT filesystems"
	default m if CONFIG_DEVEL
	help
	  Utilities to create and check MS-DOS FAT filesystems.
	  
	  ftp://ftp.uni-erlangen.de:/pub/Linux/LOCAL/dosfstools/
	  
```

## openwrt/package/dropbear/Config.in
```kconfig
config BR2_PACKAGE_DROPBEAR
	prompt "dropbear.......................... Small SSH 2 client/server"
	tristate
	default y
	select BR2_PACKAGE_ZLIB
	help
	  A small SSH 2 server/client designed for small memory environments.
	  
	  http://matt.ucc.asn.au/dropbear/
```

## openwrt/package/dropbear_sshd/Config.in
```kconfig
config BR2_PACKAGE_DROPBEAR_SSHD
	bool "dropbear_sshd"
	default n
	help
	  A small SSH 2 server designed for small memory environments.

	  http://matt.ucc.asn.au/dropbear/
```

## openwrt/package/dsniff/Config.in
```kconfig
config BR2_PACKAGE_DSNIFF
	tristate "dsniff - network auditing and penetration testing"
	select BR2_PACKAGE_LIBPCAP
	select BR2_PACKAGE_LIBNIDS
	select BR2_PACKAGE_LIBNET
	select BR2_PACKAGE_LIBOPENSSL
	select BR2_PACKAGE_LIBGDBM
	default m if CONFIG_DEVEL
	help

	collection of tools for network auditing and penetration testing

	http://www.monkey.org/~dugsong/dsniff/
```

## openwrt/package/e2fsprogs/Config.in
```kconfig
config BR2_PACKAGE_E2FSPROGS
	prompt "e2fsprogs......................... Ext2/3 filesystem utilities"
	tristate
	default m if CONFIG_DEVEL
	help
	  This package contains essential ext2 filesystem utilities which consists of 
	  e2fsck, mke2fs, debugfs, dumpe2fs, tune2fs, and most of the other core ext2 
	  filesystem utilities.
	  
	  http://e2fsprogs.sourceforge.net/
```
