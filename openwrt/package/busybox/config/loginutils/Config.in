## openwrt/package/busybox/config/loginutils/Config.in
```kconfig
#
# For a description of the syntax of this configuration file,
# see scripts/kbuild/config-language.txt.
#

menu "Login/Password Management Utilities"

config BUSYBOX_CONFIG_FEATURE_SHADOWPASSWDS
	bool "Support for shadow passwords"
	default n
	help
	  Build support for shadow password in /etc/shadow.  This file is only
	  readable by root and thus the encrypted passwords are no longer
	  publicly readable.

config BUSYBOX_CONFIG_USE_BB_SHADOW
	bool #"  Use busybox shadow password functions"
	default n
	depends on BUSYBOX_CONFIG_USE_BB_PWD_GRP && BUSYBOX_CONFIG_FEATURE_SHADOWPASSWDS
	help
	    If you leave this disabled, busybox will use the system's shadow
	    password handling functions.  And if you are using the GNU C library
	    (glibc), you will then need to install the /etc/nsswitch.conf
	    configuration file and the required /lib/libnss_* libraries in
	    order for the shadow password functions to work.  This generally
	    makes your embedded system quite a bit larger.

	    Enabling this option will cause busybox to directly access the
	    system's /etc/shadow file when handling shadow passwords.  This
	    makes your system smaller and I will get fewer emails asking about
	    how glibc NSS works).  When this option is enabled, you will not be
	    able to use PAM to access shadow passwords from remote LDAP
	    password servers and whatnot.

config BUSYBOX_CONFIG_USE_BB_PWD_GRP
	bool "Use internal password and group functions rather than system functions"
	default n
	help
	    If you leave this disabled, busybox will use the system's password
	    and group functions.  And if you are using the GNU C library
	    (glibc), you will then need to install the /etc/nsswitch.conf
	    configuration file and the required /lib/libnss_* libraries in
	    order for the password and group functions to work.  This generally
	    makes your embedded system quite a bit larger.

	    Enabling this option will cause busybox to directly access the
	    system's /etc/password, /etc/group files (and your system will be
	    smaller, and I will get fewer emails asking about how glibc NSS
	    works).  When this option is enabled, you will not be able to use
	    PAM to access remote LDAP password servers and whatnot.  And if you
	    want hostname resolution to work with glibc, you still need the
	    /lib/libnss_* libraries.

	    If you enable this option, it will add about 1.5k to busybox.

config BUSYBOX_CONFIG_ADDGROUP
	bool "addgroup"
	default n
	help
	  Utility for creating a new group account.

config BUSYBOX_CONFIG_DELGROUP
	bool "delgroup"
	default n
	help
	  Utility for deleting a group account.

config BUSYBOX_CONFIG_ADDUSER
	bool "adduser"
	default n
	help
	  Utility for creating a new user account.

config BUSYBOX_CONFIG_DELUSER
	bool "deluser"
	default n
	help
	  Utility for deleting a user account.

config BUSYBOX_CONFIG_GETTY
	bool "getty"
	default n
	help
	  getty lets you log in on a tty, it is normally invoked by init.

config BUSYBOX_CONFIG_FEATURE_UTMP
	bool "  Support utmp file"
	depends on BUSYBOX_CONFIG_GETTY || BUSYBOX_CONFIG_LOGIN || BUSYBOX_CONFIG_SU || BUSYBOX_CONFIG_WHO
	default n
	help
	  The file /var/run/utmp is used to track who is currently logged in.

config BUSYBOX_CONFIG_FEATURE_WTMP
	bool "  Support wtmp file"
	depends on BUSYBOX_CONFIG_GETTY || BUSYBOX_CONFIG_LOGIN || BUSYBOX_CONFIG_SU || BUSYBOX_CONFIG_LAST
	default n
	select BUSYBOX_CONFIG_FEATURE_UTMP
	help
	  The file /var/run/wtmp is used to track when user's have logged into
	  and logged out of the system.

config BUSYBOX_CONFIG_LOGIN
	bool "login"
	default n
	select BUSYBOX_CONFIG_FEATURE_SUID
	help
	  login is used when signing onto a system.

	  Note that Busybox binary must be setuid root for this applet to
	  work properly.

config BUSYBOX_CONFIG_FEATURE_SECURETTY
	bool "  Support for /etc/securetty"
	default n
	depends on BUSYBOX_CONFIG_LOGIN
	help
	  The file  /etc/securetty  is used by (some versions of) login(1).
	  The file contains the device names of tty lines (one per line,
	  without leading /dev/) on which root is allowed to login.

config BUSYBOX_CONFIG_PASSWD
	bool "passwd"
	default y
	select BUSYBOX_CONFIG_FEATURE_SUID
	help
	  passwd changes passwords for user and group accounts.  A normal user
	  may only change the password for his/her own account, the super user
	  may change the password for any account.  The administrator of a group
	  may change the password for the group.

	  Note that Busybox binary must be setuid root for this applet to
	  work properly.

config BUSYBOX_CONFIG_SU
	bool "su"
	default n
	select BUSYBOX_CONFIG_FEATURE_SUID
	help
	  su is used to become another user during a login session.
	  Invoked without a username, su defaults to becoming the super user.

	  Note that Busybox binary must be setuid root for this applet to
	  work properly.

config BUSYBOX_CONFIG_SULOGIN
	bool "sulogin"
	default n
	help
	  sulogin is invoked when the system goes into single user
	  mode (this is done through an entry in inittab).

config BUSYBOX_CONFIG_VLOCK
	bool "vlock"
	default n
	select BUSYBOX_CONFIG_FEATURE_SUID
	help
	  Build the "vlock" applet which allows you to lock (virtual) terminals.

	  Note that Busybox binary must be setuid root for this applet to
	  work properly.

endmenu
```

## openwrt/package/busybox/config/miscutils/Config.in
```kconfig
#
# For a description of the syntax of this configuration file,
# see scripts/kbuild/config-language.txt.
#

menu "Miscellaneous Utilities"

config BUSYBOX_CONFIG_ADJTIMEX
	bool "adjtimex"
	default n
	help
	  Adjtimex reads and optionally sets adjustment parameters for
	  the Linux clock adjustment algorithm.

config BUSYBOX_CONFIG_CROND
	bool "crond"
	default y
	select BUSYBOX_CONFIG_FEATURE_SUID
	help
	  Crond is a background daemon that parses individual crontab
	  files and executes commands on behalf of the users in question.
	  This is a port of dcron from slackware.  It uses files of the
	  format /var/spool/cron/crontabs/<username> files, for example:
	      $ cat /var/spool/cron/crontabs/root
	      # Run daily cron jobs at 4:40 every day:
	      40 4 * * * /etc/cron/daily > /dev/null 2>&1
	  Note that Busybox binary must be setuid root for this applet to
	  work properly.

config BUSYBOX_CONFIG_FEATURE_CROND_CALL_SENDMAIL
	bool "  Using /usr/sbin/sendmail?"
	default n
	depends on BUSYBOX_CONFIG_CROND
	help
	  Support calling /usr/sbin/sendmail for send cmd outputs.

config BUSYBOX_CONFIG_CRONTAB
	bool "crontab"
	default y
	help
	  Crontab manipulates the crontab for a particular user.  Only
	  the superuser may specify a different user and/or crontab directory.

config BUSYBOX_CONFIG_DC
	bool "dc"
	default n
	help
	  Dc is a reverse-polish desk calculator which supports unlimited
	  precision arithmetic.

config BUSYBOX_CONFIG_DEVFSD
	bool "devfsd"
	default n
	help
	  Provides compatibility with old device names on a devfs systems.
	  You should set it to true if you have devfs enabled.
	  The following keywords in devsfd.conf are supported:
	  "CLEAR_CONFIG", "INCLUDE", "OPTIONAL_INCLUDE", "RESTORE",
	  "PERMISSIONS", "EXECUTE", "COPY", "IGNORE",
	  "MKOLDCOMPAT", "MKNEWCOMPAT","RMOLDCOMPAT", "RMNEWCOMPAT".

	   But only if they are written UPPERCASE!!!!!!!!

config BUSYBOX_CONFIG_DEVFSD_MODLOAD
	bool "Adds support for MODLOAD keyword in devsfd.conf"
	default n
	depends on BUSYBOX_CONFIG_DEVFSD
	help
	  This actually doesn't work with busybox  modutils but needs the real modutils.

config BUSYBOX_CONFIG_DEVFSD_FG_NP
	bool "Enables the -fg and -np options"
	default n
	depends on BUSYBOX_CONFIG_DEVFSD
	help
		-fg	Run the daemon in the foreground.
		-np	Exit  after  parsing  the configuration file. Do not poll for events.

config BUSYBOX_CONFIG_DEVFSD_VERBOSE
	bool "Increases logging (and size)"
	default n
	depends on BUSYBOX_CONFIG_DEVFSD
	help
	  Increases logging to stderr or syslog.

config BUSYBOX_CONFIG_LAST
	bool "last"
	default n
	select BUSYBOX_CONFIG_FEATURE_U_W_TMP
	help
	  'last' displays a list of the last users that logged into the system.

config BUSYBOX_CONFIG_HDPARM
	bool "hdparm"
	default n
	help
	  Get/Set hard drive parameters.  Primarily intended for ATA
	  drives.  Adds about 13k (or around 30k if you enable the
	  BUSYBOX_CONFIG_FEATURE_HDPARM_GET_IDENTITY option)....

config BUSYBOX_CONFIG_FEATURE_HDPARM_GET_IDENTITY
	bool "  Support obtaining detailed information directly from drives"
	default n
	depends on BUSYBOX_CONFIG_HDPARM
	help
	  Enables the -I and -Istdin options to obtain detailed information
	  directly from drives about their capabilities and supported ATA
	  feature set.  Enabling this option will add about 16k...

config BUSYBOX_CONFIG_FEATURE_HDPARM_HDIO_SCAN_HWIF
	bool "  Register an IDE interface (DANGEROUS)"
	default n
	depends on BUSYBOX_CONFIG_HDPARM
	help
	  Enables the 'hdparm -R' option to register an IDE interface.
	  This is dangerous stuff, so you should probably say N.

config BUSYBOX_CONFIG_FEATURE_HDPARM_HDIO_UNREGISTER_HWIF
	bool "  Un-register an IDE interface (DANGEROUS)"
	default n
	depends on BUSYBOX_CONFIG_HDPARM
	help
	  Enables the 'hdparm -U' option to un-register an IDE interface.
	  This is dangerous stuff, so you should probably say N.

config BUSYBOX_CONFIG_FEATURE_HDPARM_HDIO_DRIVE_RESET
	bool "  perform device reset (DANGEROUS)"
	default n
	depends on BUSYBOX_CONFIG_HDPARM
	help
	  Enables the 'hdparm -w' option to perform a device reset.
	  This is dangerous stuff, so you should probably say N.

config BUSYBOX_CONFIG_FEATURE_HDPARM_HDIO_TRISTATE_HWIF
	bool "  tristate device for hotswap (DANGEROUS)"
	default n
	depends on BUSYBOX_CONFIG_HDPARM
	help
	  Enables the 'hdparm -x' option to tristate device for hotswap,
	  and the '-b' option to get/set bus state.  This is dangerous
	  stuff, so you should probably say N.

config BUSYBOX_CONFIG_FEATURE_HDPARM_HDIO_GETSET_DMA
	bool "  get/set using_dma flag (DANGEROUS)"
	default n
	depends on BUSYBOX_CONFIG_HDPARM
	help
	  Enables the 'hdparm -d' option to get/set using_dma flag.
	  This is dangerous stuff, so you should probably say N.

config BUSYBOX_CONFIG_MAKEDEVS
	bool "makedevs"
	default n
	help
	  'makedevs' is a utility used and created by the Linux Router Project.
	  It creates a large number of device special files (/dev devices)
	  rather quickly, and can be considerably faster then running mknod a
	  zillion times.

config BUSYBOX_CONFIG_MT
	bool "mt"
	default n
	help
	  mt is used to control tape devices.  You can use the mt utility
	  to advance or rewind a tape past a specified number of archive
	  files on the tape.

config BUSYBOX_CONFIG_RX
        bool "rx"
	default n
	help
 	  Receive files using the Xmodem protocol.

config BUSYBOX_CONFIG_STRINGS
	bool "strings"
	default y
	help
	  strings prints the printable character sequences for each file
	  specified.

config BUSYBOX_CONFIG_TIME
	bool "time"
	default y
	help
	  The time command runs the specified program with the given arguments.
	  When the command finishes, time writes a message to standard output
	  giving timing statistics about this program run.

config BUSYBOX_CONFIG_WATCHDOG
	bool "watchdog"
	default y
	help
	  The watchdog utility is used with hardware or software watchdog
	  device drivers.  It opens the specified watchdog device special file
	  and periodically writes a magic character to the device.  If the
	  watchdog applet ever fails to write the magic character within a
	  certain amount of time, the watchdog device assumes the system has
	  hung, and will cause the hardware to reboot.

endmenu
```

## openwrt/package/busybox/config/modutils/Config.in
```kconfig
#
# For a description of the syntax of this configuration file,
# see scripts/kbuild/config-language.txt.
#

menu "Linux Module Utilities"

config BUSYBOX_CONFIG_INSMOD
	bool "insmod"
	default y
	help
	  insmod is used to load specified modules in the running kernel.

config BUSYBOX_CONFIG_FEATURE_2_4_MODULES
	bool "  Support version 2.2.x to 2.4.x Linux kernels"
	default y
	depends on BUSYBOX_CONFIG_INSMOD
	help
	  Support module loading for 2.2.x and 2.4.x Linux kernels.

config BUSYBOX_CONFIG_FEATURE_2_6_MODULES
	bool "  Support version 2.6.x Linux kernels"
	default n
	depends on BUSYBOX_CONFIG_INSMOD
	help
	  Support module loading for newer 2.6.x Linux kernels.

config BUSYBOX_CONFIG_FEATURE_INSMOD_VERSION_CHECKING
	bool "  Module version checking"
	default n
	depends on BUSYBOX_CONFIG_INSMOD && BUSYBOX_CONFIG_FEATURE_2_4_MODULES
	help
	  Support checking of versions for modules.  This is used to
	  ensure that the kernel and module are made for each other.

config BUSYBOX_CONFIG_FEATURE_INSMOD_KSYMOOPS_SYMBOLS
	bool "  Add module symbols to kernel symbol table"
	default n
	depends on BUSYBOX_CONFIG_INSMOD && BUSYBOX_CONFIG_FEATURE_2_4_MODULES
	help
	  By adding module symbols to the kernel symbol table, Oops messages
	  occuring within kernel modules can be properly debugged.  By enabling
	  this feature, module symbols will always be added to the kernel symbol
	  table for properly debugging support.  If you are not interested in
	  Oops messages from kernel modules, say N.

config BUSYBOX_CONFIG_FEATURE_INSMOD_LOADINKMEM
	bool "  In kernel memory optimization (uClinux only)"
	default n
	depends on BUSYBOX_CONFIG_INSMOD && BUSYBOX_CONFIG_FEATURE_2_4_MODULES
	help
	  This is a special uClinux only memory optimization that lets insmod
	  load the specified kernel module directly into kernel space, reducing
	  memory usage by preventing the need for two copies of the module
	  being loaded into memory.

config BUSYBOX_CONFIG_FEATURE_INSMOD_LOAD_MAP
	bool "  Enable load map (-m) option"
	default n
	depends on BUSYBOX_CONFIG_INSMOD && BUSYBOX_CONFIG_FEATURE_2_4_MODULES
	help
	  Enabling this, one would be able to get a load map
	  output on stdout. This makes kernel module debugging
	  easier.
	  If you don't plan to debug kernel modules, you
	  don't need this option.

config BUSYBOX_CONFIG_FEATURE_INSMOD_LOAD_MAP_FULL
	bool "  Symbols in load map"
	default n
	depends on BUSYBOX_CONFIG_FEATURE_INSMOD_LOAD_MAP
	help
	  Without this option, -m will only output section
	  load map.  With this option, -m will also output
	  symbols load map.

config BUSYBOX_CONFIG_LSMOD
	bool "lsmod"
	default y
	help
	  lsmod is used to display a list of loaded modules.

config BUSYBOX_CONFIG_FEATURE_QUERY_MODULE_INTERFACE
	bool
	default y
	depends on BUSYBOX_CONFIG_FEATURE_2_4_MODULES && !CONFIG_FEATURE_2_6_MODULES

config BUSYBOX_CONFIG_MODPROBE
	bool "modprobe"
	default n
	help
	  Handle the loading of modules, and their dependancies on a high
	  level.

config BUSYBOX_CONFIG_RMMOD
	bool "rmmod"
	default y
	help
	  rmmod is used to unload specified modules from the kernel.

config BUSYBOX_CONFIG_FEATURE_CHECK_TAINTED_MODULE
	bool "Support tainted module checking with new kernels"
	default n
	depends on BUSYBOX_CONFIG_INSMOD || BUSYBOX_CONFIG_LSMOD
	help
	  Support checking for tainted modules.  These are usually binary
	  only modules that will make the linux-kernel list ignore your
	  support request.
	  This option is required to support GPLONLY modules.


endmenu
```
