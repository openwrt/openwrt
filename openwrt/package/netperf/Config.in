## openwrt/package/netperf/Config.in
```kconfig
config BR2_PACKAGE_NETPERF
	prompt "netperf........................... network performance measurement tool"
	tristate
	default m if CONFIG_DEVEL
	help
	  Program and service to do network performance measurement.
```

## openwrt/package/nfs-server/Config.in
```kconfig
config BR2_PACKAGE_NFS_SERVER
	tristate "nfs-server - User Space NFS server"
	default m if CONFIG_DEVEL
	select BR2_PACKAGE_PORTMAP
	help
	  User Space NFS Server
```

## openwrt/package/nmap/Config.in
```kconfig
config BR2_PACKAGE_NMAP
	tristate "nmap - Network exploration and/or security auditing utility"
	default m if CONFIG_DEVEL
	select BR2_PACKAGE_LIBPCAP
	select BR2_PACKAGE_LIBPCRE
	select BR2_PACKAGE_UCLIBCXX
	help
	  A free open source utility for network exploration or security auditing. 
	  
	  http://www.insecure.org/nmap/
	  
```

## openwrt/package/ntpclient/Config.in
```kconfig
config BR2_PACKAGE_NTPCLIENT
	prompt "ntpclient......................... NTP (Network Time Protocol) client"
	tristate
	default m if CONFIG_DEVEL
	help
	  NTP client for setting system time from NTP servers.
	  
	  http://doolittle.faludi.com/ntpclient/
```

## openwrt/package/nvram/Config.in
```kconfig
config BR2_PACKAGE_NVRAM
	prompt "nvram............................. Broadcom config utility"
	tristate
	default y 
	depends BR2_LINUX_2_4_BRCM
	help
	  control utility for broadcom's 'nvram' config area
```

## openwrt/package/olsrd/Config.in
```kconfig
config BR2_PACKAGE_OLSRD
	tristate "olsrd - OLSR (Optimized Link State Routing) daemon"
	default m if CONFIG_DEVEL
	help
	  The Optimized Link State Routing daemon
	  
	  http://www.olsr.org/
	  

config BR2_PACKAGE_OLSRD_MOD_DOT_DRAW
	depends BR2_PACKAGE_OLSRD
	prompt "mod-dot-draw - Dot topology information plugin"
	tristate
	default m if CONFIG_DEVEL

config BR2_PACKAGE_OLSRD_MOD_DYN_GW
	depends BR2_PACKAGE_OLSRD
	prompt "mod-dyn-gw - Dynamic internet gateway plugin"
	tristate
	default m if CONFIG_DEVEL

config BR2_PACKAGE_OLSRD_MOD_HTTPINFO
	depends BR2_PACKAGE_OLSRD
	prompt "mod-httpinfo - Small informative web server plugin"
	tristate
	default m if CONFIG_DEVEL

config BR2_PACKAGE_OLSRD_MOD_NAMESERVICE
	depends BR2_PACKAGE_OLSRD
	prompt "mod-nameservice - Lightweight hostname resolver plugin"
	tristate
	default m if CONFIG_DEVEL

config BR2_PACKAGE_OLSRD_MOD_POWER
	depends BR2_PACKAGE_OLSRD
	prompt "mod-power - Power status plugin"
	tristate
	default m if CONFIG_DEVEL

config BR2_PACKAGE_OLSRD_MOD_SECURE
	depends BR2_PACKAGE_OLSRD
	prompt "mod-secure - Message signing plugin to secure olsrd routing domain"
	tristate
	default m if CONFIG_DEVEL
```

## openwrt/package/opencdk/Config.in
```kconfig
config BR2_PACKAGE_OPENCDK
	tristate
	default n
	depends BR2_PACKAGE_LIBOPENCDK

config BR2_PACKAGE_LIBOPENCDK
	prompt "libopencdk........................ The Open Crypto Development Kit library"
	tristate
#	default m if CONFIG_DEVEL
	default n
	select BR2_PACKAGE_OPENCDK
	select BR2_PACKAGE_LIBGCRYPT
	help
	  This library provides basic parts of the OpenPGP message format.
	  For reference, please read the rfc2440.txt in the doc/ directory.
	  Due to some possible security problems, the library also implements
	  parts of draft-ietf-openpgp-rfc2440bis-08.txt. If you want to exchange
	  messages with earlier PGP version < 7, you should use the compat mode.
	  
	  ftp://ftp.gnutls.org/pub/gnutls/opencdk/
```

## openwrt/package/openh323/Config.in
```kconfig
config BR2_COMPILE_OPENH323
#	prompt "openh323.......................... OpenH323 implementation"
	tristate
	select BR2_COMPILE_PWLIB
	default n
	help
```

## openwrt/package/openldap/Config.in
```kconfig
config BR2_COMPILE_OPENLDAP
	tristate
	default n
	depends BR2_PACKAGE_LIBOPENLDAP

config BR2_PACKAGE_LIBOPENLDAP
	prompt "libopenldap....................... Open source LDAP (Lightweight Directory Access Protocol) client libraries"
	tristate
	default m if CONFIG_DEVEL
	select BR2_COMPILE_OPENLDAP
	help
	  
	  OpenLDAP Software is an open source implementation of the 
	  Lightweight Directory Access Protocol (LDAP).
	  
	  http://www.openldap.org/
	  
	  This package contains the shared LDAP client libraries, needed by other programs.

config BR2_PACKAGE_OPENLDAP_UTILS
	prompt   "openldap-utils.................. OpenLDAP client utilities"
	tristate
	default m if CONFIG_DEVEL
	depends BR2_PACKAGE_LIBOPENLDAP
	help
	  
	  OpenLDAP Software is an open source implementation of the 
	  Lightweight Directory Access Protocol (LDAP).
	  
	  http://www.openldap.org/
	  
	  This package contains client programs required to access LDAP servers.
```

## openwrt/package/openntpd/Config.in
```kconfig
config BR2_PACKAGE_OPENNTPD
	prompt "openntpd.......................... A free and easy to use NTP (Network Time Protocol) implementation"
	tristate
	default m if CONFIG_DEVEL
	help
	  NTP server
	  
	  http://www.openntpd.org/
```

## openwrt/package/openser/Config.in
```kconfig
menu "openser........................... Configurable, free SIP server"

config BR2_PACKAGE_OPENSER
	prompt "openser........................... Configurable, free SIP server"
	tristate
	default m if CONFIG_DEVEL
	help
	 Open SIP Express Router (OpenSER) is a high-performance,
	 configurable, free SIP server.

config BR2_PACKAGE_OPENSER_MOD_AUTH
	prompt   "openser-mod-auth................ Authentication support"
	tristate
	default m if CONFIG_DEVEL
	depends BR2_PACKAGE_OPENSER
	help
	  Enable authentication support

config BR2_PACKAGE_OPENSER_MOD_AUTH_DB
	prompt     "openser-mod-auth-db........... Authentication with database support"
	tristate
	default m if CONFIG_DEVEL
	depends BR2_PACKAGE_OPENSER_MOD_AUTH
	help
	  Enable authentication with database support

config BR2_PACKAGE_OPENSER_MOD_AUTH_RADIUS
	prompt     "openser-mod-auth-radius....... Authentication with RADIUS support"
	tristate
	default m if CONFIG_DEVEL
	depends BR2_PACKAGE_OPENSER_MOD_AUTH
	select BR2_PACKAGE_LIBRADIUSCLIENT_NG
	help
	  Authentication against RADIUS

config BR2_PACKAGE_OPENSER_MOD_AVP_RADIUS
	prompt   "openser-mod-avp-radius.......... AVP with RADIUS support"
	tristate
	default m if CONFIG_DEVEL
	depends BR2_PACKAGE_OPENSER
	select BR2_PACKAGE_LIBRADIUSCLIENT_NG
	help
	  Enable AVP with RADIUS support

config BR2_PACKAGE_OPENSER_MOD_AVPOPS
	prompt   "openser-mod-avpops.............. AVP options support"
	tristate
	default m if CONFIG_DEVEL
	depends BR2_PACKAGE_OPENSER
	help
	  Enable AVP options support

config BR2_PACKAGE_OPENSER_MOD_DISPATCHER
	prompt   "openser-mod-dispatcher.......... dispatcher support"
	tristate
	default m if CONFIG_DEVEL
	depends BR2_PACKAGE_OPENSER
	help
	  Enable dispatcher options support

config BR2_PACKAGE_OPENSER_MOD_DIVERSION
	prompt   "openser-mod-diversion........... diversion support"
	tristate
	default m if CONFIG_DEVEL
	depends BR2_PACKAGE_OPENSER
	help
	  Enable diversion options support

config BR2_PACKAGE_OPENSER_MOD_FLATSTORE
	prompt   "openser-mod-flatstore........... flatstore support"
	tristate
	default m if CONFIG_DEVEL
	depends BR2_PACKAGE_OPENSER
	help
	  Enable flatstore support

config BR2_PACKAGE_OPENSER_MOD_GFLAGS
	prompt   "openser-mod-gflags.............. gflags support"
	tristate
	default m if CONFIG_DEVEL
	depends BR2_PACKAGE_OPENSER
	help
	  Enable GFlags support

config BR2_PACKAGE_OPENSER_MOD_GROUP
	prompt   "openser-mod-group............... group support"
	tristate
	default m if CONFIG_DEVEL
	depends BR2_PACKAGE_OPENSER
	help
	  Enable group support

config BR2_PACKAGE_OPENSER_MOD_GROUP_RADIUS
	prompt   "openser-mod-group-radius........ group with RADIUS support"
	tristate
	default m if CONFIG_DEVEL
	depends BR2_PACKAGE_OPENSER
	help
	  Enable group with RADIUS support

config BR2_PACKAGE_OPENSER_MOD_LCR
	prompt   "openser-mod-lcr................. Least Cost Routing support"
	tristate
	default m if CONFIG_DEVEL
	depends BR2_PACKAGE_OPENSER
	select BR2_PACKAGE_OPENSER_MOD_MYSQL
	help
	  Enable Least Cost Routing support

config BR2_PACKAGE_OPENSER_MOD_MEDIAPROXY
	prompt   "openser-mod-mediaproxy.......... Mediaproxy support"
	tristate
	default m if CONFIG_DEVEL
	depends BR2_PACKAGE_OPENSER
	help
	  Enable mediaproxy support

config BR2_PACKAGE_OPENSER_MOD_MSILO
	prompt   "openser-mod-msilo............... MSilo support"
	tristate
	default m if CONFIG_DEVEL
	depends BR2_PACKAGE_OPENSER
	help
	  Enable msilo support

config BR2_PACKAGE_OPENSER_MOD_MYSQL
	prompt   "openser-mod-mysql............... MySQL support"
	tristate
	default m if CONFIG_DEVEL
	depends BR2_PACKAGE_OPENSER
	select BR2_PACKAGE_LIBMYSQLCLIENT
	help
	  Enable MySQL support

config BR2_PACKAGE_OPENSER_MOD_NATHELPER
	prompt   "openser-mod-nathelper........... NAT helper support"
	tristate
	default m if CONFIG_DEVEL
	depends BR2_PACKAGE_OPENSER
	help
	  NAT helper support

config BR2_PACKAGE_OPENSER_MOD_OPTIONS
	prompt   "openser-mod-options............. options support"
	tristate
	default m if CONFIG_DEVEL
	depends BR2_PACKAGE_OPENSER
	help
	  Enable options support

config BR2_PACKAGE_OPENSER_MOD_PDT
	prompt   "openser-mod-pdt................. PDT support"
	tristate
	default m if CONFIG_DEVEL
	depends BR2_PACKAGE_OPENSER
	help
	  Enable pdt support

config BR2_PACKAGE_OPENSER_MOD_PERMISSIONS
	prompt   "openser-mod-permissions......... Permissions support"
	tristate
	default m if CONFIG_DEVEL
	depends BR2_PACKAGE_OPENSER
	help
	  Enable permissions support

config BR2_PACKAGE_OPENSER_MOD_PIKE
	prompt   "openser-mod-pike................ PIKE support"
	tristate
	default m if CONFIG_DEVEL
	depends BR2_PACKAGE_OPENSER
	help
	  Enable pike support

config BR2_PACKAGE_OPENSER_MOD_SMS
	prompt   "openser-mod-sms................. SMS support"
	tristate
	default m if CONFIG_DEVEL
	depends BR2_PACKAGE_OPENSER
	help
	  SMS support

config BR2_PACKAGE_OPENSER_MOD_SPEEDDIAL
	prompt   "openser-mod-speeddial........... Speed Dial support"
	tristate
	default m if CONFIG_DEVEL
	depends BR2_PACKAGE_OPENSER
	help
	  Speed Dial support

config BR2_PACKAGE_OPENSER_MOD_UAC
	prompt   "openser-mod-uac................. UAC support"
	tristate
	default m if CONFIG_DEVEL
	depends BR2_PACKAGE_OPENSER
	help
	  Enable UAC support

config BR2_PACKAGE_OPENSER_MOD_UAC_REDIRECT
	prompt   "openser-mod-uac................. UAC redirect support"
	tristate
	default m if CONFIG_DEVEL
	depends BR2_PACKAGE_OPENSER
	help
	  Enable UAC redirect support

config BR2_PACKAGE_OPENSER_MOD_URI
	prompt   "openser-mod-uri................. URI support"
	tristate
	default m if CONFIG_DEVEL
	depends BR2_PACKAGE_OPENSER
	help
	  Enable URI support

config BR2_PACKAGE_OPENSER_MOD_URI_DB
	prompt   "openser-mod-uri-db.............. URI database support"
	tristate
	default m if CONFIG_DEVEL
	depends BR2_PACKAGE_OPENSER
	help
	  Enable URI database support

config BR2_PACKAGE_OPENSER_MOD_URI_RADIUS
	prompt   "openser-mod-uri-radius.......... URI with RADIUS support"
	tristate
	default m if CONFIG_DEVEL
	depends BR2_PACKAGE_OPENSER
	help
	  Enable URI with RADIUS support

config BR2_PACKAGE_OPENSER_MOD_XLOG
	prompt   "openser-mod-xlog................ Logging support"
	tristate
	default m if CONFIG_DEVEL
	depends BR2_PACKAGE_OPENSER
	help
	  Logging support

endmenu
```

## openwrt/package/openssh/Config.in
```kconfig
menu "openssh........................... A free implementation of the Secure Shell protocol"

config BR2_COMPILE_OPENSSH
	tristate
	default n
	depends BR2_PACKAGE_OPENSSH_CLIENT || BR2_PACKAGE_OPENSSH_SERVER || BR2_PACKAGE_OPENSSH_SFTP_CLIENT || BR2_PACKAGE_OPENSSH_SFTP_SERVER

config BR2_PACKAGE_OPENSSH_CLIENT
	prompt "openssh-client.................... OpenSSH client"
	tristate
	default m if CONFIG_DEVEL
	select BR2_COMPILE_OPENSSH
	select BR2_PACKAGE_LIBOPENSSL
	select BR2_PACKAGE_ZLIB
	help
	  OpenSSH is a FREE version of the SSH protocol suite of network 
	  connectivity tools that increasing numbers of people on the Internet 
	  are coming to rely on. Many users of telnet, rlogin, ftp, and other 
	  such programs might not realize that their password is transmitted 
	  across the Internet unencrypted, but it is. OpenSSH encrypts all 
	  traffic (including passwords) to effectively eliminate eavesdropping, 
	  connection hijacking, and other network-level attacks. Additionally, 
	  OpenSSH provides a myriad of secure tunneling capabilities, as well 
	  as a variety of authentication methods.
	  
	  http://www.openssh.com/
	  
	  Depends: openssl

config BR2_PACKAGE_OPENSSH_CLIENT_UTILS
	prompt   "openssh-client-utils............ OpenSSH client utilities"
	tristate
	default m if CONFIG_DEVEL
	depends BR2_PACKAGE_OPENSSH_CLIENT
	help
	  OpenSSH is a FREE version of the SSH protocol suite of network 
	  connectivity tools that increasing numbers of people on the Internet 
	  are coming to rely on. Many users of telnet, rlogin, ftp, and other 
	  such programs might not realize that their password is transmitted 
	  across the Internet unencrypted, but it is. OpenSSH encrypts all 
	  traffic (including passwords) to effectively eliminate eavesdropping, 
	  connection hijacking, and other network-level attacks. Additionally, 
	  OpenSSH provides a myriad of secure tunneling capabilities, as well 
	  as a variety of authentication methods.
	  
	  http://www.openssh.com/
	  
	  Depends: openssl

config BR2_PACKAGE_OPENSSH_SERVER
	prompt "openssh-server.................... OpenSSH server"
	tristate
	default m if CONFIG_DEVEL
	select BR2_COMPILE_OPENSSH
	select BR2_PACKAGE_LIBOPENSSL
	select BR2_PACKAGE_ZLIB
	help
	  OpenSSH is a FREE version of the SSH protocol suite of network 
	  connectivity tools that increasing numbers of people on the Internet 
	  are coming to rely on. Many users of telnet, rlogin, ftp, and other 
	  such programs might not realize that their password is transmitted 
	  across the Internet unencrypted, but it is. OpenSSH encrypts all 
	  traffic (including passwords) to effectively eliminate eavesdropping, 
	  connection hijacking, and other network-level attacks. Additionally, 
	  OpenSSH provides a myriad of secure tunneling capabilities, as well 
	  as a variety of authentication methods.
	  
	  http://www.openssh.com/
	  
	  Depends: openssl

config BR2_PACKAGE_OPENSSH_SFTP_CLIENT
	prompt "openssh-sftp-client............... OpenSSH SFTP client"
	tristate
	default m if CONFIG_DEVEL
	select BR2_COMPILE_OPENSSH
	select BR2_PACKAGE_LIBOPENSSL
	select BR2_PACKAGE_ZLIB
	help
	  OpenSSH is a FREE version of the SSH protocol suite of network 
	  connectivity tools that increasing numbers of people on the Internet 
	  are coming to rely on. Many users of telnet, rlogin, ftp, and other 
	  such programs might not realize that their password is transmitted 
	  across the Internet unencrypted, but it is. OpenSSH encrypts all 
	  traffic (including passwords) to effectively eliminate eavesdropping, 
	  connection hijacking, and other network-level attacks. Additionally, 
	  OpenSSH provides a myriad of secure tunneling capabilities, as well 
	  as a variety of authentication methods.
	  
	  http://www.openssh.com/
	  
	  Depends: openssl


config BR2_PACKAGE_OPENSSH_SFTP_SERVER
	prompt "openssh-sftp-server............... OpenSSH SFTP server"
	tristate
	default m if CONFIG_DEVEL
	select BR2_COMPILE_OPENSSH
	select BR2_PACKAGE_LIBOPENSSL
	select BR2_PACKAGE_ZLIB
	help
	  OpenSSH is a FREE version of the SSH protocol suite of network 
	  connectivity tools that increasing numbers of people on the Internet 
	  are coming to rely on. Many users of telnet, rlogin, ftp, and other 
	  such programs might not realize that their password is transmitted 
	  across the Internet unencrypted, but it is. OpenSSH encrypts all 
	  traffic (including passwords) to effectively eliminate eavesdropping, 
	  connection hijacking, and other network-level attacks. Additionally, 
	  OpenSSH provides a myriad of secure tunneling capabilities, as well 
	  as a variety of authentication methods.
	  
	  http://www.openssh.com/
	  
	  Depends: openssl

endmenu
```
