## openwrt/package/openssl/Config.in
```kconfig
config BR2_COMPILE_OPENSSL
	tristate
	default n
	depends BR2_PACKAGE_LIBOPENSSL
	
config BR2_PACKAGE_LIBOPENSSL
	prompt "libopenssl........................ Open source SSL (Secure Socket Layer) libraries"
	tristate
	default m if CONFIG_DEVEL
	select BR2_COMPILE_OPENSSL
	help
	  The OpenSSL Project is a collaborative effort to develop a robust, 
	  commercial-grade, full-featured, and Open Source toolkit implementing 
	  the Secure Sockets Layer (SSL v2/v3) and Transport Layer Security (TLS v1) 
	  protocols as well as a full-strength general purpose cryptography library.
	  
	  http://www.openssl.org/
	  
	  This package contains the shared SSL libraries, needed by other programs.

config BR2_PACKAGE_OPENSSL_UTIL
	prompt   "openssl-util.................... OpenSSL command line tool"
	tristate
	default m if CONFIG_DEVEL
	depends BR2_PACKAGE_LIBOPENSSL
	help
	  The OpenSSL Project is a collaborative effort to develop a robust, 
	  commercial-grade, full-featured, and Open Source toolkit implementing 
	  the Secure Sockets Layer (SSL v2/v3) and Transport Layer Security (TLS v1) 
	  protocols as well as a full-strength general purpose cryptography library.
	  
	  http://www.openssl.org/
	  
	  This package contains the multi-purpose OpenSSL binary tool.
```

## openwrt/package/openswan/Config.in
```kconfig
config BR2_PACKAGE_OPENSWAN
	prompt "openswan.......................... VPN solution using IPsec"
	tristate
	default m if CONFIG_DEVEL
	select BR2_PACKAGE_IP
	select BR2_PACKAGE_LIBGMP
	select BR2_PACKAGE_KMOD_OPENSWAN
	help
	  Openswan is an implementation of IPsec for Linux.
	  
	  http://www.openswan.org/
```

## openwrt/package/openvpn/Config.in
```kconfig
menu "openvpn........................... Open source VPN solution using SSL"

config BR2_PACKAGE_OPENVPN
	prompt "openvpn........................... Open source VPN solution using SSL"
	tristate
	default m if CONFIG_DEVEL
	select BR2_PACKAGE_KMOD_TUN
	help
	  Open Source VPN solution using SSL
	  
	  http://openvpn.net/
	  
	  Depends: kmod-tun, libpthread

config BR2_PACKAGE_OPENVPN_EASY_RSA
	prompt "openvpn-easy-rsa................ simple shell scripts to manage a Certificate Authority"
	tristate
	default m if CONFIG_DEVEL
	select BR2_PACKAGE_OPENSSL_UTIL
	depends on BR2_PACKAGE_OPENVPN
	help
	  collection of shell scripts to manage a simple CA infrastructure

	  Depends: openpvn, openssl-util

config BR2_COMPILE_OPENVPN_WITH_SERVER
	prompt "Enable server support"
	bool
	default y
	depends BR2_PACKAGE_OPENVPN

config BR2_COMPILE_OPENVPN_WITH_HTTP
	prompt "Enable http proxy support"
	bool
	default y
	depends BR2_PACKAGE_OPENVPN

config BR2_COMPILE_OPENVPN_WITH_OPENSSL
	prompt "Enable openssl support"
	bool
	default y
	depends BR2_PACKAGE_OPENVPN
	select BR2_PACKAGE_LIBOPENSSL

config BR2_COMPILE_OPENVPN_WITH_LZO
	prompt "Enable transparent compression (lzo)"
	bool
	default y
	depends BR2_PACKAGE_OPENVPN
	select BR2_PACKAGE_LIBLZO

config BR2_COMPILE_OPENVPN_WITH_PASSWORD_SAVE
	prompt "Enable password saving"
	bool
	default y
	depends BR2_PACKAGE_OPENVPN

config BR2_COMPILE_OPENVPN_WITH_SMALL
	prompt "Enable smaller executable size (disable OCC, usage message, and verb 4 parm list)"
	bool
	default n
	depends BR2_PACKAGE_OPENVPN

endmenu
```

## openwrt/package/osiris/Config.in
```kconfig
config BR2_COMPILE_OSIRIS
	tristate
	default n
	depends BR2_PACKAGE_OSIRISD

config BR2_PACKAGE_OSIRISD
	prompt "osirisd........................... Host integrity monitoring system (scanning agent)"
	tristate
	default m if CONFIG_DEVEL
	select BR2_COMPILE_OSIRIS
	select BR2_PACKAGE_LIBOPENSSL
	help
	  An host integrity monitoring system (scanning agent)
	  
	  http://www.hostintegrity.com/osiris/
	  
	  Depends: openssl
```

## openwrt/package/palantir/Config.in
```kconfig
config BR2_PACKAGE_PALANTIR
	tristate "palantir - a multichannel interactive streaming solution"
	default m if CONFIG_DEVEL
	select BR2_PACKAGE_LIBJPEG
	help
	  Palantir is a Linux-based streaming system designed to transmit live 
	  video, audio and data over a TCP/IP network, as well as to control 
	  remote devices.
	  
	  http://www.fastpath.it/products/palantir/
	  
```

## openwrt/package/parprouted/Config.in
```kconfig
config BR2_PACKAGE_PARPROUTED
	prompt "parprouted........................ Proxy ARP daemon"
	tristate
	default m if CONFIG_DEVEL
	help
	  parprouted is a daemon for transparent IP (Layer 3) proxy ARP bridging.
	  This is useful for creation of transparent firewalls and bridging networks 
	  with different MAC protocols. Also, unlike standard bridging, proxy ARP 
	  bridging allows to bridge Ethernet networks behind wireless nodes without 
	  using WDS or layer 2 bridging.
	  
	  http://www.hazard.maks.net/
```

## openwrt/package/pcmcia-cs/Config.in
```kconfig
config BR2_COMPILE_PCMCIA_CS
	tristate
	default n
	depends BR2_PACKAGE_PCMCIA_UTILS

config BR2_PACKAGE_PCMCIA_UTILS
	prompt "pcmcia-utils...................... PCMCIA/Cardbus management utilities"
	tristate
	depends BR2_LINUX_PCMCIA_SUPPORT
	select BR2_COMPILE_PCMCIA_CS
	select BR2_PACKAGE_KMOD_PCMCIA_CORE
	default m if CONFIG_DEVEL
	help
	  PCMCIA/Cardbus management utilities
	  
	  http://pcmcia-cs.sourceforge.net/
```

## openwrt/package/pcre/Config.in
```kconfig
config BR2_PACKAGE_LIBPCRE
	tristate "libpcre - a Perl Compatible Regular Expression library"
	default m if CONFIG_DEVEL
	help
	  A Perl Compatible Regular Expression library
	  
	  http://www.pcre.org/
	  

config BR2_PACKAGE_PCRE
	tristate
	default BR2_PACKAGE_LIBPCRE
```

## openwrt/package/php4/Config.in
```kconfig
menu "php4 - PHP4 Hypertext preprocessor"

config BR2_COMPILE_PHP4
	bool
	default n
	depends BR2_PACKAGE_PHP4_CLI || BR2_PACKAGE_PHP4_CGI || BR2_PACKAGE_PHP4_FASTCGI
	 
comment "Server API --"

config BR2_PACKAGE_PHP4_CLI
	prompt "...-cli - PHP4 CLI (Command Line Interface)"
	tristate 
#	default m if CONFIG_DEVEL
	select BR2_COMPILE_PHP4
	select BR2_PACKAGE_LIBOPENSSL
	select BR2_PACKAGE_ZLIB
	help
	 PHP is a widely-used general-purpose scripting language that is especially 
	 suited for Web development and can be embedded into HTML.
	 
	 http://www.php.net/

config BR2_PACKAGE_PHP4_CGI
	prompt "...-cgi - PHP4 built for CGI"
	tristate 
#	default m if CONFIG_DEVEL
	select BR2_COMPILE_PHP4
	select BR2_PACKAGE_LIBOPENSSL
	select BR2_PACKAGE_ZLIB
	help
	 PHP is a widely-used general-purpose scripting language that is especially 
	 suited for Web development and can be embedded into HTML.
	 
	 http://www.php.net/

config BR2_PACKAGE_PHP4_FASTCGI
	prompt "...-fastcgi - PHP4 built for FastCGI"
	tristate 
#	default m if CONFIG_DEVEL
	select BR2_COMPILE_PHP4
	select BR2_PACKAGE_LIBOPENSSL
	select BR2_PACKAGE_ZLIB
	help
	 PHP is a widely-used general-purpose scripting language that is especially 
	 suited for Web development and can be embedded into HTML.
	 
	 http://www.php.net/

comment "Extensions --"

config BR2_PACKAGE_PHP4_MOD_FTP
	prompt "...-mod-ftp - FTP module"
	tristate 
#	default m if CONFIG_DEVEL
	depends BR2_COMPILE_PHP4

config BR2_PACKAGE_PHP4_MOD_GD
	prompt "...-mod-gd - GD graphics library module"
	tristate 
#	default m if CONFIG_DEVEL
	depends BR2_COMPILE_PHP4
	select BR2_PACKAGE_LIBGD
	select BR2_PACKAGE_LIBPNG

config BR2_PACKAGE_PHP4_MOD_LDAP
	prompt "...-mod-ldap - LDAP module"
	tristate 
#	default m if CONFIG_DEVEL
	depends BR2_COMPILE_PHP4
	select BR2_PACKAGE_LIBOPENLDAP

config BR2_PACKAGE_PHP4_MOD_MYSQL
	prompt "...-mod-mysql - MySQL module"
	tristate 
#	default m if CONFIG_DEVEL
	depends BR2_COMPILE_PHP4
	select BR2_PACKAGE_LIBMYSQLCLIENT

config BR2_PACKAGE_PHP4_MOD_OPENSSL
	prompt "...-mod-openssl - OpenSSL module"
	tristate 
#	default m if CONFIG_DEVEL
	depends BR2_COMPILE_PHP4
	select BR2_PACKAGE_LIBOPENSSL

config BR2_PACKAGE_PHP4_MOD_PCRE
	prompt "...-mod-pcre - PCRE module"
	tristate 
#	default m if CONFIG_DEVEL
	depends BR2_COMPILE_PHP4
	select BR2_PACKAGE_LIBPCRE

config BR2_PACKAGE_PHP4_MOD_PGSQL
	prompt "...-mod-pgsql - PostgreSQL module"
	tristate 
#	default m if CONFIG_DEVEL
	depends BR2_COMPILE_PHP4
	select BR2_PACKAGE_LIBPQ

config BR2_PACKAGE_PHP4_MOD_SESSION
	prompt "...-mod-session - Sessions module"
	tristate 
#	default m if CONFIG_DEVEL
	depends BR2_COMPILE_PHP4

config BR2_PACKAGE_PHP4_MOD_SQLITE
	prompt "...-mod-sqlite - SQLite module"
	tristate 
#	default m if CONFIG_DEVEL
	depends BR2_COMPILE_PHP4
	select BR2_PACKAGE_LIBSQLITE2

config BR2_PACKAGE_PHP4_MOD_SOCKETS
	prompt "...-mod-sockets - Sockets module"
	tristate 
#	default m if CONFIG_DEVEL
	depends BR2_COMPILE_PHP4

config BR2_PACKAGE_PHP4_MOD_XML
	prompt "...-mod-xml - XML module"
	tristate 
#	default m if CONFIG_DEVEL
	depends BR2_COMPILE_PHP4
	select BR2_PACKAGE_LIBEXPAT

endmenu
```

## openwrt/package/php5/Config.in
```kconfig
menu "php5.............................. PHP5 Hypertext preprocessor"

config BR2_COMPILE_PHP5
	tristate
	default n
	depends BR2_PACKAGE_PHP5_CLI || BR2_PACKAGE_PHP5_CGI || BR2_PACKAGE_PHP5_FASTCGI
	 
comment "Server API ---"

config BR2_PACKAGE_PHP5_CLI
	prompt "php5-cli.......................... PHP5 CLI (Command Line Interface)"
	tristate 
	default m if CONFIG_DEVEL
	select BR2_COMPILE_PHP5
	select BR2_PACKAGE_LIBOPENSSL
	select BR2_PACKAGE_ZLIB
	help
	 PHP is a widely-used general-purpose scripting language that is especially 
	 suited for Web development and can be embedded into HTML.
	 
	 http://www.php.net/

config BR2_PACKAGE_PHP5_CGI
	prompt "php5-cgi.......................... PHP5 built for CGI"
	tristate 
	default m if CONFIG_DEVEL
	select BR2_COMPILE_PHP5
	select BR2_PACKAGE_LIBOPENSSL
	select BR2_PACKAGE_ZLIB
	help
	 PHP is a widely-used general-purpose scripting language that is especially 
	 suited for Web development and can be embedded into HTML.
	 
	 http://www.php.net/

config BR2_PACKAGE_PHP5_FASTCGI
	prompt "php5-fastcgi...................... PHP5 built for FastCGI"
	tristate 
	default m if CONFIG_DEVEL
	select BR2_COMPILE_PHP5
	select BR2_PACKAGE_LIBOPENSSL
	select BR2_PACKAGE_ZLIB
	help
	 PHP is a widely-used general-purpose scripting language that is especially 
	 suited for Web development and can be embedded into HTML.
	 
	 http://www.php.net/

comment "Extensions ---"

config BR2_PACKAGE_PHP5_MOD_CURL
	prompt "php5-mod-curl..................... cURL module"
	tristate 
	default m if CONFIG_DEVEL
	depends BR2_COMPILE_PHP5
	select BR2_PACKAGE_LIBCURL

config BR2_PACKAGE_PHP5_MOD_FTP
	prompt "php5-mod-ftp...................... FTP module"
	tristate 
	default m if CONFIG_DEVEL
	depends BR2_COMPILE_PHP5

config BR2_PACKAGE_PHP5_MOD_GD
	prompt "php5-mod-gd....................... GD graphics library module"
	tristate 
	default m if CONFIG_DEVEL
	depends BR2_COMPILE_PHP5
	select BR2_PACKAGE_LIBGD
	select BR2_PACKAGE_LIBPNG

config BR2_PACKAGE_PHP5_MOD_GMP
	prompt "php5-mod-gmp...................... GMP module"
	tristate 
	default m if CONFIG_DEVEL
	depends BR2_COMPILE_PHP5
	select BR2_PACKAGE_LIBGMP

config BR2_PACKAGE_PHP5_MOD_LDAP
	prompt "php5-mod-ldap..................... LDAP module"
	tristate 
	default m if CONFIG_DEVEL
	depends BR2_COMPILE_PHP5
	select BR2_PACKAGE_LIBOPENLDAP

config BR2_PACKAGE_PHP5_MOD_MYSQL
	prompt "php5-mod-mysql.................... MySQL module"
	tristate 
	default m if CONFIG_DEVEL
	depends BR2_COMPILE_PHP5
	select BR2_PACKAGE_LIBMYSQLCLIENT

config BR2_PACKAGE_PHP5_MOD_OPENSSL
	prompt "php5-mod-openssl.................. OpenSSL module"
	tristate 
	default m if CONFIG_DEVEL
	depends BR2_COMPILE_PHP5
	select BR2_PACKAGE_LIBOPENSSL

config BR2_PACKAGE_PHP5_MOD_PCRE
	prompt "php5-mod-pcre..................... PCRE module"
	tristate 
	default m if CONFIG_DEVEL
	depends BR2_COMPILE_PHP5
	select BR2_PACKAGE_LIBPCRE

config BR2_PACKAGE_PHP5_MOD_PGSQL
	prompt "php5-mod-pgsql.................... PostgreSQL module"
	tristate 
	default m if CONFIG_DEVEL
	depends BR2_COMPILE_PHP5
	select BR2_PACKAGE_LIBPQ

config BR2_PACKAGE_PHP5_MOD_SESSION
	prompt "php5-mod-session.................. Sessions module"
	tristate 
	default m if CONFIG_DEVEL
	depends BR2_COMPILE_PHP5

config BR2_PACKAGE_PHP5_MOD_SQLITE
	prompt "php5-mod-sqlite................... SQLite module"
	tristate 
	default m if CONFIG_DEVEL
	depends BR2_COMPILE_PHP5
	select BR2_PACKAGE_LIBSQLITE2

config BR2_PACKAGE_PHP5_MOD_SOCKETS
	prompt "php5-mod-sockets.................. Sockets module"
	tristate 
	default m if CONFIG_DEVEL
	depends BR2_COMPILE_PHP5

config BR2_PACKAGE_PHP5_MOD_XML
	prompt "php5-mod-xml...................... XML module"
	tristate 
	default m if CONFIG_DEVEL
	depends BR2_COMPILE_PHP5
	select BR2_PACKAGE_LIBEXPAT

endmenu
```

## openwrt/package/picocom/Config.in
```kconfig
config BR2_PACKAGE_PICOCOM
	prompt "picocom........................... minimal dumb-terminal emulation program"
	tristate
	default m if CONFIG_DEVEL
	help
	  As its name suggests, picocom is a minimal dumb-terminal emulation 
	  program. It is, in principle, very much like minicom, only it's pico 
	  instead of mini! It was designed to serve as a simple, manual, modem 
	  configuration, testing, and debugging tool. It has also served (quite 
	  well) as a low-tech "terminal-window" to allow operator intervention 
	  in PPP connection scripts. It could also prove useful in many other 
	  similar tasks.
	  
	  http://efault.net/npat/hacks/picocom/
```

## openwrt/package/pipacs/Config.in
```kconfig
config BR2_PACKAGE_PIPACS
	prompt "pipacs............................ UNIX socket accounting/wiewer program"
	tristate
	default m if CONFIG_DEVEL
	help
	  An UNIX socket accounting/wiewer program.
	  This is version 2.
```
