## openwrt/package/pmacct/Config.in
```kconfig
menu "pmacct - IPv4/IPv6 accounting and aggregation tools"

config BR2_PACKAGE_PMACCT
	bool
	default n
	select BR2_PACKAGE_LIBPCAP

config BR2_PACKAGE_PMACCT_BASIC
	bool
	default n
	depends BR2_PACKAGE_NFACCTD_BASIC || BR2_PACKAGE_PMACCTD_BASIC || BR2_PACKAGE_PMACCT_CLIENT
	select BR2_PACKAGE_PMACCT

config BR2_PACKAGE_PMACCT_MYSQL
	bool
	default n
	depends BR2_PACKAGE_NFACCTD_MYSQL || BR2_PACKAGE_PMACCTD_MYSQL
	select BR2_PACKAGE_PMACCT
	select BR2_PACKAGE_LIBMYSQLCLIENT

config BR2_PACKAGE_PMACCT_PGSQL
	bool
	default n
	depends BR2_PACKAGE_NFACCTD_PGSQL || BR2_PACKAGE_PMACCTD_PGSQL
	select BR2_PACKAGE_PMACCT
	select BR2_PACKAGE_LIBPQ

choice
	prompt "nfacctd - NetFlow accounting daemon"
	tristate
	default m if CONFIG_DEVEL
	optional
	help
	  
	  An IPv4/IPv6 Netflow accounting and aggregation daemon
	  
	  http://www.ba.cnr.it/~paolo/pmacct/
	  
	  Depends:
	    - libmysqlclient (for MySQL database logging support)
	    - libpq (for PostgreSQL database logging support)
	  
	
	config BR2_PACKAGE_NFACCTD_BASIC
		prompt "nfacctd: without database support"
		tristate
		select BR2_PACKAGE_PMACCT_BASIC
	
	config BR2_PACKAGE_NFACCTD_MYSQL
		prompt "nfacctd-mysql: with MySQL database support"
		tristate
		select BR2_PACKAGE_PMACCT_MYSQL
	
	config BR2_PACKAGE_NFACCTD_PGSQL
		prompt "nfacctd-pgsql: with PostgreSQL database support"
		tristate
		select BR2_PACKAGE_PMACCT_PGSQL
	
	config BR2_PACKAGE_NFACCTD_CUSTOM
		prompt "nfacctd-custom: customized to your needs"
		tristate
		select BR2_PACKAGE_PMACCT

	config BR2_PACKAGE_NFACCTD_ENABLE_DEBUG
		prompt "debug (enable debugging options, useful for bugreports)"
		bool
		default n
		depends BR2_PACKAGE_NFACCTD_CUSTOM

	config BR2_PACKAGE_NFACCTD_ENABLE_IPV6
		prompt "IPv6 support"
		bool
		default n
		depends BR2_PACKAGE_NFACCTD_CUSTOM

	config BR2_PACKAGE_NFACCTD_WITH_MYSQL
		prompt "MySQL database support"
		bool
		default n
		depends BR2_PACKAGE_NFACCTD_CUSTOM
		select BR2_PACKAGE_LIBMYSQLCLIENT

	config BR2_PACKAGE_NFACCTD_WITH_PGSQL
		prompt "PostgreSQL database support"
		bool
		default n
		depends BR2_PACKAGE_NFACCTD_CUSTOM
		select BR2_PACKAGE_LIBPQ

endchoice

choice
	prompt "pmacctd - IP accounting daemon (libpcap based)"
	tristate
	default m if CONFIG_DEVEL
	optional
	help
	  
	  An IPv4/IPv6 libpcap-based accounting and aggregation daemon
	  
	  http://www.ba.cnr.it/~paolo/pmacct/
	  
	  Depends:
	    - libpcap
	    - libmysqlclient (for MySQL database logging support)
	    - libpq (for PostgreSQL database logging support)
	  
	
	
	config BR2_PACKAGE_PMACCTD_BASIC
		prompt "pmacctd: without database support"
		tristate
		select BR2_PACKAGE_PMACCT_BASIC

	config BR2_PACKAGE_PMACCTD_MYSQL
		prompt "pmacctd-mysql: with MySQL database support"
		tristate
		select BR2_PACKAGE_PMACCT_MYSQL
	
	config BR2_PACKAGE_PMACCTD_PGSQL
		prompt "pmacctd-pgsql: with PostgreSQL database support"
		tristate
		select BR2_PACKAGE_PMACCT_PGSQL
	
	config BR2_PACKAGE_PMACCTD_CUSTOM
		prompt "pmacctd-custom: customized to your needs"
		tristate
		select BR2_PACKAGE_PMACCT
	
	config BR2_PACKAGE_PMACCTD_ENABLE_DEBUG
		prompt "debug (enable debugging options, useful for bugreports)"
		bool
		default n
		depends BR2_PACKAGE_PMACCTD_CUSTOM

	config BR2_PACKAGE_PMACCTD_ENABLE_IPV6
		prompt "IPv6 support"
		bool
		default n
		depends BR2_PACKAGE_PMACCTD_CUSTOM

	config BR2_PACKAGE_PMACCTD_WITH_MYSQL
		prompt "MySQL database support"
		bool
		default n
		depends BR2_PACKAGE_PMACCTD_CUSTOM
		select BR2_PACKAGE_LIBMYSQLCLIENT

	config BR2_PACKAGE_PMACCTD_WITH_PGSQL
		prompt "PostgreSQL database support"
		bool
		default n
		depends BR2_PACKAGE_PMACCTD_CUSTOM
		select BR2_PACKAGE_LIBPQ

endchoice

config BR2_PACKAGE_PMACCT_CLIENT
	prompt "pmacct-client - Command-line client to gather data from the IMT plugin"
	tristate
	default n
	select BR2_PACKAGE_PMACCT

endmenu
```
