## openwrt/package/sqlite2/Config.in
```kconfig
config BR2_COMPILE_SQLITE2
	tristate
	default n
	depends BR2_PACKAGE_LIBSQLITE2

config BR2_PACKAGE_LIBSQLITE2
	prompt "libsqlite2........................ Self-contained, embeddable, zero-configuration SQL database engine (v2.x)"
	tristate
	default m if CONFIG_DEVEL
	select BR2_COMPILE_SQLITE2
	select BR2_PACKAGE_LIBNCURSES
	select BR2_PACKAGE_LIBREADLINE
	help
	  SQLite is a small C library that implements a self-contained, embeddable, 
	  zero-configuration SQL database engine. Features include:
	  
	    * Transactions are atomic, consistent, isolated, and durable (ACID) 
	      even after system crashes and power failures.
	    * Zero-configuration - no setup or administration needed.
	    * Implements most of SQL92. (Features not supported)
	    * A complete database is stored in a single disk file.
	    * Database files can be freely shared between machines with different 
	      byte orders.
	    * Supports databases up to 2 terabytes (241 bytes) in size.
	    * Sizes of strings and BLOBs limited only by available memory.
	    * Small code footprint: less than 30K lines of C code, less than 250KB 
	      code space (gcc on i486)
	    * Faster than popular client/server database engines for most common 
	      operations.
	    * Simple, easy to use API.
	    * TCL bindings included. Bindings for many other languages available 
	      separately.
	    * Well-commented source code with over 95% test coverage.
	    * Self-contained: no external dependencies.
	    * Sources are in the public domain. Use for any purpose.
	  
	  http://www.sqlite.org/
	  
	  This package contains the shared library, needed by other programs.

config BR2_PACKAGE_SQLITE2_CLI
	prompt   "sqlite2-cli..................... Command line interface for SQLite (v2.x)"
	tristate
	default m if CONFIG_DEVEL
	depends BR2_PACKAGE_LIBSQLITE2
	help
	  SQLite is a small C library that implements a self-contained, embeddable, 
	  zero-configuration SQL database engine. Features include:
	  
	    * Transactions are atomic, consistent, isolated, and durable (ACID) 
	      even after system crashes and power failures.
	    * Zero-configuration - no setup or administration needed.
	    * Implements most of SQL92. (Features not supported)
	    * A complete database is stored in a single disk file.
	    * Database files can be freely shared between machines with different 
	      byte orders.
	    * Supports databases up to 2 terabytes (241 bytes) in size.
	    * Sizes of strings and BLOBs limited only by available memory.
	    * Small code footprint: less than 30K lines of C code, less than 250KB 
	      code space (gcc on i486)
	    * Faster than popular client/server database engines for most common 
	      operations.
	    * Simple, easy to use API.
	    * TCL bindings included. Bindings for many other languages available 
	      separately.
	    * Well-commented source code with over 95% test coverage.
	    * Self-contained: no external dependencies.
	    * Sources are in the public domain. Use for any purpose.
	  
	  http://www.sqlite.org/
	  
	  This package contains a terminal-based front-end to the SQLite library 
	  that can evaluate queries interactively and display the results in 
	  multiple formats.
```

## openwrt/package/squid/Config.in
```kconfig
menu "squid............................. proxy and web cache"

config BR2_PACKAGE_SQUID
	prompt "squid................................. full-featured Web proxy cache"
	tristate
	default m if CONFIG_DEVEL
	select BR2_PACKAGE_LIBOPENSSL
	help
	  Squid is a high-performance proxy caching server for web clients, 
	  supporting FTP, gopher, and HTTP data objects. Unlike traditional 
	  caching software, Squid handles all requests in a single, 
	  non-blocking, I/O-driven process.

	  http://www.squid-cache.org

config BR2_PACKAGE_SQUID_MOD_BASIC_AUTH_GETPWNAM
	prompt "squid-mod-basic-auth-getpwnam......... getpwnam basic authentication helper"
	tristate
	depends BR2_PACKAGE_SQUID
	help
	  Password basic authentication helper

config BR2_PACKAGE_SQUID_MOD_BASIC_AUTH_NCSA
	prompt "squid-mod-basic-auth-ncsa............. NCSA basic authentication helper"
	tristate
	depends BR2_PACKAGE_SQUID
	help
	  NCSA basic authentication helper

config BR2_PACKAGE_SQUID_MOD_BASIC_AUTH_SMB
	prompt "squid-mod-basic-auth-smb.............. Samba basic authentication helper"
	tristate
	depends BR2_PACKAGE_SQUID
	help
	  Samba basic authentication helper

config BR2_PACKAGE_SQUID_MOD_BASIC_AUTH_WINBIND
	prompt "squid-mod-basic-auth-winbind.......... Winbind basic authentication helper"
	tristate
	depends BR2_PACKAGE_SQUID
	help
	  Winbind basic authentication helper

config BR2_PACKAGE_SQUID_MOD_DIGEST_AUTH_PASSWORD
	prompt "squid-mod-digest-auth-password........ Password digest authentication ehlper"
	tristate
	depends BR2_PACKAGE_SQUID
	help
	  Password digest authentication helper

config BR2_PACKAGE_SQUID_MOD_EXTERNAL_ACL_IP_USER
	prompt "squid-mod-external-acl-ip_user........ IP user external ACL helper"
	tristate
	depends BR2_PACKAGE_SQUID
	help
	  IP user external ACL helper

config BR2_PACKAGE_SQUID_MOD_EXTERNAL_ACL_UNIX_GROUP
	prompt "squid-mod-external-acl-unix-group..... Unix group external ACL helper"
	tristate
	depends BR2_PACKAGE_SQUID
	help
	  Unix group external ACL helper

config BR2_PACKAGE_SQUID_MOD_EXTERNAL_ACL_WINBIND_GROUP
	prompt "squid-mod-external-acl-winbind-group.. Winbind group external ACL helper"
	tristate
	depends BR2_PACKAGE_SQUID
	help
	  Winbind group external ACL helper

config BR2_PACKAGE_SQUID_MOD_NTLM_AUTH_FAKEAUTH
	prompt "squid-mod-ntlm-auth-fakeauth.......... Fakeauth NTLM authentication helper"
	tristate
	depends BR2_PACKAGE_SQUID
	help
	  Fakeauth NTLM authentication helper

config BR2_PACKAGE_SQUID_MOD_NTLM_AUTH_SMB_AUTH
	prompt "squid-mod-ntlm-auth-smb-auth.......... Samba NTLM authentication helper"
	tristate
	depends BR2_PACKAGE_SQUID
	help
	  Samba NTLM authentication helper

config BR2_PACKAGE_SQUID_MOD_NTLM_AUTH_WINBIND_AUTH
	prompt "squid-mod-ntlm-auth-winbind-auth...... Winbind NTLM authentication helper"
	tristate
	depends BR2_PACKAGE_SQUID
	help
	  Winbind NTLM authentication helper

endmenu
```

## openwrt/package/srelay/Config.in
```kconfig
config BR2_PACKAGE_SRELAY
	tristate "srelay - socks 4/5 proxy server"
	default m if CONFIG_DEVEL
	help
	  
	  http://www.c-wind.com/srelay/
```

## openwrt/package/ssltunnel/Config.in
```kconfig
config BR2_PACKAGE_SSLTUNNEL
	prompt "ssltunnel ........................ A PPP over SSL vpn tool"
	tristate
	default m if CONFIG_DEVEL
	select BR2_PACKAGE_LIBOPENSSL
	select BR2_PACKAGE_PPP
	help
	  A PPP over SSL vpn tool
	  
	  http://www.hsc.fr/ressources/outils/ssltunnel/index.html
	  
```

## openwrt/package/strace/Config.in
```kconfig
config BR2_PACKAGE_STRACE
	prompt "strace............................ System call tracer"
	tristate
	default m if CONFIG_DEVEL
	help
	  A useful diagnostic, instructional, and debugging tool.
	  Allows you to track what system calls a program makes 
	  while it is running.
	  
	  http://sourceforge.net/projects/strace/
```

## openwrt/package/syslog-ng/Config.in
```kconfig
config BR2_PACKAGE_SYSLOG_NG
	prompt "syslog-ng......................... A powerful syslog daemon"
	tristate
	default m if CONFIG_DEVEL
	select BR2_PACKAGE_LIBOL
	help
		syslog-ng reads and logs messages to the  system  console,  log
		files, other machines and/or users as specified by its
		configuration file.

		The  configuration  file is read at startup and is reread after
		receipt of a hangup (HUP) signal.  When reloading the
		configuration  file,  all destination  files  are  closed  and
		reopened as appropriate. For more information about the
		configuration file, see syslog-ng.conf(5).

		Typically messages are sent to  syslog-ng  via  a  Unix  domain
		socket (/dev/log) or via UDP, to port 514 or to whatever
		syslog/udp is defined to be in /etc/services.  To receive
		messages from the kernel, /dev/klog is opened for reading.

		Messages sent to syslog-ng should be an entire line, prefixed
		by a pri- ority code in between '<' and '>'.   Definititions
		of  the  recognised values can be found in the include file
		<sys/syslog.h>.

		syslog-ng  can  be  configured to pass messages on to other
		syslog-ng's and when doing so, it sends the message on with the
		priority as a  pre- fix.

		http://www.balabit.com/products/syslog_ng/	  
```

## openwrt/package/tcp_wrappers/Config.in
```kconfig
config BR2_COMPILE_TCP_WRAPPERS
	bool
	default n
	depends BR2_PACKAGE_LIBWRAP

config BR2_PACKAGE_LIBWRAP
	prompt "libwrap........................... Security wrapper library for TCP services"
	tristate
	default m if CONFIG_DEVEL
	select BR2_COMPILE_TCP_WRAPPERS
	help
	  Security wrapper library for TCP services.
	  
	  ftp://ftp.porcupine.org/pub/security/index.html
```

## openwrt/package/tcpdump/Config.in
```kconfig
config BR2_PACKAGE_TCPDUMP
	select BR2_PACKAGE_LIBPCAP
	tristate "tcpdump"
	default m
	help
	  A tool for network monitoring and data acquisition.

	  http://www.tcpdump.org/
```

## openwrt/package/tinc/Config.in
```kconfig
config BR2_PACKAGE_TINC
	tristate "tinc - VPN tunneling daemon"
	default m if CONFIG_DEVEL
	select BR2_PACKAGE_KMOD_TUN
	select BR2_PACKAGE_LIBLZO
	select BR2_PACKAGE_LIBOPENSSL
	select BR2_PACKAGE_ZLIB
	help
	  A VPN tunneling daemon
	  
	  http://www.tinc-vpn.org/
```

## openwrt/package/tinyproxy/Config.in
```kconfig
menu "tinyproxy......................... Tinyproxy is a lightweight HTTP and HTTPS proxy."

config BR2_PACKAGE_TINYPROXY
	prompt "tinyproxy......................... Tinyproxy is a lightweight HTTP and HTTPS proxy"
	tristate
	default m if CONFIG_DEVEL
	help
		Tinyproxy is a lightweight HTTP and HTTPS proxy.

		http://tinyproxy.sourceforge.net

config BR2_COMPILE_TINYPROXY_WITH_TRANSPARENT_PROXY
	prompt "Enable transparent proxying"
	bool
	default y
	depends BR2_PACKAGE_TINYPROXY

config BR2_COMPILE_TINYPROXY_WITH_FILTER
	prompt "Enable filtering support"
	bool
	default y
	depends BR2_PACKAGE_TINYPROXY

config BR2_COMPILE_TINYPROXY_WITH_UPSTREAM
	prompt "Enable upstream support"
	bool
	default y
	depends BR2_PACKAGE_TINYPROXY

endmenu
```
