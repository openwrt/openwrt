## openwrt/package/screen/Config.in
```kconfig
config BR2_PACKAGE_SCREEN
	prompt "screen............................ Full-screen terminal window manager"
	tristate
	default m if CONFIG_DEVEL
	help
	  Screen is a full-screen window manager that multiplexes a physical 
	  terminal between several processes, typically interactive shells.
	  
	  http://www.gnu.org/software/screen/
```

## openwrt/package/sdk/Config.in
```kconfig
config BR2_PACKAGE_SDK
	bool "OpenWrt SDK"
	default y if CONFIG_DEVEL
	help
	  Build an OpenWrt SDK.
	  This is essentially a stripped-down version of the buildroot
	  with a precompiled toolchain. It can be used to develop and
	  test packages for OpenWrt before including them in the buildroot
```

## openwrt/package/ser/Config.in
```kconfig
config BR2_PACKAGE_SER
	prompt "ser............................... SIP Express Router"
	tristate
	default m if CONFIG_DEVEL
	help
	  SIP Express Router (ser) is a high-performance,
	  configurable, free SIP server.
	  
	  http://www.iptel.org/ser/
```

## openwrt/package/serdisplib/Config.in
```kconfig
config BR2_PACKAGE_SERDISPLIB
	prompt "serdisplib........................ a library for controlling displays"
	tristate
	default m if CONFIG_DEVEL
	help
	  serdisplib is a library to drive serial and parallel displays
	  with built-in controllers.
	  
	  http://serdisplib.sourceforge.net/
```

## openwrt/package/setpwc/Config.in
```kconfig
config BR2_PACKAGE_SETPWC
	prompt "setpwc............................ Philips (and compatibles) WebCams (PWC) control utility"
	tristate
	default m if CONFIG_DEVEL
	help
	  Philips (and compatibles) WebCams (PWC) control utility.
	  
	  http://www.vanheusden.com/setpwc/
```

## openwrt/package/shat/Config.in
```kconfig
config BR2_PACKAGE_SHAT
	prompt "shat.............................. Source Hardware Address Translation"
	tristate
	default m if CONFIG_DEVEL
	help
	  A tool which allows hosts with arbitrary IP configuration
	  to connect to the internet over a SHAT gateway.
	  
	  http://www.teddy-net.com/cvs/Maxina/128gw/service/arpcatch/shat/
```

## openwrt/package/shfs/Config.in
```kconfig
config BR2_COMPILE_SHFS
	tristate
	default n
	depends BR2_PACKAGE_SHFS_UTILS

config BR2_PACKAGE_SHFS_UTILS
	prompt "shfs-utils........................ ShFS mount/umount utilities"
	tristate
	select BR2_COMPILE_SHFS
	select BR2_PACKAGE_KMOD_SHFS
	default m if CONFIG_DEVEL
	help
	  ShFS is a simple and easy to use Linux kernel module which 
	  allows you to mount remote filesystems using a plain shell 
	  (SSH) connection. When using ShFS, you can access all remote 
	  files just like the local ones, only the access is governed 
	  through the transport security of SSH.
	  
	  ShFS supports some nice features:
	  
	   * file cache for access speedup
	   * perl and shell code for the remote (server) side
	   * could preserve uid/gid (root connection)
	   * number of remote host platforms (Linux, Solaris, Cygwin, ...)
	   * Linux kernel 2.4.10+ and 2.6
	   * arbitrary command used for connection (instead of SSH)
	   * persistent connection (reconnect after SSH dies) 
	  
	  http://shfs.sourceforge.net/
	  
	  This package contains the shfs mount/umount utilities.
```

## openwrt/package/sipp/Config.in
```kconfig
config BR2_PACKAGE_SIPP
	prompt "sipp.............................. test tool / traffic generator for the SIP protocol"
	tristate
	default m if CONFIG_DEVEL
	select BR2_PACKAGE_UCLIBCXX
	select BR2_PACKAGE_LIBPTHREAD
	select BR2_PACKAGE_LIBNCURSES
	help
	  SIPp is a free Open Source test tool / traffic generator for the SIP protocol. 
	  It includes a few basic SipStone user agent scenarios (UAC and UAS) and 
	  establishes and releases multiple calls with the INVITE and BYE methods.

	  http://sipp.sourceforge.net
```

## openwrt/package/sipsak/Config.in
```kconfig
config BR2_PACKAGE_SIPSAK
	prompt "sipsak............................ SIP (Session Initiation Protocol) stress and diagnostics utility"
	tristate
	default m if CONFIG_DEVEL
	select BR2_PACKAGE_LIBOPENSSL
	help
	  A SIP (Session Initiation Protocol) stress and diagnostics utility
	  
	  http://www.sipsak.org/
	  
	  Depends: openssl
```

## openwrt/package/slurm/Config.in
```kconfig
config BR2_PACKAGE_SLURM
	prompt "slurm............................. A realtime network interface monitor"
	tristate
	default m if CONFIG_DEVEL
	help
	  A realtime network interface monitor with the following features:
	  
	    * realtime traffic statistics divided into incoming and outgoing
	    * optional combined view
	    * can monitor any kind of network interface
	    * shows detailed statistics about the interface.
	    * it's themeable
	  
	  http://www.wormulon.net/projects/slurm
```

## openwrt/package/snort-wireless/Config.in
```kconfig
menu           "snort-wireless.................... Ligthweight Wireless Network Intrusion Detection System (NIDS)"

config BR2_COMPILE_SNORT_WIRELESS
	tristate
	default n
	depends BR2_PACKAGE_SNORT_WIRELESS_BASIC || BR2_PACKAGE_SNORT_WIRELESS_MYSQL || BR2_PACKAGE_SNORT_WIRELESS_PGSQL || BR2_PACKAGE_SNORT_WIRELESS_CUSTOM

choice
	prompt "snort-wireless.................... Ligthweight Wireless Network Intrusion Detection System (NIDS)"
	tristate
	optional
	help
	  
	  A ligthweight Wireless Network Intrusion Detection System (NIDS)
	  
	  http://www.snort-wireless.org/
	  
	  Depends: 
	    - libmysqlclient (for MySQL database logging support)
	    - libnet
	    - libpcap
	    - libpcre
	    - libpq (for PostgreSQL database logging support)
	  
	
	config BR2_PACKAGE_SNORT_WIRELESS_BASIC
		prompt   "snort-wireless..................   without database support"
		tristate
		select BR2_COMPILE_SNORT_WIRELESS
		select BR2_PACKAGE_LIBNET
		select BR2_PACKAGE_LIBPCAP
		select BR2_PACKAGE_LIBPCRE
	
	config BR2_PACKAGE_SNORT_WIRELESS_MYSQL
		prompt   "snort-wireless-mysql............   with MySQL database support"
		tristate
		select BR2_COMPILE_SNORT_WIRELESS
		select BR2_PACKAGE_LIBNET
		select BR2_PACKAGE_LIBPCAP
		select BR2_PACKAGE_LIBPCRE
		select BR2_PACKAGE_LIBMYSQLCLIENT
	
	config BR2_PACKAGE_SNORT_WIRELESS_PGSQL
		prompt   "snort-wireless-pgsql............   with PostgreSQL database support"
		tristate
		select BR2_COMPILE_SNORT_WIRELESS
		select BR2_PACKAGE_LIBNET
		select BR2_PACKAGE_LIBPCAP
		select BR2_PACKAGE_LIBPCRE
		select BR2_PACKAGE_LIBPQ
	
	config BR2_PACKAGE_SNORT_WIRELESS_CUSTOM
		prompt   "snort-wireless-custom...........   customized to your needs"
		tristate
		select BR2_COMPILE_SNORT_WIRELESS
		select BR2_PACKAGE_LIBNET
		select BR2_PACKAGE_LIBPCAP
		select BR2_PACKAGE_LIBPCRE
	
	config BR2_PACKAGE_SNORT_WIRELESS_ENABLE_DEBUG
		prompt "enable debug (enable debugging options, useful for bugreports)"
		bool
		default n
		depends BR2_PACKAGE_SNORT_WIRELESS_CUSTOM

	config BR2_PACKAGE_SNORT_WIRELESS_ENABLE_INLINE
		prompt "enable inline mode (read packets from iptables instead of libpcap)"
		bool
		default n
		depends BR2_PACKAGE_SNORT_WIRELESS_CUSTOM
		select BR2_PACKAGE_IPTABLES

	config BR2_PACKAGE_SNORT_WIRELESS_WITH_MYSQL
		prompt "with MySQL database support"
		bool
		default n
		depends BR2_PACKAGE_SNORT_WIRELESS_CUSTOM
		select BR2_PACKAGE_LIBMYSQLCLIENT

	config BR2_PACKAGE_SNORT_WIRELESS_WITH_PGSQL
		prompt "with PostgreSQL database support"
		bool
		default n
		depends BR2_PACKAGE_SNORT_WIRELESS_CUSTOM
		select BR2_PACKAGE_LIBPQ

endchoice

endmenu
```

## openwrt/package/snort/Config.in
```kconfig
menu "snort............................. Ligthweight Network Intrusion Detection System (NIDS)"

config BR2_COMPILE_SNORT
	tristate
	default n
	depends BR2_PACKAGE_SNORT_BASIC || BR2_PACKAGE_SNORT_MYSQL || BR2_PACKAGE_SNORT_PGSQL || BR2_PACKAGE_SNORT_CUSTOM

choice
	prompt "snort............................. Ligthweight Network Intrusion Detection System (NIDS)"
	tristate
	optional
	help
	  
	  A ligthweight Network Intrusion Detection System (NIDS)
	  
	  http://www.snort.org/
	  
	  Depends: 
	    - libmysqlclient (for MySQL database logging support)
	    - libnet
	    - libpcap
	    - libpcre
	    - libpq (for PostgreSQL database logging support)
	
	config BR2_PACKAGE_SNORT_BASIC
		prompt   "snort...........................   without database support"
		tristate
		select BR2_COMPILE_SNORT
		select BR2_PACKAGE_LIBNET
		select BR2_PACKAGE_LIBPCAP
		select BR2_PACKAGE_LIBPCRE
	
	config BR2_PACKAGE_SNORT_MYSQL
		prompt   "snort-mysql.....................   with MySQL database support"
		tristate
		select BR2_COMPILE_SNORT
		select BR2_PACKAGE_LIBNET
		select BR2_PACKAGE_LIBPCAP
		select BR2_PACKAGE_LIBPCRE
		select BR2_PACKAGE_LIBMYSQLCLIENT
	
	config BR2_PACKAGE_SNORT_PGSQL
		prompt   "snort-pgsql.....................   with PostgreSQL database support"
		tristate
		select BR2_COMPILE_SNORT
		select BR2_PACKAGE_LIBNET
		select BR2_PACKAGE_LIBPCAP
		select BR2_PACKAGE_LIBPCRE
		select BR2_PACKAGE_LIBPQ
	
	config BR2_PACKAGE_SNORT_CUSTOM
		prompt   "snort-custom....................   customized to your needs"
		tristate
		select BR2_COMPILE_SNORT
		select BR2_PACKAGE_LIBNET
		select BR2_PACKAGE_LIBPCAP
		select BR2_PACKAGE_LIBPCRE
	
	config BR2_PACKAGE_SNORT_ENABLE_DEBUG
		prompt "debug (enable debugging options, useful for bugreports)"
		bool
		default n
		depends BR2_PACKAGE_SNORT_CUSTOM

	config BR2_PACKAGE_SNORT_ENABLE_INLINE
		prompt "Inline mode (read packets from iptables instead of libpcap)"
		bool
		default n
		depends BR2_PACKAGE_SNORT_CUSTOM
		select BR2_PACKAGE_IPTABLES

	config BR2_PACKAGE_SNORT_WITH_MYSQL
		prompt "MySQL database support"
		bool
		default n
		depends BR2_PACKAGE_SNORT_CUSTOM
		select BR2_PACKAGE_LIBMYSQLCLIENT

	config BR2_PACKAGE_SNORT_WITH_PGSQL
		prompt "PostgreSQL database support"
		bool
		default n
		depends BR2_PACKAGE_SNORT_CUSTOM
		select BR2_PACKAGE_LIBPQ

endchoice

endmenu
```

## openwrt/package/socat/Config.in
```kconfig
config BR2_PACKAGE_SOCAT
	prompt "socat............................. A multipurpose relay (SOcket CAT)"
	tristate
	default m if CONFIG_DEVEL
	select BR2_PACKAGE_LIBOPENSSL
	select BR2_PACKAGE_LIBPTHREAD
	help
	  SoCat (for SOcket CAT) establishes two bidirectional byte streams and 
	  transfers data between them.
	  Data channels may be files, pipes, devices (terminal or modem, etc.), or 
	  sockets (Unix, IPv4, IPv6, raw, UDP, TCP, SSL). It provides forking, 
	  logging and tracing, different modes for interprocess communication and 
	  many more options.
	  
	  http://www.dest-unreach.org/socat/
	  
	  Depends: openssl
```

## openwrt/package/speex/Config.in
```kconfig
config BR2_COMPILE_SPEEX
	tristate
	default n
	depends BR2_PACKAGE_LIBSPEEX

config BR2_PACKAGE_LIBSPEEX
	prompt "libspeex.......................... Open source patent-free speech compression codec"
	tristate
	default m if CONFIG_DEVEL
	select BR2_COMPILE_SPEEX
	help
	  
	  Speex is an Open Source/Free Software patent-free audio compression 
	  format designed for speech. The Speex Project aims to lower the 
	  barrier of entry for voice applications by providing a free 
	  alternative to expensive proprietary speech codecs. Moreover, Speex 
	  is well-adapted to Internet applications and provides useful features 
	  that are not present in most other codecs.
	  
	  http://www.speex.org/
	  
	  This package contains the shared codec library, needed by other programs.
```

## openwrt/package/sqlite/Config.in
```kconfig
config BR2_COMPILE_SQLITE
	tristate
	default n
	depends BR2_PACKAGE_LIBSQLITE

config BR2_PACKAGE_LIBSQLITE
	prompt "libsqlite......................... Self-contained, embeddable, zero-configuration SQL database engine"
	tristate
	default m if CONFIG_DEVEL
	select BR2_COMPILE_SQLITE
	select BR2_PACKAGE_LIBNCURSES
	select BR2_PACKAGE_LIBREADLINE
	help
	  SQLite is a small C library that implements a self-contained, embeddable, 
	  zero-configuration SQL database engine. Features include:
	  
	    * Transactions are atomic, consistent, isolated, and durable (ACID) 
	      even after system crashes and power failures.
	    * Zero-configuration - no setup or administration needed.
	    * Implements most of SQL92. (Features not supported)
	    * A complete database is stored in a single disk file.
	    * Database files can be freely shared between machines with different 
	      byte orders.
	    * Supports databases up to 2 terabytes (241 bytes) in size.
	    * Sizes of strings and BLOBs limited only by available memory.
	    * Small code footprint: less than 30K lines of C code, less than 250KB 
	      code space (gcc on i486)
	    * Faster than popular client/server database engines for most common 
	      operations.
	    * Simple, easy to use API.
	    * TCL bindings included. Bindings for many other languages available 
	      separately.
	    * Well-commented source code with over 95% test coverage.
	    * Self-contained: no external dependencies.
	    * Sources are in the public domain. Use for any purpose.
	  
	  http://www.sqlite.org/
	  
	  This package contains the shared library, needed by other programs.

config BR2_PACKAGE_SQLITE_CLI
	prompt   "sqlite-cli...................... Command line interface for SQLite"
	tristate
	default m if CONFIG_DEVEL
	depends BR2_PACKAGE_LIBSQLITE
	help
	  SQLite is a small C library that implements a self-contained, embeddable, 
	  zero-configuration SQL database engine. Features include:
	  
	    * Transactions are atomic, consistent, isolated, and durable (ACID) 
	      even after system crashes and power failures.
	    * Zero-configuration - no setup or administration needed.
	    * Implements most of SQL92. (Features not supported)
	    * A complete database is stored in a single disk file.
	    * Database files can be freely shared between machines with different 
	      byte orders.
	    * Supports databases up to 2 terabytes (241 bytes) in size.
	    * Sizes of strings and BLOBs limited only by available memory.
	    * Small code footprint: less than 30K lines of C code, less than 250KB 
	      code space (gcc on i486)
	    * Faster than popular client/server database engines for most common 
	      operations.
	    * Simple, easy to use API.
	    * TCL bindings included. Bindings for many other languages available 
	      separately.
	    * Well-commented source code with over 95% test coverage.
	    * Self-contained: no external dependencies.
	    * Sources are in the public domain. Use for any purpose.
	  
	  http://www.sqlite.org/
	  
	  This package contains a terminal-based front-end to the SQLite library 
	  that can evaluate queries interactively and display the results in 
	  multiple formats.
```
