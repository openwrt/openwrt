## openwrt/package/ebtables/Config.in
```kconfig
config BR2_PACKAGE_EBTABLES
	tristate "Ethernet Bridge Firewalling"
	default m if CONFIG_DEVEL
	help
		Ethernet Bridge Firewalling (ebtables)
		http://ebtables.sourceforge.net/
```

## openwrt/package/elhttp/Config.in
```kconfig
config BR2_PACKAGE_ELHTTP
	prompt "elhttp............................ The extra-light http proxy server."
	tristate
	default m if CONFIG_DEVEL
	help
	  The extra-light http proxy server. Features: keep-alive
	  connections, http connect method, SSL/TLS support, ACLs
	  and client requests logging.
```

## openwrt/package/elinks/Config.in
```kconfig
config BR2_PACKAGE_ELINKS
	prompt "elinks............................ A text based web browser"
	tristate
	default m if CONFIG_DEVEL
	select BR2_PACKAGE_LIBOPENSSL
	help
	  An advanced text based web browser

	  http://elinks.or.cz/
```

## openwrt/package/ether-wake/Config.in
```kconfig
config BR2_PACKAGE_ETHER_WAKE
	prompt "ether-wake........................ A Wake-On-LAN (WOL) client"
	tristate
	default m if CONFIG_DEVEL
	help
	  A Wake-On-LAN (WOL) client,
	  This program sends a magic packet to wake up sleeping networked machines.
	  
	  http://www.scyld.com/wakeonlan.html
```

## openwrt/package/expat/Config.in
```kconfig
config BR2_COMPILE_EXPAT
	tristate
	default n
	depends BR2_PACKAGE_LIBEXPAT

config BR2_PACKAGE_LIBEXPAT
	prompt "libexpat.......................... A fast, non-validating, stream-oriented XML parsing library"
	tristate
	default m if CONFIG_DEVEL
	select BR2_COMPILE_EXPAT
	help
	  A fast, non-validating, stream-oriented XML parsing library
	  
	  http://expat.sourceforge.net/
```

## openwrt/package/ez-ipupdate/Config.in
```kconfig
config BR2_PACKAGE_EZIPUPDATE
	prompt "ez-ipupdate....................... Client for most dynamic DNS services"
	tristate
	default m if CONFIG_DEVEL
	help
	  A client for many Dynamic DNS services.
	  
	  http://ez-ipupdate.com/
```

## openwrt/package/fetchmail/Config.in
```kconfig
config BR2_PACKAGE_FETCHMAIL
	prompt "fetchmail......................... Remote mail retriever"
	tristate
	default m if CONFIG_DEVEL
	help
		Retrieves remote mail via POP/IMAP

		Very useful in conjunction with mutt.
```

## openwrt/package/flac/Config.in
```kconfig
config BR2_COMPILE_FLAC
	tristate
	default n
	depends BR2_PACKAGE_LIBFLAC

config BR2_PACKAGE_LIBFLAC
	prompt "libflac........................... Free Lossless Audio Codec library"
	tristate
	default m if CONFIG_DEVEL
	select BR2_COMPILE_FLAC
	help
	  Free Lossless Audio Codec library
	  
	  http://flac.sourceforge.net/
```

## openwrt/package/fping/Config.in
```kconfig
config BR2_PACKAGE_FPING
	prompt "fping............................. A program to ping multiple hosts in parallel"
	tristate
	default m if CONFIG_DEVEL
	help
	  fping is a ping(1) like program which uses the Internet Control Message Protocol
	  (ICMP) echo request to determine if a host is up. fping is different from ping in
	  that you can specify any number of hosts on the command line, or specify a file
	  containing the lists of hosts to ping. Instead of trying one host until it timeouts
	  or replies, fping will send out a ping packet and move on to the next host in a
	  round-robin fashion. If a host replies, it is noted and removed from the list of 
	  hosts to check. If a host does not respond within a certain time limit and/or retry
	  limit it will be considered unreachable.
	  
	  http://www.fping.com/
```

## openwrt/package/fprobe-ulog/Config.in
```kconfig
config BR2_PACKAGE_FPROBE_ULOG
	tristate "fprobe-ulog - NetFlow probe (ulog-based)"
	default m if CONFIG_DEVEL
	select BR2_PACKAGE_LIBPTHREAD
	help
	  A NetFlow probe obtaining packets through linux netfilter code 
	  (iptables ULOG target).
	  
	  http://fprobe.sourceforge.net/
	  
```

## openwrt/package/fprobe/Config.in
```kconfig
config BR2_PACKAGE_FPROBE
	prompt "fprobe............................ NetFlow probe (libpcap-based)"
	tristate
	default m if CONFIG_DEVEL
	select BR2_PACKAGE_LIBPCAP
	select BR2_PACKAGE_LIBPTHREAD
	help
	  A NetFlow probe using libpcap
	  
	  http://fprobe.sourceforge.net/
```

## openwrt/package/freeradius/Config.in
```kconfig
config BR2_PACKAGE_FREERADIUS
	prompt "freeradius - Flexible RADIUS server"
	tristate 
	default m if CONFIG_DEVEL
	help
	  A flexible RADIUS server
	  
	  http://www.freeradius.org/
	  
	  Depends: libltdl, libopenssl, libpthread
	  

config BR2_PACKAGE_FREERADIUS_DEMOCERTS
	depends BR2_PACKAGE_FREERADIUS
	prompt "democerts - Demo certificates to test the server"
	tristate 
	default m if CONFIG_DEVEL

config BR2_PACKAGE_FREERADIUS_MOD_CHAP
	depends BR2_PACKAGE_FREERADIUS
	prompt "mod-chap - CHAP module"
	tristate 
	default m if CONFIG_DEVEL

config BR2_PACKAGE_FREERADIUS_MOD_EAP
	depends BR2_PACKAGE_FREERADIUS
	prompt "mod-eap - Base EAP module"
	tristate 
	default m if CONFIG_DEVEL

config BR2_PACKAGE_FREERADIUS_MOD_EAP_GTC
	depends BR2_PACKAGE_FREERADIUS_MOD_EAP
	prompt "mod-eap-gtc - EAP/GTC module"
	tristate 
	default m if CONFIG_DEVEL

config BR2_PACKAGE_FREERADIUS_MOD_EAP_MD5
	depends BR2_PACKAGE_FREERADIUS_MOD_EAP
	prompt "mod-eap-md5 - EAP/MD5 module"
	tristate 
	default m if CONFIG_DEVEL

config BR2_PACKAGE_FREERADIUS_MOD_EAP_MSCHAPV2
	depends BR2_PACKAGE_FREERADIUS_MOD_EAP
	prompt "mod-eap-mschapv2 - EAP/MS-CHAPv2 module"
	tristate 
	default m if CONFIG_DEVEL

config BR2_PACKAGE_FREERADIUS_MOD_EAP_PEAP
	depends BR2_PACKAGE_FREERADIUS_MOD_EAP
	prompt "mod-eap-peap - EAP/PEAP module"
	tristate 
	default m if CONFIG_DEVEL

config BR2_PACKAGE_FREERADIUS_MOD_EAP_TLS
	depends BR2_PACKAGE_FREERADIUS_MOD_EAP
	prompt "mod-eap-tls - EAP/TLS module"
	tristate 
	default m if CONFIG_DEVEL

config BR2_PACKAGE_FREERADIUS_MOD_EAP_TTLS
	depends BR2_PACKAGE_FREERADIUS_MOD_EAP_TLS
	prompt "mod-eap-ttls - EAP/TTLS module"
	tristate 
	default m if CONFIG_DEVEL

config BR2_PACKAGE_FREERADIUS_MOD_FILES
	depends BR2_PACKAGE_FREERADIUS
	prompt "mod-files - Module using local files for authorization"
	tristate 
	default m if CONFIG_DEVEL

config BR2_PACKAGE_FREERADIUS_MOD_LDAP
	depends BR2_PACKAGE_FREERADIUS
	prompt "mod-ldap - LDAP module"
	tristate 
	default m if CONFIG_DEVEL

config BR2_PACKAGE_FREERADIUS_MOD_MSCHAP
	depends BR2_PACKAGE_FREERADIUS
	prompt "mod-mschap - MS-CHAP and MS-CHAPv2 module"
	tristate 
	default m if CONFIG_DEVEL

config BR2_PACKAGE_FREERADIUS_MOD_PAP
	depends BR2_PACKAGE_FREERADIUS
	prompt "mod-pap - PAP module"
	tristate 
	default m if CONFIG_DEVEL

config BR2_PACKAGE_FREERADIUS_MOD_SQL
	depends BR2_PACKAGE_FREERADIUS
	prompt "mod-sql - Base SQL module"
	tristate 
	default m if CONFIG_DEVEL

config BR2_PACKAGE_FREERADIUS_MOD_SQL_MYSQL
	depends BR2_PACKAGE_FREERADIUS_MOD_SQL
	prompt "mod-sql-mysql - MySQL module"
	tristate 
	default m if CONFIG_DEVEL

config BR2_PACKAGE_FREERADIUS_MOD_SQL_PGSQL
	depends BR2_PACKAGE_FREERADIUS_MOD_SQL
	prompt "mod-sql-pgsql - PostgreSQL module"
	tristate 
	default m if CONFIG_DEVEL

config BR2_PACKAGE_FREERADIUS_UTILS
	depends BR2_PACKAGE_FREERADIUS
	prompt "mod-utils - Misc. client utilities"
	tristate 
	default m if CONFIG_DEVEL
```

## openwrt/package/freetype/Config.in
```kconfig
config BR2_COMPILE_FREETYPE
	tristate
	default n
	depends BR2_PACKAGE_LIBFREETYPE

config BR2_PACKAGE_LIBFREETYPE
	tristate "libfreetype....................... A free, high-quality and portable font engine"
#	default m if CONFIG_DEVEL
	default n
	select BR2_COMPILE_FREETYPE
	select BR2_PACKAGE_ZLIB
	help
	  The FreeType project is a team of volunteers who develop free,
	  portable and high-quality software solutions for digital typography.
	  They specifically target embedded systems and focus on bringing small,
	  efficient and ubiquitous products.
	  
	  The FreeType 2 library is their new software font engine.  It has been
	  designed to provide the following important features:
	   * A universal and simple API to manage font files
	   * Support for several font formats through loadable modules
	   * High-quality anti-aliasing
	   * High portability & performance
	  
	  http://www.freetype.org/
```

## openwrt/package/frickin/Config.in
```kconfig
config BR2_PACKAGE_FRICKIN
	tristate "frickin - PPTP (Point-to-Point Tunneling Protocol) proxy"
	default m if CONFIG_DEVEL
	help
	  Frickin PPTP Proxy allows a Point-to-Point Tunneling Protocol (PPTP) 
	  client to connect to a PPTP server through Network Address 
	  Translation (NAT).
	  
	  http://frickin.sourceforge.net/
	  
```

## openwrt/package/fuse/Config.in
```kconfig
config BR2_PACKAGE_KMOD_FUSE
	select BR2_PACKAGE_FUSE
	tristate "kmod-fuse - FUSE kernel module"
	default m if CONFIG_DEVEL
	help
	  With FUSE it is possible to implement a fully functional 
	  filesystem in a userspace program.
	  
	  Features include:
	  
	   * Simple library API
	   * Simple installation (no need to patch or recompile the kernel)
	   * Secure implementation
	   * Userspace - kernel interface is very efficient
	   * Usable by non privileged users
	   * Runs on Linux kernels 2.4.X and 2.6.X
	   * Has proven very stable over time
	  
	  
	  http://fuse.sourceforge.net/
	  
	  Depends: libpthread

config BR2_PACKAGE_LIBFUSE
	tristate "libfuse - FUSE library"
	default m if CONFIG_DEVEL
	depends BR2_PACKAGE_KMOD_FUSE
	select BR2_PACKAGE_LIBPTHREAD
	help
	  With FUSE it is possible to implement a fully functional 
	  filesystem in a userspace program.
	  
	  Features include:
	  
	   * Simple library API
	   * Simple installation (no need to patch or recompile the kernel)
	   * Secure implementation
	   * Userspace - kernel interface is very efficient
	   * Usable by non privileged users
	   * Runs on Linux kernels 2.4.X and 2.6.X
	   * Has proven very stable over time
	  
	  
	  http://fuse.sourceforge.net/
	  
	  Depends: libpthread

config BR2_PACKAGE_FUSE_UTILS
	tristate "fuse-utils - FUSE utilities"
	default m if CONFIG_DEVEL
	depends BR2_PACKAGE_LIBFUSE
	select BR2_PACKAGE_LIBPTHREAD
	help
	  With FUSE it is possible to implement a fully functional 
	  filesystem in a userspace program.
	  
	  Features include:
	  
	   * Simple library API
	   * Simple installation (no need to patch or recompile the kernel)
	   * Secure implementation
	   * Userspace - kernel interface is very efficient
	   * Usable by non privileged users
	   * Runs on Linux kernels 2.4.X and 2.6.X
	   * Has proven very stable over time
	  
	  
	  http://fuse.sourceforge.net/
	  
	  Depends: libpthread


config BR2_PACKAGE_FUSE
	tristate
	default BR2_PACKAGE_KMOD_FUSE
```

## openwrt/package/gcom/Config.in
```kconfig
config BR2_PACKAGE_GCOM
	prompt "gcom.............................. Option/Vodafone 3G/GPRS control tool"
	tristate
	default m
	help
	  Option GlobeTrotter GPRS/EDGE/3G/HSDPA and Vodafone 3G/GPRS datacard control tool
	  
	  gcom is a scripting language interpreter useful for establishing communications
	  on serial lines and through PCMCIA modems as well as GPRS and 3G datacards.
	  
	  http://www.pharscape.org/content/view/46/70/
```

## openwrt/package/gdbserver/Config.in
```kconfig
config BR2_PACKAGE_GDBSERVER
	prompt "gdbserver......................... Remote Server for the GNU Debugger"
	tristate
	default m if CONFIG_DEVEL
	help
	  GDBSERVER is a program that allows you to run GDB on a different machine
	  than the one which is running the program being debugged.
```

## openwrt/package/glib/Config.in
```kconfig
config BR2_COMPILE_GLIB
	tristate
	depends BR2_PACKAGE_GLIB1

config BR2_PACKAGE_GLIB1
	prompt "glib1............................. The GLib library of C routines (v1.2)"
	tristate
	default m if CONFIG_DEVEL
	select BR2_COMPILE_GLIB
	select BR2_PACKAGE_LIBPTHREAD
	help
	  GLib is a library containing many useful C routines for things such
	  as trees, hashes, and lists.
	  
	  http://www.gtk.org/
	  
	  Depends: libpthread
```

## openwrt/package/gmp/Config.in
```kconfig
config BR2_COMPILE_GMP
	tristate
	default n
	depends BR2_PACKAGE_LIBGMP

config BR2_PACKAGE_LIBGMP
	prompt "libgmp............................ GNU multiprecision arithmetic library"
	tristate
	default m if CONFIG_DEVEL
	select BR2_COMPILE_GMP
	help
	  GNU multiprecision arithmetic library
	  
	  http://www.swox.com/gmp/
```

## openwrt/package/gpg/Config.in
```kconfig
config BR2_PACKAGE_GPG
	prompt "gpg .............................. Gnu Privacy Guard"
	tristate
	default m if CONFIG_DEVEL
	help
	  GPG is an encryption program
	  
	  http://www.gnupg.org
```

## openwrt/package/gpsd/Config.in
```kconfig
config BR2_PACKAGE_GPSD
	prompt "gpsd.............................. An interface daemon for GPS receivers"
	tristate
	default m if CONFIG_DEVEL
	select BR2_PACKAGE_LIBPTHREAD
	select BR2_PACKAGE_UCLIBCXX
	help
	  gpsd is a monitor daemon that watches a TCP/IP port (2947 by default), 
	  waiting for applications to request information from GPSes or 
	  differential-GPS radios attached to the host machine. Each GPS or 
	  radio is expected to be direct-connected to the host via a USB or 
	  RS232C serial port. The port may be specified to gpsd at startup, or 
	  it may be set via a command shipped down a local control socket (e.g. 
	  by a USB hotplug script). Given a GPS device by either means, gpsd 
	  discovers the correct port speed and protocol for it.
	  
	  http://gpsd.berlios.de/
```

## openwrt/package/haserl/Config.in
```kconfig
config BR2_PACKAGE_HASERL
	prompt "haserl............................ A CGI wrapper to embed shell scripts in HTML documents"
	tristate
	default m if CONFIG_DEVEL
	help
	  A CGI wrapper to embed shell scripts in HTML documents.
	  
	  http://haserl.sourceforge.net/
```

## openwrt/package/hdparm/Config.in
```kconfig
config BR2_PACKAGE_HDPARM
	prompt "hdparm............................ get/set ATA drive parameters"
	tristate
	default m if CONFIG_DEVEL
	help
	
	  tune hard disk parameters for high performance
	  Get/set hard disk parameters for Linux IDE drives.
	  Primary use is for enabling irq-unmasking and IDE multiplemode.

	  The original website:
	  http://sourceforge.net/projects/hdparm/
```

## openwrt/package/heyu/Config.in
```kconfig
config BR2_PACKAGE_HEYU
	prompt "heyu.............................. X10 home automation control using a CM11A"
	tristate
	default m if CONFIG_DEVEL
	help
	  X10 home automation control using the CM11A serial device.

          See http://heyu.tanj.com/heyu2/ for details.
```

## openwrt/package/hostap-utils/Config.in
```kconfig
config BR2_PACKAGE_HOSTAP_UTILS
	prompt "hostap-utils...................... Host AP driver utility programs"
	tristate
	default m if CONFIG_DEVEL
	help
	  Host AP driver utility programs
	  
	  http://hostap.epitest.fi/
```
