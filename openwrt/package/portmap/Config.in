## openwrt/package/portmap/Config.in
```kconfig
config BR2_PACKAGE_PORTMAP
	tristate "portmap - RPC Portmapper"
	default m if CONFIG_DEVEL
	help
	  The RPC Portmapper (used by the NFS Server)
	  
	
```

## openwrt/package/portsentry/Config.in
```kconfig
config BR2_PACKAGE_PORTSENTRY
	tristate "portsentry"
	default m if CONFIG_DEVEL
	help
	  Software for protection against port scans
	  
	  http://sourceforge.net/projects/sentrytools
	  
```

## openwrt/package/postgresql/Config.in
```kconfig
config BR2_COMPILE_POSTGRESQL
	tristate
	default n
	depends BR2_PACKAGE_LIBPQ

config BR2_PACKAGE_LIBPQ
	prompt "libpq............................. PostgreSQL client library"
	tristate
	default m if CONFIG_DEVEL
	select BR2_COMPILE_POSTGRESQL
	help
	  PostgreSQL is an object-relational database management system (ORDBMS) 
	  based on POSTGRES, Version 4.2, developed at the University of 
	  California at Berkeley Computer Science Department. POSTGRES pioneered 
	  many concepts that only became available in some commercial database 
	  systems much later.

	  PostgreSQL is an open-source descendant of this original Berkeley code. 
	  It supports SQL92 and SQL99 and offers many modern features:

	    * complex queries
	    * foreign keys
	    * triggers
	    * views
	    * transactional integrity
	    * multiversion concurrency control
	  
	  http://www.postgresql.org/
	  
	  This package contains the shared client library, needed by other programs.

config BR2_PACKAGE_PGSQL_CLI
	prompt   "pgsql-cli....................... Command Line Interface (CLI) to PostgreSQL databases"
	tristate
	default m if CONFIG_DEVEL
	depends BR2_PACKAGE_LIBPQ
	help
	  PostgreSQL is an object-relational database management system (ORDBMS) 
	  based on POSTGRES, Version 4.2, developed at the University of 
	  California at Berkeley Computer Science Department. POSTGRES pioneered 
	  many concepts that only became available in some commercial database 
	  systems much later.

	  PostgreSQL is an open-source descendant of this original Berkeley code. 
	  It supports SQL92 and SQL99 and offers many modern features:

	    * complex queries
	    * foreign keys
	    * triggers
	    * views
	    * transactional integrity
	    * multiversion concurrency control
	  
	  http://www.postgresql.org/
	  
	  This package contains a terminal-based front-end to PostgreSQL. It enables 
	  you to type in queries interactively, issue them to PostgreSQL, and see the 
	  query results.  Alternatively, input can be from a file. In addition, it 
	  provides a number of  meta-commands  and  various  shell-like features to 
	  facilitate writing scripts and automating a wide variety of tasks.
```

## openwrt/package/ppp/Config.in
```kconfig
menu "ppp............................... PPP (Point-to-Point Protocol) daemon"

config PACKAGE_PPP
	prompt "ppp............................... PPP (Point-to-Point Protocol) daemon"
	tristate
	default n if LINUX_2_6_ARUBA
	default y
	select PACKAGE_KMOD_PPP

config PACKAGE_PPP_WITH_FILTER
	prompt "Enable filter support"
	bool
	default y

config PACKAGE_PPP_MOD_PPPOA
	prompt   "ppp-mod-pppoa................... PPPoA (PPP over ATM) plugin"
	tristate
	default y if LINUX_2_4_AR7
	depends on PACKAGE_PPP
	select PACKAGE_KMOD_PPPOATM

config PACKAGE_PPP_MOD_PPPOE
	prompt   "ppp-mod-pppoe................... PPPoE (PPP over Ethernet) plugin"
	tristate
	default y
	depends on PACKAGE_PPP
	select PACKAGE_KMOD_PPPOE

config PACKAGE_PPP_MOD_RADIUS
	prompt   "ppp-mod-radius.................. RADIUS (Remote Authentication Dial-In User Service) plugin"
	tristate
	default m if DEVEL
	depends on PACKAGE_PPP

config PACKAGE_CHAT
	prompt   "chat............................ Utility to establish conversation with other PPP servers (via a modem)"
	tristate
	default m if DEVEL
	depends on PACKAGE_PPP

config PACKAGE_PPPDUMP
	prompt   "pppdump......................... Utility to read PPP record file"
	tristate
	default m if DEVEL
	depends on PACKAGE_PPP

config PACKAGE_PPPSTATS
	prompt   "pppstats........................ Utility to report PPP statistics"
	tristate
	default m if DEVEL
	depends on PACKAGE_PPP

endmenu
```

## openwrt/package/pptp/Config.in
```kconfig
config BR2_PACKAGE_PPTP
	prompt "pptp.............................. PPTP (Point-to-Point Tunneling Protocol) client"
	tristate
	default m if CONFIG_DEVEL
	select BR2_PACKAGE_KMOD_GRE
	select BR2_PACKAGE_PPP
	help
	  A Point-to-Point Tunneling Protocol Client 
	  
	  http://pptpclient.sourceforge.net/
```

## openwrt/package/pptpd/Config.in
```kconfig
config BR2_PACKAGE_PPTPD
	prompt "pptpd - PPTP (Point-to-Point Tunneling Protocol) server"
	tristate
	default m if CONFIG_DEVEL
	select BR2_PACKAGE_KMOD_GRE
	select BR2_PACKAGE_PPP
	help
	  A Point-to-Point Tunneling Protocol server
	  
	  http://poptop.sourceforge.net/
	  
```

## openwrt/package/privoxy/Config.in
```kconfig
config BR2_PACKAGE_PRIVOXY
	prompt "privoxy........................... web proxy with advanced filtering capabilities"
	tristate
	default m if CONFIG_DEVEL
	help

	  Privoxy is a web proxy with advanced filtering capabilities for
	  protecting privacy, modifying web page content, managing cookies,
	  controlling access, and removing ads, banners, pop-ups and other
	  obnoxious Internet junk. Privoxy has a very flexible configuration
	  and can be customized to suit individual needs and tastes. Privoxy
	  has application for both stand-alone systems and multi-user networks.
	  
	  http://www.privoxy.org/
```

## openwrt/package/procmail/Config.in
```kconfig
config BR2_PACKAGE_PROCMAIL
	prompt "procmail.......................... mail processing tool"
	tristate
	default n
	help
	  Procmail is able to process and classify incoming mail into
	  different mail boxes.

	  Very useful in conjunction with mutt.
	
	  http://www.procmail.org
```

## openwrt/package/psybnc/Config.in
```kconfig
config BR2_PACKAGE_PSYBNC
	prompt "psybnc............................ An IRC-Bouncer with many features"
	tristate
	default m if CONFIG_DEVEL
	help
	  psyBNC is an easy-to-use, multi-user, permanent 
	  IRC-Bouncer with many features. Some of its features
	  vhost- and relay support to connected bouncers and an 
	  extensive online help system. Many other helpful 
	  functions are included.
	  
	  http://www.psybnc.info/
```

## openwrt/package/pwlib/Config.in
```kconfig
config BR2_COMPILE_PWLIB
#	prompt "pwlib............................. Portable Windows library"
	tristate
	select BR2_PACKAGE_LIBPTHREAD
	default n
	help
	  Portable Windows library
```

## openwrt/package/quagga/Config.in
```kconfig
menu "quagga............................ The Quagga Software Routing Suite"

config BR2_PACKAGE_QUAGGA
	prompt "quagga............................ The Quagga Software Routing Suite"
	tristate
	default m if CONFIG_DEVEL
	help
	  A routing software package that provides TCP/IP based routing services
	  with routing protocols support such as RIPv1, RIPv2, RIPng, OSPFv2, 
	  OSPFv3, BGP-4, and BGP-4+
	  
	  http://www.quagga.net/

config BR2_PACKAGE_QUAGGA_BGPD
	prompt   "quagga-bgpd..................... BGPv4, BGPv4+, BGPv4- routing engine"
	tristate
	default m if CONFIG_DEVEL
	depends BR2_PACKAGE_QUAGGA
	help
	  A BGPv4, BGPv4+, BGPv4- routing engine for use with Quagga routing
	  software.

config BR2_PACKAGE_QUAGGA_OSPFD
	prompt   "quagga-ospfd.................... OSPFv2 routing engine"
	tristate
	default m if CONFIG_DEVEL
	depends BR2_PACKAGE_QUAGGA
	help
	  An OSPFv2 (IPv4) routing engine for use with Quagga routing software.

config BR2_PACKAGE_QUAGGA_OSPF6D
	prompt   "quagga-ospf6d................... OSPFv3 routing engine"
	tristate
	default m if CONFIG_DEVEL
	depends BR2_PACKAGE_QUAGGA
	help
	  An OSPFv3 (IPv6) routing engine for use with Quagga routing software.

config BR2_PACKAGE_QUAGGA_RIPD
	prompt   "quagga-ripd..................... RIP routing engine"
	tristate
	default m if CONFIG_DEVEL
	depends BR2_PACKAGE_QUAGGA
	help
	  A RIP (IPv4) routing engine for use with Quagga routing software.

config BR2_PACKAGE_QUAGGA_RIPNGD
	prompt   "quagga-ripngd................... RIPNG routing engine"
	tristate
	default m if CONFIG_DEVEL
	depends BR2_PACKAGE_QUAGGA
	help
	  A RIPNG (IPv6) routing engine for use with Quagga routing software.

config BR2_PACKAGE_QUAGGA_VTYSH
	prompt   "quagga-vtysh.................... integrated shell for Quagga routing software"
	tristate
	default m if CONFIG_DEVEL
	depends BR2_PACKAGE_QUAGGA
	select BR2_PACKAGE_LIBREADLINE
	select BR2_PACKAGE_LIBNCURSES
	help
	  vtysh lets you interact with all the Quagga routing daemons
	  at once in an integrated shell.

endmenu
```

## openwrt/package/raddump/Config.in
```kconfig
config BR2_PACKAGE_RADDUMP
        prompt "raddump........................... raddump interprets captured RADIUS packets."
	tristate
	default m if CONFIG_DEVEL
	select BR2_PACKAGE_LIBOPENSSL
	select BR2_PACKAGE_LIBPCAP
	help
		raddump interprets captured RADIUS packets to print a
		timestamp, packet length, RADIUS packet type, source and
		destination hosts and ports, and included attribute names and
		values for each packet.
```

## openwrt/package/radiusclient-ng/Config.in
```kconfig
config BR2_COMPILE_RADIUSCLIENT_NG
	tristate
	default n
	depends BR2_PACKAGE_LIBRADIUSCLIENT_NG

config BR2_PACKAGE_RADIUSCLIENT_NG
	prompt "radiusclient-ng................... RADIUS client"
	tristate
	default m if CONFIG_DEVEL
	select BR2_PACKAGE_LIBOPENSSL
	select BR2_PACKAGE_LIBRADIUSCLIENT_NG
	help
	  Purpose of this project is to build portable, easy-to-use and standard compliant 
	  library suitable for developing free and commercial software that need support 
	  for a RADIUS protocol (RFCs 2128 and 2139).

	  http://developer.berlios.de/projects/radiusclient-ng/

	  Depends: libopenssl

config BR2_PACKAGE_LIBRADIUSCLIENT_NG
	prompt "libradiusclient-ng................ RADIUS client library"
	tristate
	default m if CONFIG_DEVEL
	select BR2_COMPILE_RADIUSCLIENT_NG
	help
	  Developpment library from radiusclient-ng
```

## openwrt/package/radvd/Config.in
```kconfig
config BR2_PACKAGE_RADVD
	prompt "radvd............................. IPv6 Routing Advertisement Daemon"
	tristate
	default m if CONFIG_DEVEL
	select BR2_PACKAGE_KMOD_IPV6
	help
	  Routing Advertisement Daemon for IPv6
	  
	  http://v6web.litech.org/radvd/
```

## openwrt/package/rarpd/Config.in
```kconfig
config BR2_PACKAGE_RARPD
	prompt "rarpd............................. Reverse ARP Daemon"
	tristate
	default m if CONFIG_DEVEL
	select BR2_PACKAGE_LIBNET
	help
	  Rarpd  is  a  daemon  which responds to RARP requests.
	  RARP is used by some machines at boot time to discover their
	  IP address.  They  provide their  Ethernet address and rarpd
	  responds with their IP address if it finds it in the ethers
	  database.
	  
	  ftp://ftp.dementia.org/pub/net-tools/
```

## openwrt/package/robocfg/Config.in
```kconfig
config BR2_PACKAGE_ROBOCFG
	prompt "robocfg........................... BCM5325E/536x switch configuration utility"
	tristate
	default m if CONFIG_DEVEL
	help
	  Broadcom BCM5325E/536x switch configuration utility
```

## openwrt/package/rp-l2tp/Config.in
```kconfig
#menu "rp-l2tp............................ Roaring Penguin PPPoE (PPP over Ethernet) implementation"

config BR2_COMPILE_RP_L2TP
	tristate
	default n
	depends BR2_PACKAGE_RP_L2TPD

config BR2_PACKAGE_RP_L2TPD
	prompt "rp-l2tpd.......................... an L2TP (Layer 2 Tunneling Protocol) daemon"
	tristate
	default m if CONFIG_DEVEL
	select BR2_COMPILE_RP_L2TP
	help
	  An L2TP (Layer 2 Tunneling Protocol) daemon.
	  
	  http://sourceforge.net/projects/rp-l2tp/

config BR2_PACKAGE_RP_L2TPD_MOD_CMD
	prompt   "rp-l2tpd-mod-cmd................ a simple command handler for the L2TP daemon"
	tristate
	default m if CONFIG_DEVEL
	depends BR2_PACKAGE_RP_L2TPD
	help
	  A simple command handler for the L2TP daemon.

config BR2_PACKAGE_RP_L2TPD_MOD_PPP
	prompt   "rp-l2tpd-mod-ppp................ a PPP handler for the L2TP daeomon"
	tristate
	default m if CONFIG_DEVEL
	depends BR2_PACKAGE_RP_L2TPD
	help
	  A PPP handler for the L2TP daeomon.

#endmenu
```

## openwrt/package/rp-pppoe/Config.in
```kconfig
#menu "rp-pppoe.......................... Roaring Penguin PPPoE (PPP over Ethernet) implementation"

config BR2_COMPILE_RP_PPPOE
	tristate
	default n
	depends BR2_PACKAGE_PPPOE_CLIENT || BR2_PACKAGE_PPPOE_RELAY || BR2_PACKAGE_PPPOE_SERVER || BR2_PACKAGE_PPPOE_SNIFF

config BR2_PACKAGE_PPPOE_CLIENT
	prompt "pppoe-client...................... PPPoE (PPP over Ethernet) client"
	tristate
	default m if CONFIG_DEVEL
	select BR2_COMPILE_RP_PPPOE
	select BR2_PACKAGE_PPP
	help
	  PPPoE (PPP over Ethernet) client
	  
	  http://roaringpenguin.com/penguin/open_source_rp-pppoe.php

config BR2_PACKAGE_PPPOE_RELAY
	prompt "pppoe-relay....................... PPPoE (PPP over Ethernet) relay"
	tristate
	default m if CONFIG_DEVEL
	select BR2_COMPILE_RP_PPPOE
	help
	  PPPoE (PPP over Ethernet) relay
	  
	  http://roaringpenguin.com/penguin/open_source_rp-pppoe.php

config BR2_PACKAGE_PPPOE_SERVER
	prompt "pppoe-server...................... PPPoE (PPP over Ethernet) server"
	tristate
	default m if CONFIG_DEVEL
	select BR2_COMPILE_RP_PPPOE
	select BR2_PACKAGE_PPP
	help
	  PPPoE (PPP over Ethernet) server
	  
	  http://roaringpenguin.com/penguin/open_source_rp-pppoe.php

config BR2_PACKAGE_PPPOE_SNIFF
	prompt "pppoe-sniff....................... PPPoE (PPP over Ethernet) frame sniffer"
	tristate
	default m if CONFIG_DEVEL
	select BR2_COMPILE_RP_PPPOE
	help
	  PPPoE (PPP over Ethernet) frame sniffer
	  
	  http://roaringpenguin.com/penguin/open_source_rp-pppoe.php

#endmenu
```

## openwrt/package/rrdcollect/Config.in
```kconfig
config BR2_PACKAGE_RRDCOLLECT
	tristate "rrdcollect - Round-Robin Database Collecting Daemon"
	default m if CONFIG_DEVEL
	select BR2_PACKAGE_LIBRRD
	help
	  RRDcollect is a daemon which polls ceratin files in /proc/
	  directory, gathering data and storing it inside RRDtool's
	  database files.  Being written in C should be both fast
	  and resources-friendly.  Supports both scanf(3)-style
	  pattern matches and perl compatible regular expressions.
	  
	  http://rrdcollect.sourceforge.net/
	  
	
```
