## openwrt/package/rrdtool1/Config.in
```kconfig
config BR2_COMPILE_RRDTOOL1
	prompt "rrdtool1.......................... Round Robin Database (RRD) tools (v1.0.x)"
	tristate
	default m if CONFIG_DEVEL

config BR2_PACKAGE_LIBRRD1
	prompt   "librrd1......................... Round Robin Database (RRD) management library (v1.0.x)"
	tristate
	default m if CONFIG_DEVEL
	depends BR2_COMPILE_RRDTOOL1
	select BR2_PACKAGE_ZLIB
	help
	  RRD is the Acronym for Round Robin Database. RRD is a system to store and
	  display time-series data (i.e. network bandwidth, machine-room temperature,
	  server load average). It stores the data in a very compact way that will
	  not expand over time, and it presents useful graphs by processing the data
	  to enforce a certain data density. It can be used either via simple wrapper
	  scripts (from shell or Perl) or via frontends that poll network devices and
	  put friendly user interface on it.
	  
	  http://people.ee.ethz.ch/~oetiker/webtools/rrdtool/
	  
	  This package contains command line tools used to manage RRDs.
	  
	  This is version 1.0.x with cgilib-0.4, gd1.3 and libpng-1.0.9 linked into 
	  librrd.so. The library is much smaller compared to the 1.2.x version with 
	  separate dynamic linked libraries.

config BR2_PACKAGE_RRDCGI1
	prompt   "rrdcgi1......................... Round Robin Database (RRD) CGI graphing tool (v1.0.x)"
	tristate
	default m if CONFIG_DEVEL
	depends BR2_COMPILE_RRDTOOL1
	select BR2_PACKAGE_LIBRRD1
	help
	  RRD is the Acronym for Round Robin Database. RRD is a system to store and
	  display time-series data (i.e. network bandwidth, machine-room temperature,
	  server load average). It stores the data in a very compact way that will
	  not expand over time, and it presents useful graphs by processing the data
	  to enforce a certain data density. It can be used either via simple wrapper
	  scripts (from shell or Perl) or via frontends that poll network devices and
	  put friendly user interface on it.
	  
	  http://people.ee.ethz.ch/~oetiker/webtools/rrdtool/
	  
	  This package contains the rrdcgi tool used to create web pages containing 
	  RRD graphs based on templates.
	  
	  This is version 1.0.x with cgilib-0.4, gd1.3 and libpng-1.0.9 linked into 
	  librrd.so. The library is much smaller compared to the 1.2.x version with 
	  separate dynamic linked libraries.

config BR2_PACKAGE_RRDTOOL1
	prompt   "rrdtool1........................ Round Robin Database (RRD) management tools (v1.0.x)"
	tristate
	default m if CONFIG_DEVEL
	depends BR2_COMPILE_RRDTOOL1
	select BR2_PACKAGE_LIBRRD1
	help
	  RRD is the Acronym for Round Robin Database. RRD is a system to store and
	  display time-series data (i.e. network bandwidth, machine-room temperature,
	  server load average). It stores the data in a very compact way that will
	  not expand over time, and it presents useful graphs by processing the data
	  to enforce a certain data density. It can be used either via simple wrapper
	  scripts (from shell or Perl) or via frontends that poll network devices and
	  put friendly user interface on it.
	  
	  http://people.ee.ethz.ch/~oetiker/webtools/rrdtool/
	  
	  This package contains command line tools used to manage RRDs.
	  
	  This is version 1.0.x with cgilib-0.4, gd1.3 and libpng-1.0.9 linked into 
	  librrd.so. The library is much smaller compared to the 1.2.x version with 
	  separate dynamic linked libraries.
```

## openwrt/package/rrs/Config.in
```kconfig
#menu "rrs............................... A reverse (connecting) remote shell"

config BR2_COMPILE_RRS
	tristate
	default n
	depends BR2_PACKAGE_RRS || BR2_PACKAGE_RRS_NOSSL

config BR2_PACKAGE_RRS
	prompt "rrs............................... A reverse (connecting) remote shell, with SSL support"
	tristate
	default m if CONFIG_DEVEL
	select BR2_COMPILE_RRS
	select BR2_PACKAGE_UCLIBCXX
	select BR2_PACKAGE_LIBOPENSSL
	help
	  A reverse (connecting) remote shell, built with SSL support.
	  
	  http://www.cycom.se/dl/rrs/

config BR2_PACKAGE_RRS_NOSSL
	prompt "rrs-nossl......................... A reverse (connecting) remote shell, without SSL support"
	tristate
	default m if CONFIG_DEVEL
	select BR2_COMPILE_RRS
	select BR2_PACKAGE_UCLIBCXX
	help
	  A reverse (connecting) remote shell, built without SSL support.
	  
	  http://www.cycom.se/dl/rrs/

#endmenu
```

## openwrt/package/rsync/Config.in
```kconfig
config BR2_PACKAGE_RSYNC
	prompt "rsync............................. file transfer utility"
	tristate
	select BR2_PACKAGE_LIBPOPT
	default m if CONFIG_DEVEL
	help
	  An utility that provides fast incremental file transfer
	  
	  http://rsync.samba.org
```

## openwrt/package/sablevm-classpath/Config.in
```kconfig
config BR2_COMPILE_SABLEVM_CLASSPATH
	tristate
	default n
	depends BR2_PACKAGE_LIBSABLEVM_CLASSPATH

config BR2_PACKAGE_LIBSABLEVM_CLASSPATH
	prompt "libsablevm-classpath.............. Essential native libraries for Java"
	tristate
	default m if CONFIG_DEVEL
	select BR2_COMPILE_SABLEVM_CLASSPATH
	help
	  GNU Classpath, Essential Libraries for Java, is a GNU project to create 
	  free core class libraries for use with virtual machines and compilers for 
	  the java programming language.
	  
	  This is a modified version for use with SableVM.
	  
	  http://www.gnu.org/software/classpath/
	  
	  This package contains the native shared libraries, needed by other packages.

choice
	prompt   "sablevm-classpath............... Essential classes for Java"
	tristate
	depends BR2_PACKAGE_LIBSABLEVM_CLASSPATH
	optional

config BR2_PACKAGE_SABLEVM_CLASSPATH_FULL
	prompt     "sablevm-classpath-full........ Full set"
	tristate
	help
	  GNU Classpath, Essential Libraries for Java, is a GNU project to create 
	  free core class libraries for use with virtual machines and compilers for 
	  the java programming language.
	  
	  This is a modified version for use with SableVM.
	  
	  http://www.gnu.org/software/classpath/
	  
	  This package contains the full set of Java compiled classes.
	  It will unlikely fit on your router as-is.

config BR2_PACKAGE_SABLEVM_CLASSPATH_MINI
	prompt     "sablevm-classpath-mini........ Minimal set"
	tristate
	help
	  
	  GNU Classpath, Essential Libraries for Java, is a GNU project to create 
	  free core class libraries for use with virtual machines and compilers for 
	  the java programming language.
	  
	  This is a modified version for use with SableVM.
	  
	  http://www.gnu.org/software/classpath/
	  
	  This package contains only a minimal set of Java compiled classes, just 
	  enough to run the famous "Hello World !" test program.

endchoice
```

## openwrt/package/sablevm/Config.in
```kconfig
config BR2_PACKAGE_SABLEVM
	tristate "sablevm - A Java Virtual Machine (JVM) implementation"
#	default m if CONFIG_DEVEL
	default n
	select BR2_PACKAGE_LIBFFI_SABLE
	select BR2_PACKAGE_LIBLTDL
	select BR2_PACKAGE_LIBPOPT
	select BR2_PACKAGE_ZLIB
	help
	  SableVM is a robust, extremely portable, efficient, and specifications-
	  -compliant Java virtual machine that aims to be easy to maintain and to 
	  extend. It features a state-of-the-art and efficient interpreter engine. 
	  Its source code is very accessible and easy to understand. It also has 
	  many robustness features that have been the object of careful design.  
	  
	  http://sablevm.org/
	  
```

## openwrt/package/sane-backends/Config.in
```kconfig
config BR2_PACKAGE_SANE_BACKENDS
	prompt "sane-backends........................ scanner access now easy"
	tristate
	default m if CONFIG_DEVEL
	help
	  Scanner access now easy
	  
	  http://www.sane-project.org
```
