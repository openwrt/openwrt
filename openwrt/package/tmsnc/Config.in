## openwrt/package/tmsnc/Config.in
```kconfig
config BR2_PACKAGE_TMSNC
	tristate "tmsnc............................. text-based MSN client"
	default m if CONFIG_DEVEL
	help
		TMSNC is a textbased (console) MSN client written in C.

		http://tmsnc.sourceforge.net
```

## openwrt/package/tor/Config.in
```kconfig
config BR2_PACKAGE_TOR
	tristate "tor - An anonymous Internet communication system"
	default m if CONFIG_DEVEL
	select BR2_PACKAGE_LIBEVENT
	select BR2_PACKAGE_LIBOPENSSL
	select BR2_PACKAGE_LIBPTHREAD
	select BR2_PACKAGE_ZLIB
	help
	  Tor is a toolset for a wide range of organizations and people that want
	  to improve their safety and security on the Internet. Using Tor can 
	  help you anonymize web browsing and publishing, instant messaging, 
	  IRC, SSH, and more. Tor also provides a platform on which software 
	  developers can build new applications with built-in anonymity, safety, 
	  and privacy features.
	  
	  http://tor.eff.org/
	  
```

## openwrt/package/ttcp/Config.in
```kconfig
config BR2_PACKAGE_TTCP
	prompt "ttcp.............................. A TCP connection performance tester"
	tristate
	default m if CONFIG_DEVEL
	help
	  A small utility to test TCP connection performance
```

## openwrt/package/uclibc++/Config.in
```kconfig
config BR2_PACKAGE_UCLIBCXX
	prompt "uClibc++.......................... C++ library for embedded systems"
	tristate
	default m if CONFIG_DEVEL
	help
	  A standard C++ library for embedded systems
```

## openwrt/package/ulogd/Config.in
```kconfig
menu "ulogd............................. Netfilter userspace logging daemon"

config BR2_PACKAGE_ULOGD
	prompt "ulogd............................. Netfilter userspace logging daemon"
	tristate
	default m if CONFIG_DEVEL
	select BR2_PACKAGE_IPTABLES
	help
	  The netfilter userspace logging daemon
	  
	  http://gnumonks.org/projects/ulogd

config BR2_PACKAGE_ULOGD_MOD_MYSQL
	prompt   "ulogd-mod-mysql................. Output plugin for logging into a MySQL database"
	tristate
	default m if CONFIG_DEVEL
	depends BR2_PACKAGE_ULOGD
	select BR2_PACKAGE_LIBMYSQLCLIENT

config BR2_PACKAGE_ULOGD_MOD_PCAP
        prompt  "ulogd-mod-pcap................... Output plugin for logging into pcap format"
	tristate
	default m if CONFIG_DEVEL
	depends BR2_PACKAGE_ULOGD
	select BR2_PACKAGE_LIBPCAP

config BR2_PACKAGE_ULOGD_MOD_PGSQL
	prompt   "ulogd-mod-pgsql................. Output plugin for logging into a PostgreSQL database"
	tristate
	default m if CONFIG_DEVEL
	depends BR2_PACKAGE_ULOGD
	select BR2_PACKAGE_LIBPQ

config BR2_PACKAGE_ULOGD_MOD_SQLITE
	prompt   "ulogd-mod-sqlite................ Output plugin for logging into an SQLite database"
	tristate
	default m if CONFIG_DEVEL
	depends BR2_PACKAGE_ULOGD
	select BR2_PACKAGE_LIBSQLITE

config BR2_PACKAGE_ULOGD_MOD_EXTRA
	prompt   "ulogd-mod-extra................. All other plugins"
	tristate
	default m if CONFIG_DEVEL
	depends BR2_PACKAGE_ULOGD

endmenu
```

## openwrt/package/updatedd/Config.in
```kconfig
menu "updatedd.......................... A tool to update dynamic dns services"

config BR2_PACKAGE_UPDATEDD
	prompt "updatedd.......................... A tool to update dynamic DNS services"
	tristate
	default m if CONFIG_DEVEL
	help
	  Updatedd is a small tool that will update one of many dynamic
	  dns services on boot.
	  
	  Please look at the /etc/init.d/S50ddns script for more info.
	  
	  http://www.philipp-benner.de/updatedd/

if BR2_PACKAGE_UPDATEDD
comment          "Plugin                           Dynamic DNS service"
endif

config BR2_PACKAGE_UPDATEDD_MOD_CHANGEIP
	prompt   "updatedd-mod-changeip........... changeip.com"
	tristate
	depends on BR2_PACKAGE_UPDATEDD
	default m if CONFIG_DEVEL

config BR2_PACKAGE_UPDATEDD_MOD_DYNDNS
	prompt   "updatedd-mod-dyndns............. dyndns.org"
	tristate
	depends on BR2_PACKAGE_UPDATEDD
	default m if CONFIG_DEVEL

config BR2_PACKAGE_UPDATEDD_MOD_EURODYNDNS
	prompt   "updatedd-mod-eurodyndns......... eurodyndns.org"
	tristate
	depends on BR2_PACKAGE_UPDATEDD
	default m if CONFIG_DEVEL

config BR2_PACKAGE_UPDATEDD_MOD_HN
	prompt   "updatedd-mod-hn................. hn.org"
	tristate
	depends on BR2_PACKAGE_UPDATEDD
	default m if CONFIG_DEVEL

config BR2_PACKAGE_UPDATEDD_MOD_NOIP
	prompt   "updatedd-mod-noip............... no-ip.com"
	tristate
	depends on BR2_PACKAGE_UPDATEDD
	default m if CONFIG_DEVEL

config BR2_PACKAGE_UPDATEDD_MOD_ODS
	prompt   "updatedd-mod-ods................ ods.org"
	tristate
	depends on BR2_PACKAGE_UPDATEDD
	default m if CONFIG_DEVEL

config BR2_PACKAGE_UPDATEDD_MOD_OVH
	prompt   "updatedd-mod-ovh................ ovh.com"
	tristate
	depends on BR2_PACKAGE_UPDATEDD
	default m if CONFIG_DEVEL

config BR2_PACKAGE_UPDATEDD_MOD_REGFISH
	prompt   "updatedd-mod-regfish............ regfish.com"
	tristate
	depends on BR2_PACKAGE_UPDATEDD
	default m if CONFIG_DEVEL

config BR2_PACKAGE_UPDATEDD_MOD_TZO
	prompt   "updatedd-mod-tzo................ tzo.com"
	tristate
	depends on BR2_PACKAGE_UPDATEDD
	default m if CONFIG_DEVEL

endmenu
```

## openwrt/package/usbutils/Config.in
```kconfig
config BR2_COMPILE_USBUTILS
	tristate
	depends BR2_PACKAGE_LSUSB

config BR2_PACKAGE_LSUSB
	prompt "lsusb............................. USB devices listing program"
	tristate
	default m if CONFIG_DEVEL
	select BR2_COMPILE_USBUTILS
	select BR2_PACKAGE_LIBUSB
	help
	  A program to list Linux USB devices
	  
	  http://linux-usb.sourceforge.net/
```

## openwrt/package/ustl/Config.in
```kconfig
config BR2_PACKAGE_USTL
	prompt "ustl.............................. C++ Standard Template Library for embedded systems"
	tristate
	default m if CONFIG_DEVEL
	help
	  uSTL is a partial implementation of the STL (Standard Template 
	  Library) that reduces code size by factoring memory management 
	  code into a non-template base class and deriving containers 
	  from it.
	  
	  http://ustl.sourceforge.net/
```

## openwrt/package/util-linux/Config.in
```kconfig
menu "util-linux"

config BR2_COMPILE_UTIL_LINUX
	bool
	default n
	depends BR2_PACKAGE_FDISK || BR2_PACKAGE_SWAP_UTILS

config BR2_PACKAGE_FDISK
	prompt "fdisk............................. A partition table manipulation utility"
	tristate
	default m if CONFIG_DEVEL
	select BR2_COMPILE_UTIL_LINUX
	help
	  A partition table manipulation utility
	  
	  http://www.kernel.org/pub/linux/utils/util-linux/

config BR2_PACKAGE_SWAP_UTILS
	prompt "swap-utils........................ Swap space management utilities"
	tristate
	default m if CONFIG_DEVEL
	select BR2_COMPILE_UTIL_LINUX
	help
	  A collection of tools to manage swap space :
	    * mkswap
	    * swapon
	    * swapoff
	  
	  http://www.kernel.org/pub/linux/utils/util-linux/

endmenu
```

## openwrt/package/vgp/Config.in
```kconfig
config BR2_PACKAGE_VGP
	prompt "vgp............................... a daemon working like Cisco(c) HSRP"
	tristate
	default m if CONFIG_DEVEL
	help
		VGP (Virtual Gateway Protocol)is a very simple protocol able to
		work in a way similar to Cisco(c) HSRP. It implements the idea
		of Virtual Gateway to provide fault tollerance (and load
		balancing) on your net. Each client on your net has as its
		default gateway the virtual gateway and not the real router.

		http://vgpd.freaknet.org/
```

## openwrt/package/vim/Config.in
```kconfig
config BR2_PACKAGE_VIM
	prompt "vim............................... VI Improved"
	tristate
	default m if CONFIG_DEVEL
	select BR2_PACKAGE_LIBNCURSES
	help
	  An improved version of VI.
	  
	  http://www.vim.org
```

## openwrt/package/vnc-reflector/Config.in
```kconfig
config BR2_PACKAGE_VNC_REFLECTOR
        tristate "vnc-reflector....................... VNC proxy for multiple clients"
	default m if CONFIG_DEVEL
	depends on BR2_PACKAGE_JPEG
	depends on BR2_PACKAGE_ZLIB
	help
		VNC Reflector is a specialized VNC server which acts as a proxy sitting between real VNC server (a host) and a number of VNC clients. It was designed to work efficiently with large number of clients.
```

## openwrt/package/vncrepeater/Config.in
```kconfig
config BR2_PACKAGE_VNCREPEATER
	prompt "vncrepeater....................... UltraVNC repeater for Linux"
	tristate
	default m if CONFIG_DEVEL
	select BR2_PACKAGE_UCLIBCXX
	help
	  Viewer can be behind Nat router or directly connected to the internet

	  Instead of forwarding serveral ports, you only need to forward 1 port

	  If the PC that runs the Repeater has access to the local DNS server, 
	  you can use your local DNS names instead of 10.10.10.12.

	  This could be handy when you have a dynamic DHCP server allocating 
	  ip adresses for your PC.

	  http://ultravnc.sourceforge.net/addons/repeater.html
```

## openwrt/package/vnstat/Config.in
```kconfig
config BR2_PACKAGE_VNSTAT
	prompt "vnstat............................ Console-based network traffic monitor"
	tristate
	default m if CONFIG_DEVEL
	help
	  vnStat is a network traffic monitor for Linux that keeps a log of daily
	  network traffic for the selected interface(s). vnStat isn't a packet
	  sniffer. The traffic information is analyzed from the /proc -filesystem,
	  so vnStat can be used without root permissions.
	  .
	  http://humdi.net/vnstat/
```

## openwrt/package/vpnc/Config.in
```kconfig
config BR2_PACKAGE_VPNC
	prompt "vpnc.............................. VPN client for Cisco 3000"
	tristate
	default m if CONFIG_DEVEL
	select BR2_PACKAGE_KMOD_TUN
	select BR2_PACKAGE_LIBGPG_ERROR
	select BR2_PACKAGE_LIBGCRYPT
	help
		Client for cisco3000 VPN Concentrator.
```

## openwrt/package/vrrpd/Config.in
```kconfig
config BR2_PACKAGE_VRRPD
        prompt "vrrpd............................. Virtual Router Redundancy Protocol daemon"
	tristate
	default m if CONFIG_DEVEL
	help
	  VRRPd is an implementation of Virtual Router Redundancy
	  Protocol as specified in rfc2338.  VRRPd is interoperable with
	  other RFC-based VRRP implementations, including Cisco and
	  Juniper, and is included as a standard feature on ImageStream
	  routers.
	  
	  http://www.sourceforge.net/projects/vrrpd
```

## openwrt/package/vsftpd/Config.in
```kconfig
config BR2_PACKAGE_VSFTPD
	prompt "vsftpd............................ Fast and secure FTP server"
	tristate
	default m if CONFIG_DEVEL
	help
	  A fast and secure FTP server
	  
	  http://vsftpd.beasts.org/
```

## openwrt/package/vtun/Config.in
```kconfig
config BR2_PACKAGE_VTUN
	prompt "vtun.............................. VPN tunneling daemon"
	tristate
	default m if CONFIG_DEVEL
	select BR2_PACKAGE_LIBLZO
	select BR2_PACKAGE_LIBOPENSSL
	select BR2_PACKAGE_ZLIB
	help
	  A VPN tunneling daemon
	  
	  http://vtun.sourceforge.net
```

## openwrt/package/wakelan/Config.in
```kconfig
config BR2_PACKAGE_WAKELAN
	prompt "wakelan........................... Send a wake-on-lan packet"
	tristate
	default m if CONFIG_DEVEL
	help
	  WakeLan sends a properly formatted UDP packet across the network 
	  which will cause a wake-on-lan enabled computer to power on.
```

## openwrt/package/watchdog/Config.in
```kconfig
config BR2_PACKAGE_WATCHDOG
	prompt "watchdog.......................... configurable watchdog"
	tristate
	default m if CONFIG_DEVEL
	help
	  watchdog
	  
```

## openwrt/package/wccpd/Config.in
```kconfig
config BR2_PACKAGE_WCCPD
	prompt "wccpd............................. a Web Cache Coordination daemon"
	tristate
	default m if CONFIG_DEVEL
	help
		wccpd is a WCCP (Web Cache Coordination Protocol) server daemon
		It allows a router (running Linux) to redirect web traffic to a
		group of Squid servers using WCCP as the monitoring/controling 
		protocol.

		http://wccpd.sourceforge.net/
```

## openwrt/package/weechat/Config.in
```kconfig
menu "weechat........................... Lightweight IRC client"

config BR2_PACKAGE_WEECHAT
	prompt "weechat.......................... Lightweight IRC client"
	tristate
	default m if CONFIG_DEVEL
	select BR2_PACKAGE_LIBNCURSES
	help
	  Fast, light & extensible IRC client

	  http://weechat.flashtux.org

config BR2_COMPILE_WEECHAT_WITH_TLS
	prompt "Enable TLS support"
	bool
	select BR2_PACKAGE_LIBGNUTLS
	depends BR2_PACKAGE_WEECHAT

config BR2_COMPILE_WEECHAT_WITH_LUA
	prompt "Enable LUA scripting"
	bool
	select BR2_PACKAGE_LIBLUA
	depends BR2_PACKAGE_WEECHAT

endmenu
```

## openwrt/package/wificonf/Config.in
```kconfig
config PACKAGE_WIFICONF
	prompt "wificonf.......................... replacement utility for wlconf"
	tristate
	default y
	depends PACKAGE_NVRAM
	help
	  Replacement utility for wlconf
```

## openwrt/package/wifidog/Config.in
```kconfig
config BR2_PACKAGE_WIFIDOG
	prompt "wifidog........................... A wireless captive portal solution"
	tristate
	default m if CONFIG_DEVEL
	select BR2_PACKAGE_IPTABLES
	select BR2_PACKAGE_IPTABLES_EXTRA
	select BR2_PACKAGE_KMOD_IPTABLES_V4
	select BR2_PACKAGE_KMOD_IPTABLES_V4_EXTRA
	help
	  The Wifidog project is a complete and embeddable captive
	  portal solution for wireless community groups or individuals
	  who wish to open a free Hotspot while still preventing abuse
	  of their Internet connection.
	  
	  http://www.wifidog.org/
```

## openwrt/package/wireless-tools/Config.in
```kconfig
config BR2_PACKAGE_WIRELESS_TOOLS
	prompt "wireless-tools.................... Tools for manipulating Linux Wireless Extensions"
	tristate
	default y
	help
	  Tools for configuring Wireless Adapters implementing the "Wireless Extension"
```
