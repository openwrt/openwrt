## openwrt/package/wiviz/Config.in
```kconfig
config BR2_PACKAGE_WIVIZ
	tristate "wiviz - Wireless Network Visualization"
	default m if CONFIG_DEVEL
	help
	 Wireless Network Visualization

	 http://students.washington.edu/natetrue/wiviz/
```

## openwrt/package/wknock/Config.in
```kconfig
config BR2_PACKAGE_WKNOCK
	prompt "wknock............................ A tool to hide your Access Point against opportunistic attackers."
	tristate
	default m if CONFIG_DEVEL
	select BR2_PACKAGE_LIBPCAP
	help
	  A tool to hide your Access Point against opportunistic attackers.
	  
	  http://www.rstack.org/oudot/wknock/
```

## openwrt/package/wol/Config.in
```kconfig
config BR2_PACKAGE_WOL
	prompt "wol............................... Wake On LAN client"
	tristate
	default m if CONFIG_DEVEL
	help
	  wol implements Wake On LAN functionality in a small program. 
	  It wakes up hardware that is Magic Packet compliant.
	  
	  http://ahh.sourceforge.net/wol/
```

## openwrt/package/wondershaper/Config.in
```kconfig
config BR2_PACKAGE_WONDERSHAPER
	prompt "wondershaper...................... The Wonder Shaper"
	tristate
	default m if CONFIG_DEVEL
	select BR2_PACKAGE_TC
	help
	  WonderShaper is a tc based traffic shaping tool.
	  
	  Depends: tc
```

## openwrt/package/wpa_supplicant/Config.in
```kconfig
config BR2_PACKAGE_WPA_SUPPLICANT
	prompt "wpa_supplicant.................... WPA Supplicant with support for WPA and WPA2"
	tristate
	default m if CONFIG_DEVEL
	select BR2_PACKAGE_KMOD_MADWIFI
	select BR2_PACKAGE_LIBOPENSSL
	help
	  WPA Supplicant with support for WPA and WPA2 (IEEE 802.11i / RSN).
	  Supplicant is the IEEE 802.1X/WPA component that is used in the client 
	  stations. It implements key negotiation with a WPA Authenticator and it 
	  controls the roaming and IEEE 802.11 authentication/association.
	  
	  http://hostap.epitest.fi/wpa_supplicant/
	  
	  Depends: openssl
```

## openwrt/package/wput/Config.in
```kconfig
config BR2_PACKAGE_WPUT
	prompt "wput.............................. A wget-like command-line FTP client"
	tristate
	default m if CONFIG_DEVEL
	help
	  A wget-like command-line FTP client.
	  
	  http://itooktheredpill.dyndns.org/wput/
```

## openwrt/package/wx200d/Config.in
```kconfig
config BR2_PACKAGE_WX200D
	prompt "wx200d............................ weather station data collector"
	tristate
	default m if CONFIG_DEVEL
	select BR2_PACKAGE_LIBPQ
	help
		wx200d is a weather station data collector and server daemon 
		for the WX200, WM918, WMR918 and WMR968 weather station 
		hardware.

		http://wx200d.sourceforge.net/
```

## openwrt/package/xinetd/Config.in
```kconfig
config BR2_PACKAGE_XINETD
	prompt "xinetd............................ Powerful and secure superserver"
	tristate
	default m if CONFIG_DEVEL
	help
	  A powerful and secure superserver
	  
	  http://www.xinetd.org/
```

## openwrt/package/xsupplicant/Config.in
```kconfig
config BR2_PACKAGE_XSUPPLICANT
	prompt "xsupplicant....................... A fully compliant 802.1x authenticator"
	tristate
	default m if CONFIG_DEVEL
	select BR2_PACKAGE_LIBOPENSSL
	select BR2_PACKAGE_WIRELESS_TOOLS
	help
	  This software allows a GNU/Linux or BSD workstation to authenticate with
	  a RADIUS server using 802.1x and various EAP protocols.
	  
	  http://open1x.sourceforge.net/
```

## openwrt/package/zlib/Config.in
```kconfig
config BR2_PACKAGE_ZLIB
	tristate "zlib"
	default m if CONFIG_DEVEL
	help
	  A library implementing the 'deflate' compression method
	  
	  http://www.zlib.net/
```

## openwrt/target/Config.in
```kconfig
choice
	prompt "Target System"
	default BR2_LINUX_2_4_BRCM
	
config BR2_LINUX_2_6_AU1000
	bool "AMD Alchemy 1xxx [2.6]"
	select BR2_mipsel
	select BR2_LINUX_2_6
	select BR2_LINUX_PCMCIA_SUPPORT
	help
	  Build firmware for AMD Alchemy 1500 boards
	  (e.g. 4G-Systems Mesh/Access Cube ...)

config BR2_LINUX_2_6_ARUBA
	bool "Aruba [2.6]"
	select BR2_mips
	select BR2_LINUX_2_6
	help
          Build firmware images for Aruba boards 

config BR2_LINUX_2_4_AR531X
	bool "Atheros AR531x [2.4]"
	select BR2_mips
	help
	  Build firmware images for Atheros AR531x based boards
	  (e.g. Netgear WGT624, Linksys WRT55AG)

config BR2_LINUX_2_4_BRCM
	bool "Broadcom BCM47xx/53xx [2.4]"
	select BR2_mipsel
	select BR2_LINUX_PCMCIA_SUPPORT
	help
	  Build firmware images for Broadcom based routers
	  (e.g. Linksys WRT54G(S), Asus WL-500g, Motorola WR850G)
	  
	  This one builds the generic .trx images, activate one of the
	  options below for creating device specific files for use 
	  with TFTP client too. 

config BR2_LINUX_2_6_BRCM
	bool "Broadcom BCM47xx/53xx [2.6]"
	select BR2_mipsel
	select BR2_LINUX_2_6
	select BR2_LINUX_PCMCIA_SUPPORT
	help
	  Build firmware images for Broadcom based routers
	  (e.g. Netgear WGT634u)

config BR2_LINUX_2_6_XSCALE
	bool "Intel XScale IXP42x [2.6]"
	select BR2_armeb
	select BR2_LINUX_2_6
	help
	  Build firmware image for Intel Xscale based routers
	  (e.g. Gateway 7001 series)

config BR2_LINUX_2_4_AR7
	bool "TI AR7 [2.4]"
	select BR2_mipsel
	help
	  Build firmware images for TI AR7 based routers (w.g. Linksys WAG54G v2)

config BR2_LINUX_2_4_X86
	bool "x86 [2.4]"
	select BR2_i386
	select BR2_LINUX_PCMCIA_SUPPORT
	help
	  Build firmware images for x86 based boards
	  (e.g. Soekris net4521 and net4801, PC Engines WRAP...)

config BR2_LINUX_2_6_X86
	bool "x86 [2.6]"
	select BR2_i386
	select BR2_LINUX_2_6
	select BR2_LINUX_PCMCIA_SUPPORT
	help
	  Build firmware images for x86 based boards
	  (e.g. Soekris net4521 and net4801, PC Engines WRAP...)

config BR2_LINUX_2_6_SIBYTE
	bool "SiByte [2.6]"
	select BR2_mips
	select BR2_LINUX_2_6

if CONFIG_DEVEL

config BR2_LINUX_2_6_MIPS64
	bool "UNSUPPORTED mips64 platform"
	select BR2_mips64

config BR2_LINUX_2_6_ARM
	bool "UNSUPPORTED little-endian arm platform"
	select BR2_arm

config BR2_LINUX_2_6_CRIS
	bool "UNSUPPORTED cris platform"
	select BR2_cris

config BR2_LINUX_2_6_M68K
	bool "UNSUPPORTED m68k platform"
	select BR2_m68k

config BR2_LINUX_2_6_PPC
	bool "UNSUPPORTED powerpc platform"
	select BR2_powerpc

config BR2_LINUX_2_6_SH3
	bool "UNSUPPORTED little-endian sh3 platform"
	select BR2_sh3

config BR2_LINUX_2_6_SH3EB
	bool "UNSUPPORTED big-endian sh3 platform"
	select BR2_sh3eb

config BR2_LINUX_2_6_SH4
	bool "UNSUPPORTED little-endian sh4 platform"
	select BR2_sh4

config BR2_LINUX_2_6_SH4EB
	bool "UNSUPPORTED big-endian sh4 platform"
	select BR2_sh4eb

config BR2_LINUX_2_6_SPARC
	bool "UNSUPPORTED sparc platform"
	select BR2_sparc

endif

endchoice

config BR2_LINUX_2_6
	bool
	default n
	depends BR2_LINUX_2_6_X86 || BR2_LINUX_2_6_BRCM || BR2_LINUX_2_6_ARUBA

config BR2_LINUX_PCMCIA_SUPPORT
	bool
	default n
	depends BR2_LINUX_2_4_X86 || BR2_LINUX_2_4_BRCM || BR2_LINUX_2_6_X86 || BR2_LINUX_2_6_BRCM
```

## openwrt/target/jffs2/Config.in
```kconfig
config BR2_TARGET_ROOTFS_JFFS2
	bool "jffs2 root filesystem for the target device"
	default n
	help
	  Build a jffs2 root filesystem
```
