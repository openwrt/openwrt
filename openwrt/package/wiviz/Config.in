## openwrt/target/linux/Config.in
```kconfig
menu "Target Root Filesystem"

	config BR2_TARGET_ROOTFS_JFFS2
		bool "jffs2"
		default y
		help
		  Build a jffs2 root filesystem

	config BR2_TARGET_ROOTFS_SQUASHFS_LZMA
		bool "squashfs-lzma"
		default y
		depends !BR2_LINUX_2_6_ARUBA
		depends !BR2_LINUX_2_6_XSCALE
		help
		  Build a squashfs-lzma root filesystem

	config BR2_TARGET_ROOTFS_TGZ
		bool "tgz"
		default y
		help
		  Build a compressed tar archive of the the root filesystem

endmenu

menu "Kernel Configuration / Device Support"

comment "Device specific configuration"

source "target/linux/*-2.[46]/Config.in"

comment "Kernel modules"

menu "Networking modules"

config BR2_PACKAGE_KMOD_ATM
	prompt "kmod-atm.......................... ATM support"
	tristate
	default y if BR2_LINUX_2_4_AR7
	default m
	help
	  ATM support

config BR2_PACKAGE_KMOD_GRE
	prompt "kmod-gre.......................... GRE tunneling driver"
	tristate
	default m
	help
	  Kernel support for GRE tunnels
	
config BR2_PACKAGE_KMOD_IMQ
        prompt "kmod-imq.......................... Intermediate Queueing device"
        tristate
        default m
        help
          Kernel support for the Intermediate Queueing device

config BR2_PACKAGE_KMOD_IPIP
	prompt "kmod-ipip......................... IP in IP encapsulation support"
	tristate
	default m
	help
	  Kernel module for IP in IP encapsulation

config BR2_PACKAGE_KMOD_IPV6
	prompt "kmod-ipv6......................... IPv6 support"
	tristate
	default m
	help
	  Kernel modules for IPv6 protocol support

config BR2_PACKAGE_KMOD_PPP
	prompt "kmod-ppp.......................... PPP support"
	tristate
	default m
	help
	  Kernel support for PPP

config BR2_PACKAGE_KMOD_MPPE
	prompt   "kmod-mppe....................... PPP MPPE/MPPC module"
	tristate
	default m
	depends BR2_PACKAGE_KMOD_PPP
	select BR2_PACKAGE_KMOD_CRYPTO
	help
	  Support for Microsoft PPP Encryption/Compression

config BR2_PACKAGE_KMOD_PPPOATM
	prompt   "kmod-pppoatm.................... PPPoA (PPP over ATM) kernel support"
	tristate
	default y if BR2_LINUX_2_4_AR7
	default m
	depends BR2_PACKAGE_KMOD_PPP
	select BR2_PACKAGE_KMOD_ATM
	help
	  Support for PPP over ATM

config BR2_PACKAGE_KMOD_PPPOE
	prompt   "kmod-pppoe...................... PPPoE (PPP over Ethernet) kernel support"
	tristate
	default m
	depends BR2_PACKAGE_KMOD_PPP
	help
	  Support for PPP over Ethernet

config BR2_PACKAGE_KMOD_RING
	prompt "kmod-ring......................... PF Ring"
	tristate
	default m
	help
	  PF Ring

config BR2_PACKAGE_KMOD_SCHED
	prompt "kmod-sched........................ Traffic schedulers"
	tristate
	default m
	help
	  Kernel schedulers for IP traffic

config BR2_PACKAGE_KMOD_TUN
	prompt "kmod-tun.......................... Universal TUN/TAP driver"
	tristate
	default m
	help
	  Kernel support for the TUN/TAP tunneling device

endmenu

menu "Filtering/Firewalling"

config BR2_PACKAGE_KMOD_ARPTABLES
	prompt "kmod-arptables.................... ARP firewalling support"
	tristate
	default m
	help
	  Kernel modules for ARP firewalling

config BR2_PACKAGE_KMOD_EBTABLES
	prompt "kmod-ebtables..................... Ethernet Bridge firewalling support"
	tristate
	default m
	help
	  Kernel modules for bridge firewalling

config BR2_PACKAGE_KMOD_IPTABLES
	prompt "kmod-iptables..................... Core Netfilter modules for IPv4 firewalling"
	tristate
	default y
	help
	  Kernel modules for IPv4 firewalling

config BR2_PACKAGE_KMOD_IPTABLES_EXTRA
	prompt "kmod-iptables-extra............... Extra Netfilter modules for IPv4 firewalling (meta-package)"
	tristate
	default m
	select BR2_PACKAGE_KMOD_IPT_CONNTRACK
	select BR2_PACKAGE_KMOD_IPT_FILTER
	select BR2_PACKAGE_KMOD_IPT_IPOPT
	select BR2_PACKAGE_KMOD_IPT_IPSEC
	select BR2_PACKAGE_KMOD_IPT_NAT
	select BR2_PACKAGE_KMOD_IPT_NAT_EXTRA
	select BR2_PACKAGE_KMOD_IPT_QUEUE
	select BR2_PACKAGE_KMOD_IPT_ULOG
	select BR2_PACKAGE_KMOD_IPT_EXTRA
	help
	  Extra Netfilter kernel modules for IPv4 firewalling (meta-package)

config BR2_PACKAGE_KMOD_IPT_CONNTRACK
	prompt "kmod-ipt-conntrack................ Netfilter modules for connection tracking"
	tristate
	default m
	help
	  Netfilter (IPv4) kernel modules for connection tracking

	  Includes:
	    * ipt_conntrack
	    * ipt_helper
	    * ipt_connmark/CONNMARK

config BR2_PACKAGE_KMOD_IPT_FILTER
	prompt "kmod-ipt-filter................... Netfilter modules for packet content inspection"
	tristate
	default m
	help
	  Netfilter (IPv4) kernel modules for packet content inspection

	  Includes:
	    * ipt_ipp2p
	    * ipt_layer7

config BR2_PACKAGE_KMOD_IPT_IPOPT
	prompt "kmod-ipt-ipopt.................... Netfilter modules for matching/changing IP packet options"
	tristate
	default m
	help
	  Netfilter (IPv4) kernel modules for matching/changing IP packet options
	  
	  Includes:
	    * ipt_dscp/DSCP
	    * ipt_ecn/ECN
	    * ipt_length
	    * ipt_mac
	    * ipt_tos/TOS
	    * ipt_tcpmms
	    * ipt_ttl/TTL
	    * ipt_unclean

config BR2_PACKAGE_KMOD_IPT_IPSEC
	prompt "kmod-ipt-ipsec.................... Netfilter modules for matching IPsec packets"
	tristate
	default m
	help
	  Netfilter (IPv4) kernel modules for matching IPsec packets
	  
	  Includes:
	    * ipt_ah
	    * ipt_esp

config BR2_PACKAGE_KMOD_IPT_NAT
	prompt "kmod-ipt-nat...................... Netfilter modules for different NAT targets"
	tristate
	default m
	help
	  Netfilter (IPv4) kernel modules for different NAT targets

	  Includes: 
	    * ipt_REDIRECT

config BR2_PACKAGE_KMOD_IPT_NAT_EXTRA
	prompt "kmod-ipt-nat-extra................ Extra Netfilter NAT modules for special protocols"
	tristate
	default m
	help
	  Extra Netfilter (IPv4) NAT kernel modules for special protocols
	  
	  Includes:
	    * ip_conntrack_amanda
	    * ip_conntrack_proto_gre
	    * ip_nat_proto_gre
	    * ip_conntrack_pptp
	    * ip_nat_pptp
	    * ip_conntrack_sip
	    * ip_nat_sip
	    * ip_nat_snmp_basic
	    * ip_conntrack_tftp

config BR2_PACKAGE_KMOD_IPT_QUEUE
	prompt "kmod-ipt-queue.................... Netfilter module for user-space packet queueing"
	tristate
	default m
	help
	  Netfilter (IPv4) module for user-space packet queueing
	  
	  Includes:
	    * ipt_QUEUE

config BR2_PACKAGE_KMOD_IPT_ULOG
	prompt "kmod-ipt-ulog..................... Netfilter module for user-space packet logging"
	tristate
	default m
	help
	  Netfilter (IPv4) module for user-space packet logging
	  
	  Includes:
	    * ipt_ULOG

config BR2_PACKAGE_KMOD_IPT_EXTRA
	prompt "kmod-ipt-extra.................... Other extra Netfilter modules"
	tristate
	default m
	help
	  Other extra Netfilter (IPv4) kernel modules

	  Includes:
	    * ipt_limit
	    * ipt_owner
	    * ipt_physdev
	    * ipt_pkttype
	    * ipt_recent

config BR2_PACKAGE_KMOD_IP6TABLES
	prompt "kmod-ip6tables.................... Kernel modules for ip6tables"
	tristate
	default m
	depends BR2_PACKAGE_KMOD_IPV6
	help
	  IPv6 firewalling support

endmenu

menu "Block devices support"

config BR2_PACKAGE_KMOD_IDE
	prompt "kmod-ide.......................... IDE support"
	tristate
	default m
	depends BR2_LINUX_2_4_X86 || BR2_LINUX_2_6_X86 || BR2_LINUX_2_4_BRCM || BR2_LINUX_2_6_BRCM
	help
	  Kernel modules for IDE support
	  useful for usb mass storage devices (e.g. on WL-HDD)
	  
	  Includes:
	    - ide-core
	    - ide-detect
	    - ide-disk
	    - pdc202xx_old

config BR2_PACKAGE_KMOD_LOOP
	prompt "kmod-loop......................... Loop mount support"
	tristate
	default m
	help
	  Kernel module for loop mount support

config BR2_PACKAGE_KMOD_NBD
	prompt "kmod-nbd.......................... Network Block Device"
	tristate
	default m
	help
	  Kernel module for network block device

endmenu

config BR2_PACKAGE_KMOD_CRYPTO
	prompt "CryptoAPI modules"
	tristate
	default m
	select BUSYBOX_CONFIG_FEATURE_CHECK_TAINTED_MODULE
	help
	  Kernel modules for cryptographic algorithms

menu "Filesystems support"

config BR2_PACKAGE_KMOD_FS_CIFS
	prompt "kmod-fs-cifs...................... CIFS support"
	tristate
	default m
	help
	  Kernel modules for CIFS support

config BR2_PACKAGE_KMOD_FS_EXT2
	prompt "kmod-fs-ext2...................... EXT2 filesystem support"
	tristate
	default m
	help
	  Kernel modules for EXT2 filesystem support

config BR2_PACKAGE_KMOD_FS_EXT3
	prompt "kmod-fs-ext3...................... EXT3 filesystem support"
	tristate
	default m
	help
	  Kernel modules for EXT3 filesystem support

config BR2_PACKAGE_KMOD_FS_HFSPLUS
	prompt "kmod-fs-hfsplus................... HFS+ filesystem support"
	tristate
	default m
	help
	  Kernel modules for HFS+ filesystem support

config BR2_PACKAGE_KMOD_FS_NFS
	prompt "kmod-fs-nfs....................... NFS support"
	tristate
	default m
	help
	  Kernel modules for NFS support
	  Includes lockd, nfs and sunrpc

config BR2_PACKAGE_KMOD_FS_VFAT
	prompt "kmod-fs-vfat...................... VFAT filesystem support"
	tristate
	default m
	help
	  Kernel modules for VFAT filesystem support
	  useful for usb mass storage devices

config BR2_PACKAGE_KMOD_FS_XFS
	prompt "kmod-fs-xfs....................... XFS filesystem support"
	tristate
	default m
	help
	  Kernel modules for XFS filesystem support

endmenu

menu "Multimedia devices support"

config BR2_PACKAGE_KMOD_PWC
	prompt "kmod-pwc.......................... Kernel driver for USB Philips Cameras"
	tristate
	depends BR2_PACKAGE_KMOD_USB
	default m

config BR2_PACKAGE_KMOD_SOUNDCORE
	prompt "kmod-soundcore.................... Soundcard support"
	tristate
	default n
	help
	  Base support for soundcards
	  Requires either USB soundcard support (OSS) or ALSA package to be useful

config BR2_PACKAGE_KMOD_VIDEODEV
	prompt "kmod-videodev..................... Video (For Linux) kernel support"
	tristate
	default m

endmenu

menu "Native Language support"

config BR2_PACKAGE_KMOD_NLS_BASE
	prompt "kmod-nls-base..................... Native Language support"
	tristate
	default m
	help
	  Kernel native language support

config BR2_PACKAGE_KMOD_NLS_CP437
	prompt   "kmod-nls-cp437.................. Codepage 437 (United States, Canada)"
	tristate
	default m
	depends BR2_PACKAGE_KMOD_NLS_BASE
	help
	  Kernel native language support

config BR2_PACKAGE_KMOD_NLS_CP850
	prompt   "kmod-nls-cp850.................. Codepage 850 (Europe)"
	tristate
	default m
	depends BR2_PACKAGE_KMOD_NLS_BASE
	help
	  Kernel native language support

config BR2_PACKAGE_KMOD_NLS_ISO8859_1
	prompt   "kmod-nls-iso8859-1.............. NLS ISO 8859-1 (Latin 1; Western European Languages)"
	tristate
	default m
	depends BR2_PACKAGE_KMOD_NLS_BASE
	help
	  Kernel native language support

config BR2_PACKAGE_KMOD_NLS_ISO8859_15
	prompt   "kmod-nls-iso8859-15............. NLS ISO 8859-15 (Latin 15; Western European Languages with Euro)"
	tristate
	default m
	depends BR2_PACKAGE_KMOD_NLS_BASE
	help
	  Kernel native language support

config BR2_PACKAGE_KMOD_NLS_UTF8
	prompt   "kmod-nls-utf8................... NLS UTF8"
	tristate
	default m
	depends BR2_PACKAGE_KMOD_NLS_BASE
	help
	  Kernel native language support

endmenu

menu "Network devices support"
	depends BR2_LINUX_2_4_X86 || BR2_LINUX_2_6_X86

config BR2_PACKAGE_KMOD_NET_3C59X
	prompt "kmod-net-3c59x.................... 3Com 3c590/3c900 series (592/595/597) \"Vortex/Boomerang\" Ethernet kernel support"
	tristate
	depends BR2_LINUX_2_4_X86 || BR2_LINUX_2_6_X86
	default m
	help
	  This option enables driver support for a large number of 10mbps and 
	  10/100mbps EISA, PCI and PCMCIA 3Com network cards:
	  
	   * "Vortex"    (Fast EtherLink 3c590/3c592/3c595/3c597) EISA and PCI
	   * "Boomerang" (EtherLink XL 3c900 or 3c905)            PCI
	   * "Cyclone"   (3c540/3c900/3c905/3c980/3c575/3c656)    PCI and Cardbus
	   * "Tornado"   (3c905)                                  PCI
	   * "Hurricane" (3c555/3cSOHO)                           PCI

config BR2_PACKAGE_KMOD_NET_8139TOO
	prompt "kmod-net-8139too.................. RealTek RTL-8139 PCI Fast Ethernet Adapter kernel support"
	tristate
	depends BR2_LINUX_2_4_X86 || BR2_LINUX_2_6_X86
	default m
	help
	  This is a driver for the Fast Ethernet PCI network cards based on 
	  the RTL8139 chips.

config BR2_PACKAGE_KMOD_NET_AIRO
	prompt "kmod-net-airo..................... Cisco/Aironet 34X/35X/4500/4800 ISA and PCI cards kernel support"
	tristate
	depends BR2_LINUX_2_4_X86 || BR2_LINUX_2_6_X86
	default m
	help
	  This is the standard Linux driver to support Cisco/Aironet ISA and 
	  PCI 802.11 wireless cards.
	  It supports the new 802.11b cards from Cisco (Cisco 34X, Cisco 35X 
	  - with or without encryption) as well as card before the Cisco 
	  acquisition (Aironet 4500, Aironet 4800, Aironet 4800B).
	  
	  This driver support both the standard Linux Wireless Extensions 
	  and Cisco proprietary API, so both the Linux Wireless Tools and the 
	  Cisco Linux utilities can be used to configure the card.

config BR2_PACKAGE_KMOD_NET_E100
	prompt "kmod-net-e100..................... Intel(R) PRO/100+ cards kernel support"
	tristate
	depends BR2_LINUX_2_4_X86 || BR2_LINUX_2_6_X86
	default m
	help
	  Intel(R) PRO/100+ cards kernel support

config BR2_PACKAGE_KMOD_NET_HERMES
	prompt "kmod-net-hermes................... Hermes chipset 802.11b support (Orinoco/Prism2/Symbol) kernel support"
	tristate
	depends BR2_LINUX_2_4_X86 || BR2_LINUX_2_6_X86
	default m
	help
	  A driver for 802.11b wireless cards based based on the "Hermes" or 
	  Intersil HFA384x (Prism 2) MAC controller.  This includes the vast 
	  majority of the PCMCIA 802.11b cards (which are nearly all rebadges) 
	  - except for the Cisco/Aironet cards.  Cards supported include the 
	  Apple Airport (not a PCMCIA card), WavelanIEEE/Orinoco, 
	  Cabletron/EnteraSys Roamabout, ELSA AirLancer, MELCO Buffalo, Avaya, 
	  IBM High Rate Wireless, Farralon Syyline, Samsung MagicLAN, Netgear 
	  MA401, LinkSys WPC-11, D-Link DWL-650, 3Com AirConnect, Intel 
	  PRO/Wireless, and Symbol Spectrum24 High Rate amongst others.

config BR2_PACKAGE_KMOD_NET_HERMES_PCI
	prompt   "kmod-net-hermes-pci............. Intersil Prism 2.5 PCI 802.11b adaptor support"
	tristate
	default m
	depends BR2_PACKAGE_KMOD_NET_HERMES
	help
	  Enable support for PCI and mini-PCI 802.11b wireless NICs based on 
	  the Prism 2.5 chipset.  These are true PCI cards, not the 802.11b 
	  PCMCIA cards bundled with PCI<->PCMCIA adaptors which are also 
	  common.  Some of the built-in wireless adaptors in laptops are of 
	  this variety.

config BR2_PACKAGE_KMOD_NET_HERMES_PLX
	prompt   "kmod-net-hermes-plx............. Hermes in PLX9052 based PCI adaptor (Netgear MA301, etc.) kernel support"
	tristate
	default m
	depends BR2_PACKAGE_KMOD_NET_HERMES
	help
	  Enable support for PCMCIA cards supported by the "Hermes" (aka 
	  orinoco_cs) driver when used in PLX9052 based PCI adaptors.  These 
	  adaptors are not a full PCMCIA controller but act as a more limited 
	  PCI <-> PCMCIA bridge.  Several vendors sell such adaptors so that 
	  802.11b PCMCIA cards can be used in desktop machines.  The Netgear 
	  MA301 is such an adaptor.

config BR2_PACKAGE_KMOD_NET_NATSEMI
	prompt "kmod-net-natsemi.................. National Semiconductor DP8381x series PCI Ethernet kernel support"
	tristate
	depends BR2_LINUX_2_4_X86 || BR2_LINUX_2_6_X86
	default m
	help
	  This driver is for the National Semiconductor DP83810 series, 
	  which is used in cards from PureData, NetGear, Linksys 
	  and others, including the 83815 chip.

config BR2_PACKAGE_KMOD_NET_PRISM54
	prompt "kmod-net-prism54.................. Intersil Prism GT/Duette/Indigo PCI/PCMCIA cards kernel support"
	tristate
	depends BR2_LINUX_2_4_X86 || BR2_LINUX_2_6_X86 || BR2_LINUX_2_4_BRCM || BR2_LINUX_2_6_BRCM
	default m
	help
	  Enable PCI and Cardbus support for the following chipset based cards: 
	  
	   * ISL3880 - Prism GT       802.11 b/g
	   * ISL3877 - Prism Indigo   802.11 a
	   * ISL3890 - Prism Duette   802.11 a/b/g
	  
	  For a complete list of supported cards visit <http://prism54.org>.
	  Here is the latest confirmed list of supported cards: 
	  
	   * 3com OfficeConnect 11g Cardbus Card aka 3CRWE154G72
	   * Allnet ALL0271 PCI Card
	   * Compex WL54G Cardbus Card
	   * Corega CG-WLCB54GT Cardbus Card
	   * D-Link Air Plus Xtreme G A1 Cardbus Card aka DWL-g650
	   * I-O Data WN-G54/CB Cardbus Card
	   * Kobishi XG-300 aka Z-Com Cardbus Card
	   * Netgear WG511 Cardbus Card
	   * Ovislink WL-5400PCI PCI Card
	   * Peabird WLG-PCI PCI Card
	   * Sitecom WL-100i Cardbus Card
	   * Sitecom WL-110i PCI Card
	   * SMC2802W - EZ Connect g 2.4GHz 54 Mbps Wireless PCI Card
	   * SMC2835W - EZ Connect g 2.4GHz 54 Mbps Wireless Cardbus Card
	   * Z-Com XG-900 PCI Card
	   * Zyxel G-100 Cardbus Card
	  
	  If you enable this, you require a firmware file as well.
	  You will need to copy this to /usr/lib/hotplug/firmware/isl3890.
	  You can get this non-GPL'd firmware file from the Prism54 project page: 
	  <http://prism54.org>.
	  
	  Note: You need a motherboard with DMA support to use any of these cards.

endmenu

menu "PCMCIA/CardBus support"
	depends BR2_LINUX_2_4_X86 || BR2_LINUX_2_6_X86 || BR2_LINUX_2_4_BRCM || BR2_LINUX_2_6_BRCM

config BR2_PACKAGE_KMOD_PCMCIA_CORE
	prompt "kmod-pcmcia-core.................. PCMCIA/CardBus support"
	depends BR2_LINUX_PCMCIA_SUPPORT
	tristate
	depends BR2_LINUX_2_4_X86 || BR2_LINUX_2_6_X86 || BR2_LINUX_2_4_BRCM || BR2_LINUX_2_6_BRCM
	default m

config BR2_PACKAGE_KMOD_PCMCIA_SERIAL
	prompt   "kmod-pcmcia-serial.............. PCMCIA/CardBus serial device support"
	tristate
	default m
	depends BR2_PACKAGE_KMOD_PCMCIA_CORE

endmenu

menu "USB support"

config BR2_PACKAGE_KMOD_USB
	prompt "kmod-usb-core..................... USB support"
	tristate
	default n if BR2_LINUX_2_4_AR531X
	default m

config BR2_PACKAGE_KMOD_USB_UHCI 
	prompt   "kmod-usb-uhci................... Support for UHCI controllers"
	tristate
	default n if BR2_LINUX_2_6_AU1000
	depends BR2_PACKAGE_KMOD_USB
	select BR2_PACKAGE_KMOD_USB_CONTROLLER

config BR2_PACKAGE_KMOD_USB_OHCI
	prompt   "kmod-usb-ohci................... Support for OHCI controllers"
	tristate
	default m
	depends BR2_PACKAGE_KMOD_USB
	select BR2_PACKAGE_KMOD_USB_CONTROLLER

config BR2_PACKAGE_KMOD_USB2
	prompt   "kmod-usb2....................... Support for USB 2.0 controllers"
	tristate
	default n if BR2_LINUX_2_6_AU1000
	depends BR2_PACKAGE_KMOD_USB
	select BR2_PACKAGE_KMOD_USB_CONTROLLER

config BR2_PACKAGE_KMOD_USB_CONTROLLER
	tristate
	depends on BR2_PACKAGE_KMOD_USB_UHCI || BR2_PACKAGE_KMOD_USB_OHCI || BR2_PACKAGE_KMOD_USB2
	default n

config BR2_PACKAGE_KMOD_USB_ACM
	prompt "kmod-usb-acm...................... Support for USB modems/isdn controllers"
	tristate
	default m
	depends BR2_PACKAGE_KMOD_USB_CONTROLLER

config BR2_PACKAGE_KMOD_USB_AUDIO
	prompt "kmod-usb-audio.................... Support for USB soundcards"
	tristate
	default m
	depends BR2_PACKAGE_KMOD_USB_CONTROLLER
	select BR2_PACKAGE_KMOD_SOUNDCORE

config BR2_PACKAGE_KMOD_USB_PRINTER
	prompt "kmod-usb-printer.................. Support for USB printers"
	tristate
	default m
	depends BR2_PACKAGE_KMOD_USB_CONTROLLER

config BR2_PACKAGE_KMOD_USB_SERIAL
	prompt "kmod-usb-serial................... Support for USB-to-serial converters"
	tristate
	default m
	depends BR2_PACKAGE_KMOD_USB_CONTROLLER

config BR2_PACKAGE_KMOD_USB_SERIAL_BELKIN
	prompt   "kmod-usb-serial-belkin.......... Support for Belkin USB-to-serial converters"
	tristate
	default m
	depends BR2_PACKAGE_KMOD_USB_SERIAL

config BR2_PACKAGE_KMOD_USB_SERIAL_FTDI
	prompt   "kmod-usb-serial-ftdi............ Support for FTDI USB-to-serial converterr"
	tristate
	default m
	depends BR2_PACKAGE_KMOD_USB_SERIAL

config BR2_PACKAGE_KMOD_USB_SERIAL_MCT_U232
	prompt   "kmod-usb-serial-mct-u232........ Support for Magic Control Technology USB-to-Serial converters"
	tristate
	default m
	depends BR2_PACKAGE_KMOD_USB_SERIAL

config BR2_PACKAGE_KMOD_USB_SERIAL_PL2303
	prompt   "kmod-usb-serial-pl2303.......... Support for Prolific PL2303 USB-to-Serial converters"
	tristate
	default m
	depends BR2_PACKAGE_KMOD_USB_SERIAL

config BR2_PACKAGE_KMOD_USB_SERIAL_VISOR
	prompt   "kmod-usb-serial-visor........... Support for Handspring Visor / Palm m50x / Sony Clie Driver"
	tristate
	default m
	depends BR2_PACKAGE_KMOD_USB_SERIAL

config BR2_PACKAGE_KMOD_USB_STORAGE
	prompt "kmod-usb-storage.................. Support for USB storage devices"
	tristate
	default m
	depends BR2_PACKAGE_KMOD_USB_CONTROLLER

config BR2_PACKAGE_KMOD_USB_ATM
        prompt "kmod-usb-atm...................... Support for USB ATM devices"
	tristate
	default m
	depends BR2_PACKAGE_KMOD_USB_CONTROLLER

config BR2_PACKAGE_KMOD_USB_ATM_SPEEDTOUCH
        prompt   "kmod-usb-atm-speedtouch......... Support for USB Speedtouch ADSL modem"
	tristate
	default m
	depends BR2_PACKAGE_KMOD_USB_ATM

endmenu

menu "Misc. devices support"

config BR2_PACKAGE_KMOD_AX25
	prompt "kmod-ax25......................... AX25 support"
	tristate
	default m
	help
	  Kernel modules for AX25 protocol family
	  
	  This package contains both the AX25 layer 2 support (ax25) and AX25 KISS driver (mkiss)

config BR2_PACKAGE_KMOD_BLUETOOTH
	prompt "kmod-bluetooth.................... Bluetooth drivers and network stack"
	tristate
	default m
	default n if BR2_LINUX_2_4_AR531X
	help
	  Bluetooth drivers and network stack

config BR2_PACKAGE_KMOD_LP
	prompt "kmod-lp........................... Parallel port and lp support"
	tristate
	default m
	help
	  Kernel modules for line printer and parallel port support

config BR2_PACKAGE_KMOD_SOFTDOG
	prompt "kmod-softdog...................... Software watchdog"
	tristate
	default m
	help
	  Kernel modules for software watchdog driver

config BR2_PACKAGE_KMOD_WD1100
	prompt "kmod-wd1100....................... Soekris net4801 watchdog"
	tristate
	default y
	depends BR2_LINUX_2_4_X86
	help
	  Driver for the NatSemi SC1x00 series Watchdog 
	  found on Soekris net4801 boards

endmenu

menu "Additional kernel modules"

source "target/linux/package/Config.in"

endmenu

endmenu
```
