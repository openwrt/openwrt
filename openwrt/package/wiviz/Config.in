## openwrt/target/linux/aruba-2.6/Config.in
```kconfig
config BR2_ARUBA_RAMDISK
	prompt "ramdisk support"
	depends BR2_LINUX_2_6_ARUBA
	bool
```

## openwrt/target/linux/brcm-2.4/Config.in
```kconfig
config PACKAGE_KMOD_BRCM_WL
	prompt "kmod-brcm-wl...................... Broadcom Wireless Network Driver"
	tristate
	depends LINUX_2_4_BRCM
	default y
	help
	  Proprietary driver for Broadcom Wireless chipsets
```

## openwrt/target/linux/package/alsa/Config.in
```kconfig
config PACKAGE_KMOD_ALSA
	prompt "kmod-alsa......................... Alsa Sound Drivers"
	tristate
    depends LINUX_2_4_X86 || LINUX_2_4_BRCM || LINUX_2_6_X86 || LINUX_2_6_BRCM
	depends PACKAGE_KMOD_USB_CONTROLLER
	select PACKAGE_KMOD_SOUNDCORE
	default m if DEVEL
	help
	  Alsa Drivers for USB Soundcards
```

## openwrt/target/linux/package/bcm43xx-dscape/Config.in
```kconfig
config BR2_PACKAGE_KMOD_BCM43XX_DSCAPE
	prompt "kmod-bcm43xx-dscape............... Free Broadcom 43xx wireless driver (devicescape stack)"
	tristate
	depends BR2_LINUX_2_6_BRCM
	depends BR2_PACKAGE_KMOD_IEEE80211_DSCAPE
	default m if CONFIG_DEVEL
	default n
	help
	  Free driver for the Broadcom 43xx wireless chipset
	  This driver uses the DeviceScape 802.11 stack
	  
	  http://bcm43xx.berlios.de
	  
```

## openwrt/target/linux/package/bcm43xx-standalone/Config.in
```kconfig
config BR2_PACKAGE_KMOD_BCM43XX_STANDALONE
	prompt "kmod-bcm43xx-standalone............... Free Broadcom 43xx wireless driver (devicescape stack)"
	tristate
	depends BR2_LINUX_2_6_BRCM
	select BR2_PACKAGE_KMOD_IEEE80211_DSCAPE
	default m if CONFIG_DEVEL
	default n
	help
	  Free driver for the Broadcom 43xx wireless chipset
	  This driver uses the DeviceScape 802.11 stack
	  
	  http://bcm43xx.berlios.de
	  
```

## openwrt/target/linux/package/diag/Config.in
```kconfig
config BR2_PACKAGE_KMOD_DIAG
	prompt "kmod-diag......................... Driver for router LEDs and Buttons"
	tristate
	depends BR2_LINUX_2_4_BRCM
	default y
	help
	  Driver for router LEDs and Buttons
```

## openwrt/target/linux/package/fuse/Config.in
```kconfig
config BR2_PACKAGE_KMOD_FUSE
	prompt "kmod-fuse - FUSE kernel module"
	tristate
	default m if CONFIG_DEVEL
	select BR2_PACKAGE_FUSE
	help
	  With FUSE it is possible to implement a fully functional 
	  filesystem in a userspace program.
	  
	  Features include:
	  
	   * Simple library API
	   * Simple installation (no need to patch or recompile the kernel)
	   * Secure implementation
	   * Userspace - kernel interface is very efficient
	   * Usable by non privileged users
	   * Runs on Linux kernels 2.4.X and 2.6.X
	   * Has proven very stable over time
	  
	  
	  http://fuse.sourceforge.net/
	  
	  This package contains the fuse.o kernel module.
```

## openwrt/target/linux/package/hostap/Config.in
```kconfig
config BR2_PACKAGE_KMOD_HOSTAP
	tristate "kmod-hostap.................... Host AP support for Prism2/2.5/3 IEEE 802.11b"
	default m if CONFIG_DEVEL
	help
	  A driver for 802.11b wireless cards based on Intersil Prism2/2.5/3
	  chipset. This driver supports so called Host AP mode that allows
	  the card to act as an IEEE 802.11 access point.
	  
	  This option includes the base Host AP driver code that is shared by
	  different hardware models. You will also need to enable support for
	  PLX/PCI/CS version of the driver to actually use the driver.
	  
	  http://hostap.epitest.fi/
	  
	  This package contains the hostap.o and hostap_crypt_wep.o kernel modules.
	  

config BR2_PACKAGE_KMOD_HOSTAP_PCI
	tristate   "kmod-hostap-pci.............. Host AP driver for Prism2.5 PCI adaptors"
	default m if CONFIG_DEVEL
	depends BR2_PACKAGE_KMOD_HOSTAP
	help
	  Host AP support for Prism2/2.5/3 IEEE 802.11b" is required for this
	  driver and its help text includes more information about the Host AP
	  driver.
	  
	  http://hostap.epitest.fi/
	  
	  This package contains the hostap_pci.o kernel module.
	  

config BR2_PACKAGE_KMOD_HOSTAP_PLX
	tristate   "kmod-hostap-plx.............. Host AP driver for Prism2/2.5/3 in PLX9052 based PCI adaptors"
	default m if CONFIG_DEVEL
	depends BR2_PACKAGE_KMOD_HOSTAP
	help
	  Host AP support for Prism2/2.5/3 IEEE 802.11b" is required for this
	  driver and its help text includes more information about the Host AP
	  driver.
	  
	  http://hostap.epitest.fi/
	  
	  This package contains the hostap_plx.o kernel module.
	  
```

## openwrt/target/linux/package/ieee80211-dscape/Config.in
```kconfig
config BR2_PACKAGE_KMOD_IEEE80211_DSCAPE
	prompt "kmod-ieee80211-dscape............. IEEE 802.11 stack (devicescape)"
	tristate
	default n
	depends BR2_LINUX_2_6_BRCM || BR2_LINUX_2_6_X86
	
	help
	  IEEE 802.11 stack (devicescape)
	  
	  http://ftp.kernel.org/pub/linux/kernel/people/jbenc/
```

## openwrt/target/linux/package/ieee80211-dscape/src/Kconfig
```kconfig
config IEEE80211
	tristate "Generic IEEE 802.11 Networking Stack"
	---help---
	This option enables the hardware independent IEEE 802.11
	networking stack.

config IEEE80211_DEBUG
	bool "Enable debugging output"
	depends on IEEE80211
	---help---
	  This option will enable debug tracing output for the
	  ieee80211 network stack.

	  If you are not trying to debug or develop the ieee80211
	  subsystem, you most likely want to say N here.

config IEEE80211_VERBOSE_DEBUG
	bool "Verbose debugging output"
	depends on IEEE80211_DEBUG

config TKIP_DEBUG
	bool "TKIP debugging"
	depends on IEEE80211_DEBUG

config IEEE80211_DEBUG_COUNTERS
	bool "Extra statistics for TX/RX debugging"
	depends on IEEE80211_DEBUG

config HOSTAPD_WPA_TESTING
	bool "Support for TKIP countermeasures testing"
	depends on IEEE80211_DEBUG
```

## openwrt/target/linux/package/madwifi/Config.in
```kconfig
config BR2_PACKAGE_KMOD_MADWIFI
	prompt "kmod-madwifi...................... Atheros Wifi driver"
	tristate
	default y if BR2_LINUX_2_6_BRCM || BR2_LINUX_2_6_ARUBA || BR2_LINUX_2_4_AR531X || BR2_LINUX_2_6_XSCALE
	default m if CONFIG_DEVEL
	default n
	help
	  Driver for Atheros 802.11a/b/g MiniPCI cards
	  
	  http://www.madwifi.org/
```
