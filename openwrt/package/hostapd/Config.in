## openwrt/package/kismet/Config.in
```kconfig
menu "kismet - an 802.11 layer2 wireless network detector, sniffer, and intrusion detection system"

config BR2_PACKAGE_KISMET
	tristate
	default n
	depends BR2_PACKAGE_KISMET_CLIENT || BR2_PACKAGE_KISMET_DRONE || BR2_PACKAGE_KISMET_SERVER

config BR2_PACKAGE_KISMET_CLIENT
	prompt "kismet-client - the Kismet client"
	tristate
	default m if CONFIG_DEVEL
	select BR2_PACKAGE_KISMET
	select BR2_PACKAGE_LIBNCURSES
	select BR2_PACKAGE_UCLIBCXX
	help
	  
	  An 802.11 layer2 wireless network detector, sniffer, and intrusion detection system.
	  
	  http://www.kismetwireless.net/
	  
	  This package contains the kismet text interface client.
	  
	  Depends:
	    - libncurses
	    - libpcap
	    - uClibc++
	  

config BR2_PACKAGE_KISMET_DRONE
	prompt "kismet-drone - the Kismet drone"
	tristate
	default m if CONFIG_DEVEL
	select BR2_PACKAGE_KISMET
	select BR2_PACKAGE_LIBPCAP
	select BR2_PACKAGE_UCLIBCXX
	help
	  
	  An 802.11 layer2 wireless network detector, sniffer, and intrusion detection system.
	  
	  http://www.kismetwireless.net/
	  
	  This package contains the kismet remote sniffing.and monitoring drone.
	  
	  Depends:
	    - libpcap
	    - uClibc++
	  

config BR2_PACKAGE_KISMET_SERVER
	prompt "kismet-server - the Kismet server"
	tristate
	default m if CONFIG_DEVEL
	select BR2_PACKAGE_KISMET
	select BR2_PACKAGE_LIBPCAP
	select BR2_PACKAGE_UCLIBCXX
	help
	  
	  An 802.11 layer2 wireless network detector, sniffer, and intrusion detection system.
	  
	  http://www.kismetwireless.net/
	  
	  This package contains the kismet server.
	  
	  Depends:
	    - libpcap
	    - uClibc++
	  

endmenu
```

## openwrt/package/l2tpd/Config.in
```kconfig
config BR2_PACKAGE_L2TPD
	prompt "l2tpd............................. An L2TP (Layer 2 Tunneling Protocol) daemon"
	tristate
	default m if CONFIG_DEVEL
	help
	  A layer 2 tunneling protocol implementation.
	  l2tpd is the open source implementation of the L2TP tunneling
	  protocol (RFC2661). It does implement both LAC and LNS role 
	  in a L2TP networking architecture. The main goal of this protocol is 
	  to tunnel PPP frame trough an ip network. 
	  
	  http://l2tpd.sourceforge.net/
```

## openwrt/package/l2tpns/Config.in
```kconfig
config BR2_PACKAGE_L2TPNS
	prompt "l2tpns............................ An L2TP enhanced server"
	tristate
	default m if CONFIG_DEVEL
	select BR2_PACKAGE_LIBCLI
	help
		l2tpns is a layer 2 tunneling protocol network server (LNS).
		It supports up to 65535 concurrent sessions per server/cluster 
		plus ISP features such as rate limiting, walled garden, usage 
		accounting, and more.

		http://sourceforge.net/projects/l2tpns
```

## openwrt/package/lcd4linux/Config.in
```kconfig
config BR2_PACKAGE_LCD4LINUX
	prompt "lcd4linux......................... Program to access an external LCD"
	tristate
	default m if CONFIG_DEVEL
	select BR2_PACKAGE_LIBNCURSES
	help
	  LCD4Linux
	  
	  https://ssl.bulix.org/projects/lcd4linux/wiki/Howto
```

## openwrt/package/less/Config.in
```kconfig
config BR2_PACKAGE_LESS
	prompt "less.............................. A text file viewer."
	tristate
	default m if CONFIG_DEVEL
	select BR2_PACKAGE_LIBNCURSES
	help
	  less - less is a pager. A pager usually displays text files.
	  
	  http://www.greenwoodsoftware.com/less/
```

## openwrt/package/libao/Config.in
```kconfig
config BR2_PACKAGE_LIBAO
	prompt "libao............................. A cross platform audio library"
	tristate
	default m if CONFIG_DEVEL
	help
	  Libao is a cross-platform audio library that allows programs to 
	  output audio using a simple API on a wide variety of platforms. 
	  
	  http://www.xiph.org/ao/
```

## openwrt/package/libart/Config.in
```kconfig
config BR2_PACKAGE_LIBART
	prompt "libart............................ An high-performance 2D graphics library"
	tristate
#	default m if CONFIG_DEVEL
	default n
	help
	  A library of functions for 2D graphics supporting a superset of the
	  PostScript imaging model, designed to be integrated with graphics, artwork,
	  and illustration programs. It is written in optimized C, and is fully
	  compatible with C++. With a small footprint of 10,000 lines of code, it is
	  especially suitable for embedded applications.
	  
	  http://www.levien.com/libart/
```

## openwrt/package/libaudiofile/Config.in
```kconfig
config BR2_PACKAGE_LIBAUDIOFILE
	prompt "libaudiofile...................... An open-source version of SGI's audiofile library"
	tristate
	help
	  The audiofile library allows the processing of audio data to and from audio
	  files of many common formats (currently AIFF, AIFF-C, WAVE, NeXT/Sun, BICS,
	  and raw data).
```

## openwrt/package/libdaemon/Config.in
```kconfig
config BR2_PACKAGE_LIBDAEMON
	prompt "libdaemon......................... A lightweight C library that eases the writing of UNIX daemons"
	tristate
	default m if CONFIG_DEVEL
	help
	  libdaemon is a lightweight C library that eases the writing of UNIX daemons. 
	  It consists of the following parts:
	  
	    * A wrapper around fork() which does the correct daemonization procedure of a process
	    * A wrapper around syslog() for simpler and compatible log output to Syslog or STDERR
	    * An API for writing PID files
	    * An API for serializing UNIX signals into a pipe for usage with select() or poll()
	    * An API for running subprocesses with STDOUT and STDERR redirected to syslog.
	  
	  APIs like these are used in most daemon software available. It is not that 
	  simple to get it done right and code duplication is not a goal.
	  
	  http://0pointer.de/lennart/projects/libdaemon/
```

## openwrt/package/libdb/Config.in
```kconfig
config BR2_COMPILE_DB
	tristate
	default n
	depends BR2_PACKAGE_LIBDB

config BR2_PACKAGE_LIBDB
	prompt "libdb............................. Berkeley DB"
	tristate
	default m if CONFIG_DEVEL
	select BR2_COMPILE_DB
	help
	  disk file format database which stores key/data-pairs in single files.  
	  
	  http://www.sleepycat.com/products/db.shtml
```
