## openwrt/package/hostapd/Config.in
```kconfig
config BR2_COMPILE_HOSTAPD
	tristate
	default n
	depends BR2_PACKAGE_HOSTAPD || BR2_PACKAGE_HOSTAPD_MINI || BR2_PACKAGE_HOSTAPD_UTILS
	select BR2_PACKAGE_KMOD_MADWIFI

config BR2_PACKAGE_HOSTAPD
	prompt "hostapd........................... An IEEE 802.11 AP, IEEE 802.1x/WPA/WPA2/EAP/RADIUS Authenticator"
	tristate
	default m if CONFIG_DEVEL
	select BR2_COMPILE_HOSTAPD
	select BR2_PACKAGE_LIBOPENSSL
	help
	  
	  hostapd is a user space daemon for access point and 
	  authentication servers. It implements IEEE 802.11 access point 
	  management, IEEE 802.1X/WPA/WPA2/EAP Authenticators, RADIUS 
	  client, EAP server, and RADIUS authentication server.
	  
	  http://hostap.epitest.fi/hostapd/
	
	  Includes:
	   - hostapd

config BR2_PACKAGE_HOSTAPD_MINI
	prompt "hostapd-mini...................... An IEEE 802.11 AP, IEEE 802.1x/WPA/WPA2/EAP/RADIUS Authenticator (without EAP TLS/TTLS support)"
	tristate
	default m if CONFIG_DEVEL
	select BR2_COMPILE_HOSTAPD
	help
	  
	  hostapd is a user space daemon for access point and 
	  authentication servers. It implements IEEE 802.11 access point 
	  management, IEEE 802.1X/WPA/WPA2/EAP Authenticators, RADIUS 
	  client, EAP server, and RADIUS authentication server.
	  
	  http://hostap.epitest.fi/hostapd/
	
	  Includes:
	   - hostapd (built with WPA support only)

config BR2_PACKAGE_HOSTAPD_UTILS
	prompt "hostapd-utils..................... An IEEE 802.11 AP, IEEE 802.1x/WPA/WPA2/EAP/RADIUS Authenticator (CLI utility)"
	tristate
	default m if CONFIG_DEVEL
	select BR2_COMPILE_HOSTAPD
	help
	  
	  hostapd is a user space daemon for access point and 
	  authentication servers. It implements IEEE 802.11 access point 
	  management, IEEE 802.1X/WPA/WPA2/EAP Authenticators, RADIUS 
	  client, EAP server, and RADIUS authentication server.
	  
	  http://hostap.epitest.fi/hostapd/
	
	  Includes:
	   - hostapd_cli

if (BR2_PACKAGE_HOSTAPD = y) && (BR2_PACKAGE_HOSTAPD_MINI = y)
	comment "WARNING: both hostapd and hostapd-mini are selected for installation !"
endif
```

## openwrt/package/howl/Config.in
```kconfig
menu "howl.............................. A Zeroconf networking implementation"

config BR2_COMPILE_HOWL
	tristate
	default n
	depends BR2_PACKAGE_LIBHOWL

config BR2_PACKAGE_LIBHOWL
	prompt "libhowl........................... The howl library"
	tristate
	default m if CONFIG_DEVEL
	select BR2_COMPILE_HOWL
	help
	  A cross-platform implementation of Zeroconf networking.
	  
	  http://www.porchdogsoft.com/products/howl/
	  
	  This package contains shared libraries, needed by other programs.

config BR2_PACKAGE_HOWL_UTILS
	prompt   "howl-utils...................... The howl client utilities"
	tristate
	default m if CONFIG_DEVEL
	depends BR2_PACKAGE_LIBHOWL
	help
	  A cross-platform implementation of Zeroconf networking.
	  
	  http://www.porchdogsoft.com/products/howl/

comment "Daemons ---"

config BR2_PACKAGE_AUTOIPD
	prompt "autoipd........................... An IPv4 Link-Local address self-assigner daemon"
	tristate
	default m if CONFIG_DEVEL
	select BR2_PACKAGE_LIBHOWL
	help
	  A cross-platform implementation of Zeroconf networking.
	  
	  http://www.porchdogsoft.com/products/howl/

config BR2_PACKAGE_MDNSRESPONDER
	prompt "mdnsresponder..................... An mDNS (Multicast DNS) service responder daemon"
	tristate
	default m if CONFIG_DEVEL
	select BR2_PACKAGE_LIBHOWL
	help
	  A cross-platform implementation of Zeroconf networking.
	  
	  http://www.porchdogsoft.com/products/howl/

config BR2_PACKAGE_NIFD
	prompt "nifd.............................. A network interface monitor daemon"
	tristate
	default m if CONFIG_DEVEL
	select BR2_PACKAGE_LIBHOWL
	help
	  A cross-platform implementation of Zeroconf networking.
	  
	  http://www.porchdogsoft.com/products/howl/

endmenu
```

## openwrt/package/htpdate/Config.in
```kconfig
config BR2_PACKAGE_HTPDATE
	prompt "htpdate........................... HTP (Hypertext Time Protocol) implementation"
	tristate
	default m if CONFIG_DEVEL
	help
	  An HTP (Hypertext Time Protocol) implementation
	  
	  http://www.clevervest.com/htp/
```

## openwrt/package/icecast/Config.in
```kconfig
config BR2_PACKAGE_ICECAST
	prompt "icecast........................... A streaming media server for Ogg/Vorbis and MP3 audio streams"
	tristate
	default m if CONFIG_DEVEL
	select BR2_PACKAGE_LIBCURL
	select BR2_PACKAGE_LIBVORBISIDEC
	select BR2_PACKAGE_LIBXML2
	select BR2_PACKAGE_LIBXSLT
	help
	  Icecast is a streaming media server which currently supports Ogg 
	  Vorbis and MP3 audio streams. It can be used to create an Internet 
	  radio station or a privately running jukebox and many things in 
	  between. It is very versatile in that new formats can be added 
	  relatively easily and supports open standards for commuincation and 
	  interaction.
	  
	  http://www.icecast.org/
	  
	  Depends:
	   * libcurl
	   * libvorbisidec
	   * libxml2
	   * libxslt
```

## openwrt/package/iftop/Config.in
```kconfig
config BR2_PACKAGE_IFTOP
	prompt "iftop............................. display bandwith usage on an interface"
	tristate
	default m if CONFIG_DEVEL
	select BR2_PACKAGE_LIBPCAP
	select BR2_PACKAGE_LIBNCURSES
	select BR2_PACKAGE_LIBPTHREAD
	help
	  iftop does for network usage what top(1) does for CPU usage. It
	  listens to network traffic on a named interface and displays a
	  table of current bandwidth usage by pairs of hosts. Handy for
	  answering the question "why is our ADSL link so slow?".

	  http://www.ex-parrot.com/~pdw/iftop/
```

## openwrt/package/ipcad/Config.in
```kconfig
config BR2_PACKAGE_IPCAD
	prompt "ipcad............................. listens for traffic on the specified interfaces"
	tristate
	default m if CONFIG_DEVEL
	select BR2_PACKAGE_LIBPCAP
	help
	  This daemon listens for traffic on the specified interfaces.
	  It has the built-in RSH and NetFlow engines to allow exporting
	  the accounting data the same way as Cisco routers do.
	  
	  http://lionet.info/ipcad/
```

## openwrt/package/iperf/Config.in
```kconfig
config BR2_PACKAGE_IPERF
	tristate "iperf - Internet Protocol bandwidth measuring tool"
#	default m if CONFIG_DEVEL
	default n
	help
	  Iperf is a modern alternative for measuring TCP and UDP bandwidth 
	  performance, allowing the tuning of various parameters and 
	  characteristics.
	  
	  http://dast.nlanr.net/Projects/Iperf/
	  
```

## openwrt/package/iproute2/Config.in
```kconfig
menu "iproute2.......................... A collection of utilites for controlling TCP/IP networking and Traffic Control"

config BR2_COMPILE_IPROUTE2
	tristate
	default n
	depends BR2_PACKAGE_IPROUTE2_IP || BR2_PACKAGE_IPROUTE2_TC

config BR2_PACKAGE_IP
	prompt   "ip.............................. A routing control utility"
	tristate
	default m if CONFIG_DEVEL
	select BR2_COMPILE_IPROUTE2

config BR2_PACKAGE_TC
	prompt   "tc.............................. A traffic control utility"
	tristate
	default m if CONFIG_DEVEL
	select BR2_COMPILE_IPROUTE2
	select BR2_PACKAGE_KMOD_SCHED

endmenu
```

## openwrt/package/ipsec-tools/Config.in
```kconfig
config BR2_PACKAGE_IPSEC_TOOLS
	prompt "ipsec-tools....................... IPsec management tools"
	tristate
	default m if BR2_LINUX_2_6_BRCM && CONFIG_DEVEL
	default m if BR2_LINUX_2_6_X86 && CONFIG_DEVEL
	select BR2_PACKAGE_LIBOPENSSL
	default n
	help
	  IPsec management tools
	  
	  http://ipsec-tools.sourceforge.net/
```

## openwrt/package/ipset/Config.in
```kconfig
config BR2_PACKAGE_IPSET
	prompt "ipset............................. Netfilter ip sets administration utility"
	tristate
	default m if CONFIG_DEVEL
	help
	  Netfilter ip sets administration utility
	  
	  http://ipset.netfilter.org/
```

## openwrt/package/iptables/Config.in
```kconfig
menu "iptables.......................... IPv4 / IPv6 firewall administration"

config BR2_COMPILE_IPTABLES
	bool
	default n
	depends BR2_PACKAGE_IPTABLES || BR2_PACKAGE_IP6TABLES

config BR2_PACKAGE_IPTABLES
	prompt "iptables.......................... IPv4 firewall administration tool"
	tristate
	default y
	select BR2_COMPILE_IPTABLES
	help
	  IPv4 firewall, NAT, and packet mangling tools.
	  
	  http://www.iptables.org/

config BR2_PACKAGE_IPTABLES_EXTRA
	prompt   "iptables-extra.................. Extra Iptables extensions for IPv4 firewalling (meta-package)"
	tristate
	default m if CONFIG_DEVEL
	depends BR2_PACKAGE_IPTABLES
	select BR2_PACKAGE_KMOD_IPTABLES_EXTRA
	select BR2_PACKAGE_IPTABLES_MOD_CONNTRACK
	select BR2_PACKAGE_IPTABLES_MOD_EXTRA
	select BR2_PACKAGE_IPTABLES_MOD_FILTER
	select BR2_PACKAGE_IPTABLES_MOD_IMQ
	select BR2_PACKAGE_IPTABLES_MOD_IPOPT
	select BR2_PACKAGE_IPTABLES_MOD_IPSEC
	select BR2_PACKAGE_IPTABLES_MOD_NAT
	select BR2_PACKAGE_IPTABLES_MOD_ULOG
	help
	  Extra Iptables extensions for IPv4 firewalling (meta-package)

config BR2_PACKAGE_IPTABLES_MOD_CONNTRACK
	prompt   "iptables-mod-conntrack.......... Iptables extensions for connection tracking"
	tristate
	default m if CONFIG_DEVEL
	depends BR2_PACKAGE_IPTABLES
	select BR2_PACKAGE_KMOD_IPT_CONNTRACK
	help
	  Iptables (IPv4) extensions for connection tracking

	  Includes:
            * libipt_conntrack
            * libipt_helper
            * libipt_connmark/CONNMARK

config BR2_PACKAGE_IPTABLES_MOD_FILTER
	prompt   "iptables-mod-filter............. Iptables extension for packet content inspection"
	tristate
	default m if CONFIG_DEVEL
	depends BR2_PACKAGE_IPTABLES
	select BR2_PACKAGE_KMOD_IPT_FILTER
	help
	  Iptables (IPv4) extension for packet content inspection

	  Includes:
            * libipt_ipp2p
            * libipt_layer7

config BR2_PACKAGE_IPTABLES_MOD_IMQ
       	prompt "iptables-mod-imq................ Iptables extensions for Intermediate Queuing Device QoS-support"
       	tristate
       	default m if CONFIG_DEVEL
       	depends BR2_PACKAGE_IPTABLES
       	select BR2_PACKAGE_KMOD_IMQ
       	help
          Iptables (IPv4) extensions for Intermediate Queuing Device QoS-support

          Includes:
            * libipt_IMQ

config BR2_PACKAGE_IPTABLES_MOD_IPOPT
	prompt   "iptables-mod-ipopt.............. Iptables extensions for matching/changing IP packet options"
	tristate
	default m if CONFIG_DEVEL
	depends BR2_PACKAGE_IPTABLES
	select BR2_PACKAGE_KMOD_IPT_IPOPT
	help
	  Extra Iptables (IPv4) extensions for matching/changing IP packet options

	  Includes:
            * libipt_dscp/DSCP
            * libipt_ecn/ECN
            * libipt_length
            * libipt_mac
            * libipt_tos/TOS
            * libipt_tcpmms
            * libipt_ttl/TTL
            * libipt_unclean

config BR2_PACKAGE_IPTABLES_MOD_IPSEC
	prompt   "iptables-mod-ipsec.............. Iptables extensions for matching special IPsec packets"
	tristate
	default m if CONFIG_DEVEL
	depends BR2_PACKAGE_IPTABLES
	select BR2_PACKAGE_KMOD_IPT_IPSEC
	help
	  Iptables (IPv4) extensions for matching special IPsec packets

	  Includes:
            * libipt_ah
            * libipt_esp

config BR2_PACKAGE_IPTABLES_MOD_NAT
	prompt   "iptables-mod-nat................ Iptables extensions for different NAT targets"
	tristate
	default m if CONFIG_DEVEL
	depends BR2_PACKAGE_IPTABLES
	select BR2_PACKAGE_KMOD_IPT_NAT
	help
	  Iptables (IPv4) extensions for different NAT targets

	  Includes:
	    * libipt_REDIRECT

config BR2_PACKAGE_IPTABLES_MOD_ULOG
	prompt   "iptables-mod-ulog............... Iptables extensions for user-space packet logging"
	tristate
	default m if CONFIG_DEVEL
	depends BR2_PACKAGE_IPTABLES
	select BR2_PACKAGE_KMOD_IPT_ULOG
	help
	  Iptables (IPv4) extensions for user-space packet logging

          Includes:
            * libipt_ULOG

config BR2_PACKAGE_IPTABLES_MOD_EXTRA
	prompt   "iptables-mod-extra.............. Other extra Iptables extensions"
	tristate
	default m if CONFIG_DEVEL
	depends BR2_PACKAGE_IPTABLES
	select BR2_PACKAGE_KMOD_IPT_EXTRA
	help
	  Other extra Iptables (IPv4) extensions

          Includes:
            * libipt_limit
            * libipt_owner
            * libipt_physdev
            * libipt_pkttype
            * libipt_recent

config BR2_PACKAGE_IPTABLES_UTILS
	prompt   "iptables-utils.................. Save and restore utilities"
	tristate
	default m if CONFIG_DEVEL
	depends BR2_PACKAGE_IPTABLES
	help
	  iptables-save and iptables-restore for Iptables (IPv4)
	  
	  http://www.iptables.org/

config BR2_PACKAGE_IP6TABLES
	prompt "ip6tables......................... IPv6 firewall administration tool"
	tristate
	default m if CONFIG_DEVEL
	select BR2_COMPILE_IPTABLES
	select BR2_PACKAGE_KMOD_IPV6
	help
	  IPv6 firewall, NAT, and packet mangling tools.
	  
	  http://www.iptables.org/

endmenu
```

## openwrt/package/iptraf/Config.in
```kconfig
config BR2_PACKAGE_IPTRAF
	prompt "iptraf............................ A console-based network monitoring program"
	tristate
	default m if CONFIG_DEVEL
	help
	  IPTraf is a console-based network statistics utility for Linux. It gathers 
	  a variety of figures such as TCP connection packet and byte counts, 
	  interface statistics and activity indicators, TCP/UDP traffic breakdowns, 
	  and LAN station packet and byte counts.
	  
	  http://iptraf.seul.org/
```

## openwrt/package/irssi/Config.in
```kconfig
config BR2_PACKAGE_IRSSI
	tristate "irssi - console irc client"
	default m if CONFIG_DEVEL
	select BR2_PACKAGE_GLIB1
	select BR2_PACKAGE_LIBNCURSES

	help
	IRC client for the text console
	 
	http://irssi.org
	  
```

## openwrt/package/jamvm/Config.in
```kconfig
config BR2_PACKAGE_JAMVM
        prompt "jamvm .............................A compact Java Virtual Machine"
	tristate
        default m if CONFIG_DEVEL
        help
          JamVM is a new Java Virtual Machine which conforms to the JVM specification version
          (blue book). In comparison to most other VM's (free and commercial) it is extremely
          small.However, unlike other small VMs (e.g. KVM) it is designed to support the full
          specification, and includes support for object finalisation, Soft/Weak/Phantom 
	  References, the Java Native Interface (JNI) and the Reflection API.

	  http://sourceforge.net/projects/jamvm
```

## openwrt/package/jpeg/Config.in
```kconfig
config BR2_COMPILE_JPEG
	bool
	default n
	depends BR2_PACKAGE_LIBJPEG

config BR2_PACKAGE_LIBJPEG
	tristate "libjpeg - The Independent JPEG Group's JPEG runtime library"
	default m if CONFIG_DEVEL
	select BR2_COMPILE_JPEG
	help
	  The Independent JPEG Group's JPEG runtime library.
	  
	  http://www.ijg.org/
	  
```
