OUTPUT_ARCH(mips)
ENTRY(_start)
SECTIONS
{
  /* Read-only sections, merged into text segment: */
  . = @LOADADDR@;
  .text      :
  {
    _ftext = . ;
    *(.text)
    *(.rodata)
    lzma_start = .;
    kernel.o
    lzma_end = .;
  } =0

  .reginfo : { *(.reginfo) }

  .bss       :
  {
   *(.bss)
  }
}
