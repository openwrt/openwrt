## openwrt/target/linux/package/mini_fo/Config.in
```kconfig
config PACKAGE_KMOD_MINI_FO
	prompt "kmod-mini_fo...................... mini fanout overlay file system"
	tristate
	default m if DEVEL
	help
	  The mini fanout overlay file system.
```

## openwrt/target/linux/package/openswan/Config.in
```kconfig
config PACKAGE_KMOD_OPENSWAN
	prompt "kmod-openswan..................... Openswan kernel module"
	tristate
	default m if DEVEL
	help
	  Openswan is an implementation of IPsec for Linux.
	  
	  http://www.openswan.org/
	  
	  This package contains the Openswan IPSec module for the kernel
```

## openwrt/target/linux/package/shfs/Config.in
```kconfig
config BR2_PACKAGE_KMOD_SHFS
	prompt "kmod-shfs......................... Shell FileSystem kernel module (ShFS) kernel module"
	tristate
	default m if CONFIG_DEVEL
	help
	  ShFS is a simple and easy to use Linux kernel module which 
	  allows you to mount remote filesystems using a plain shell 
	  (SSH) connection. When using ShFS, you can access all remote 
	  files just like the local ones, only the access is governed 
	  through the transport security of SSH.
	  
	  ShFS supports some nice features:
	  
	   * file cache for access speedup
	   * perl and shell code for the remote (server) side
	   * could preserve uid/gid (root connection)
	   * number of remote host platforms (Linux, Solaris, Cygwin, ...)
	   * Linux kernel 2.4.10+ and 2.6
	   * arbitrary command used for connection (instead of SSH)
	   * persistent connection (reconnect after SSH dies) 
	  
	  http://shfs.sourceforge.net/
```

## openwrt/target/linux/package/spca5xx/Config.in
```kconfig
config PACKAGE_KMOD_SPCA5XX
	prompt "kmod-spca5xx...................... Kernel driver for SPCA5XX based USB cameras"
	tristate
	default m if DEVEL
	help
	  Kernel driver for SPCA5XX based USB cameras
	  
	  http://mxhaard.free.fr/
	  
```

## openwrt/target/linux/package/switch/Config.in
```kconfig
config BR2_PACKAGE_KMOD_SWITCH
	prompt "kmod-switch....................... Kernel driver for ROBO and ADMTEK SWITCH"
	tristate
	default y if BR2_LINUX_2_6_BRCM || BR2_LINUX_2_4_BRCM
	default m if CONFIG_DEVEL
	default n
	help
	  Kernel driver for ROBO and ADMTEK switches.
	  
	  http://www.openwrt.org
	  
```

## openwrt/target/linux/package/ueagle-atm/Config.in
```kconfig
config PACKAGE_KMOD_UEAGLE_ATM
	prompt "kmod-ueagle-atm.................... Kernel driver for Eagle 8051 based USB ADSL modems"
	tristate
	depends LINUX_2_6_BRCM
	default m if DEVEL
	help
	  Kernel driver for Eagle 8051 USB ADSL modems
	  
	  http://www.eagle-usb.org
	  
```

## openwrt/target/linux/package/wlcompat/Config.in
```kconfig
config BR2_PACKAGE_KMOD_WLCOMPAT
	prompt "kmod-wlcompat..................... Wrapper providing Wireless Extensions for Broadcom wl module"
	tristate
	default y
	depends BR2_PACKAGE_KMOD_BRCM_WL || BR2_PACKAGE_KMOD_BRCM_WL2
	help
	  A wrapper module, that provides Wireless Extension support for the
	  proprietary Broadcom wl module.

config BR2_PACKAGE_KMOD_WLCOMPAT_DEBUG
	prompt "kmod-wlcompat-debug............... Wrapper providing Wireless Extensions for Broadcom wl module (debug)"
	tristate
	default m
	depends BR2_PACKAGE_KMOD_BRCM_WL || BR2_PACKAGE_KMOD_BRCM_WL2
	help
	  A wrapper module, that provides Wireless Extension support for the
	  proprietary Broadcom wl module. (debug version)
```

## openwrt/target/linux/package/zd1211/Config.in
```kconfig
config BR2_PACKAGE_KMOD_ZD1211
	prompt "kmod-zd12111...................... Driver for Zydas 1211 based devices"
	tristate
	depends BR2_LINUX_2_6
	default m if CONFIG_DEVEL
	help
	  Linux driver for the ZyDAS ZD1211 802.11b/g USB-WLAN-Chip. 
	  Initially contributed by ZyDAS, this driver is actively maintained 
	  by the open source community.
	
	  http://zd1211.ath.cx/
```

## openwrt/target/squashfs-lzma/Config.in
```kconfig
config BR2_TARGET_ROOTFS_SQUASHFS_LZMA
	bool "squashfs-lzma"
	help
	  Build a squashfs-lzma root filesystem
```

## openwrt/target/squashfs/Config.in
```kconfig
config BR2_TARGET_ROOTFS_SQUASHFS
	bool "squashfs"
	help
	  Build a squashfs root filesystem
```

## openwrt/toolchain/Config.in
```kconfig
#

menuconfig TOOLCHAINOPTS
	bool "Toolchain Options" if DEVEL

source "toolchain/binutils/Config.in"
source "toolchain/gcc/Config.in"

config GDB
	bool
	prompt "Build gdb" if TOOLCHAINOPTS
	default n
	help
		Enable if you want to build the gdb

config ENABLE_MULTILIB
	bool
	prompt "Enable multilib support?" if TOOLCHAINOPTS
	default n
	help
	    If you want multilib enabled, enable this...

config LARGEFILE
	bool
	prompt "Enable large file (files > 2 GB) support?" if TOOLCHAINOPTS
	depends on !cris
	default y
	help
	    Enable large file (files > 2 GB) support

config SOFT_FLOAT
	bool
	prompt "Use software floating point by default" if TOOLCHAINOPTS
	default n
	depends on arm || mips || powerpc
	help
	  If your target CPU does not have a Floating Point Unit (FPU) or a
	  kernel FPU emulator, but you still wish to support floating point
	  functions, then everything will need to be compiled with soft floating
	  point support (-msoft-float).

	  Most people will answer N.

config TARGET_OPTIMIZATION
	string
	prompt "Target Optimizations" if TOOLCHAINOPTS
	default "-Os -pipe -march=i486 -funit-at-a-time" if i386
	default "-Os -pipe -mips32 -mtune=mips32 -funit-at-a-time" if mipsel || mips
	default "-Os -pipe -funit-at-a-time"
	help
	  Optimizations to use when building for the target host.

source "toolchain/gcc/Config.version"
```

## openwrt/toolchain/binutils/Config.in
```kconfig
# Choose binutils version.

choice
	prompt "Binutils Version" if TOOLCHAINOPTS
	default BINUTILS_VERSION_2_16_1
	help
	  Select the version of binutils you wish to use.

	config BINUTILS_VERSION_2_16_1
		bool "binutils 2.16.1"

	config BINUTILS_VERSION_2_17
		bool "binutils 2.17"

endchoice

config BINUTILS_VERSION
	string
	prompt "Binutils Version" if (TOOLCHAINOPTS && NULL)
	default "2.16.1"          if BINUTILS_VERSION_2_16_1
	default "2.17"            if BINUTILS_VERSION_2_17
	default "2.16.1"
```

## openwrt/toolchain/ccache/Config.in
```kconfig
#
if CONFIG_DEVEL
	comment "Ccache Options"
endif

config BR2_CCACHE
	bool "Enable ccache support?" if CONFIG_DEVEL
	default y
	help
	    Enable ccache support?
```

## openwrt/toolchain/gcc/Config.in
```kconfig
# Choose gcc version.

choice
	prompt "GCC compiler Version" if TOOLCHAINOPTS
	default GCC_VERSION_4_1_1 if LINUX_2_6_ARUBA
	default GCC_VERSION_3_4_4 if LINUX_2_4_BRCM
	default GCC_VERSION_3_4_6
	help
	  Select the version of gcc you wish to use.


	config GCC_VERSION_3_4_4
		bool "gcc 3.4.4"

	config GCC_VERSION_3_4_5
		bool "gcc 3.4.5"

	config GCC_VERSION_3_4_6
		bool "gcc 3.4.6"

	config GCC_VERSION_4_0_2
		bool "gcc 4.0.2"

	config GCC_VERSION_4_0_3
		bool "gcc 4.0.3"

	config GCC_VERSION_4_1_0
		bool "gcc 4.1.0"

	config GCC_VERSION_4_1_1
		bool "gcc 4.1.1"

endchoice

config EXTRA_GCC_CONFIG_OPTIONS
	string
	prompt "Additional gcc options" if TOOLCHAINOPTS
	default ""
	help
	    Any additional gcc options you may want to include....

config INSTALL_LIBSTDCPP
	bool
	prompt "Build/install c++ compiler and libstdc++?" if TOOLCHAINOPTS
	default y
	help
	    Build/install c++ compiler and libstdc++?
```

## openwrt/toolchain/gdb/Config.in
```kconfig
comment "Gdb Options"

config BR2_PACKAGE_GDB_CLIENT
	bool "Build gdb client for the Host"
	default n
	help
	    Build gdb to run on the host to debug programs running on the target.
```

## openwrt/toolchain/uClibc/Config.in
```kconfig
# Choose uClibc options
#
if CONFIG_DEVEL
	comment "uClibc Options"
endif

config BR2_UCLIBC_VERSION_SNAPSHOT
	bool
	prompt "Use the daily snapshot of uClibc?" if CONFIG_DEVEL
	default n
	help
	    Would you like to use the latest daily snapshot?

config BR2_USE_UCLIBC_SNAPSHOT
	string
	default "snapshot"
	depends on BR2_UCLIBC_VERSION_SNAPSHOT
```

## package/6tunnel/Config.in
```kconfig
config BR2_PACKAGE_6TUNNEL
	prompt "6tunnel........................... IPv4 / IPv6 tunnel proxy"
	tristate
	default m if CONFIG_DEVEL
	select BR2_PACKAGE_KMOD_IPV6
	help
	  6tunnel allows you to use services provided by IPv6 hosts with IPv4-only 
	  applications and vice-versa. It can bind to any of your IPv4 (default) 
	  or IPv6 addresses and forward all data to IPv4 or IPv6 (default) host.
	  
	  http://toxygen.net/6tunnel/
```
