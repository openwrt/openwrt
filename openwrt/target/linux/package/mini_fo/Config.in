## package/Config.in
```kconfig
#

menu "OpenWrt Package Selection"

comment "The default set"
source "package/busybox/Config.in"
source "package/bridge/Config.in"
source "package/dnsmasq/Config.in"
source "package/ipkg/Config.in"
source "package/iptables/Config.in"
source "package/mtd/Config.in"
source "package/nvram/Config.in"

comment "Applications"
source "package/collectd/Config.in"
source "package/deco/Config.in"
source "package/gpsd/Config.in"
source "package/haserl/Config.in"
source "package/irssi/Config.in"
source "package/lcd4linux/Config.in"
source "package/less/Config.in"
source "package/lua/Config.in"
source "package/microperl/Config.in"
source "package/monit/Config.in"
source "package/nano/Config.in"
source "package/osiris/Config.in"
source "package/php4/Config.in"
source "package/php5/Config.in"
source "package/psybnc/Config.in"
menu "sablevm........................... A Java Virtual Machine (JVM) implementation"
source "package/sablevm/Config.in"
source "package/sablevm-classpath/Config.in"
source "package/libffi-sable/Config.in"
endmenu
source "package/sane-backends/Config.in"
menu "rrdtool........................... Round-Robin Database (RRD) libraries and tools"
source "package/rrdtool/Config.in"
source "package/rrdtool1/Config.in"
source "package/rrdcollect/Config.in"
endmenu
source "package/screen/Config.in"

comment "Networking"
source "package/aircrack/Config.in"
source "package/amwall/Config.in"
source "package/arpd/Config.in"
source "package/arptables/Config.in"
source "package/arpwatch/Config.in"
source "package/asterisk/Config.in"
source "package/atftp/Config.in"
source "package/avahi/Config.in"
source "package/bind/Config.in"
source "package/bwm/Config.in"
source "package/chillispot/Config.in"
source "package/cifsmount/Config.in"
source "package/cups/Config.in"
source "package/cutter/Config.in"
source "package/dhcp/Config.in"
source "package/dhcp-forwarder/Config.in"
source "package/dropbear/Config.in"
source "package/dsniff/Config.in"
source "package/ebtables/Config.in"
source "package/elhttp/Config.in"
source "package/ether-wake/Config.in"
source "package/ez-ipupdate/Config.in"
source "package/fping/Config.in"
source "package/fprobe/Config.in"
source "package/fprobe-ulog/Config.in"
source "package/freeradius/Config.in"
source "package/frickin/Config.in"
source "package/howl/Config.in"
source "package/hostap-utils/Config.in"
source "package/hostapd/Config.in"
source "package/htpdate/Config.in"
source "package/ipcad/Config.in"
source "package/iproute2/Config.in"
source "package/iperf/Config.in"
source "package/ipsec-tools/Config.in"
source "package/ipset/Config.in"
source "package/iptables-snmp/Config.in"
source "package/iptraf/Config.in"
source "package/kismet/Config.in"
source "package/knock/Config.in"
source "package/l2tpd/Config.in"
source "package/l2tpns/Config.in"
source "package/lighttpd/Config.in"
source "package/linux-atm/Config.in"
source "package/macchanger/Config.in"
source "package/maradns/Config.in"
source "package/mini_httpd/Config.in"
source "package/mini_sendmail/Config.in"
source "package/mtr/Config.in"
source "package/net-snmp/Config.in"
source "package/netstat-nat/Config.in"
source "package/nfs-server/Config.in"
source "package/nmap/Config.in"
source "package/nocatsplash/Config.in"
source "package/ntpclient/Config.in"
source "package/olsrd/Config.in"
source "package/openntpd/Config.in"
source "package/openssh/Config.in"
source "package/openswan/Config.in"
source "package/openvpn/Config.in"
source "package/p910nd/Config.in"
source "package/parprouted/Config.in"
source "package/pmacct/Config.in"
source "package/portmap/Config.in"
source "package/portsentry/Config.in"
source "package/ppp/Config.in"
source "package/rp-pppoe/Config.in"
source "package/pptp/Config.in"
source "package/pptpd/Config.in"
source "package/ptunnel/Config.in"
source "package/quagga/Config.in"
source "package/raddump/Config.in"
source "package/rarpd/Config.in"
source "package/reaim/Config.in"
source "package/robocfg/Config.in"
source "package/rrs/Config.in"
source "package/rsync/Config.in"
source "package/samba/Config.in"
source "package/scdp/Config.in"
source "package/ser/Config.in"
source "package/shat/Config.in"
source "package/siproxd/Config.in"
source "package/sipsak/Config.in"
source "package/slurm/Config.in"
source "package/snort/Config.in"
source "package/snort-wireless/Config.in"
source "package/socat/Config.in"
source "package/ssmtp/Config.in"
source "package/srelay/Config.in"
source "package/tmsnc/Config.in"
source "package/tcpdump/Config.in"
source "package/tinc/Config.in"
source "package/tor/Config.in"
source "package/ttcp/Config.in"
source "package/ulogd/Config.in"
source "package/updatedd/Config.in"
source "package/vgp/Config.in"
source "package/vnc-reflector/Config.in"
source "package/vnstat/Config.in"
source "package/vpnc/Config.in"
source "package/vrrpd/Config.in"
source "package/vsftpd/Config.in"
source "package/vtun/Config.in"
source "package/wccpd/Config.in"
source "package/wificonf/Config.in"
source "package/wifidog/Config.in"
source "package/wireless-tools/Config.in"
source "package/wiviz/Config.in"
source "package/wknock/Config.in"
source "package/wol/Config.in"
source "package/wondershaper/Config.in"
source "package/wpa_supplicant/Config.in"
source "package/wput/Config.in"
source "package/wrt-radauth/Config.in"
source "package/xinetd/Config.in"
source "package/xsupplicant/Config.in"

comment "IPv6"
source "package/6tunnel/Config.in"
source "package/aiccu/Config.in"
source "package/dhcp6/Config.in"
source "package/miredo/Config.in"
source "package/ndisc/Config.in"
source "package/radvd/Config.in"

comment "Libraries"
source "package/cgilib/Config.in"
source "package/glib/Config.in"
source "package/id3lib/Config.in"
source "package/libamsel/Config.in"
source "package/libao/Config.in"
source "package/libart/Config.in"
source "package/libcli/Config.in"
source "package/curl/Config.in" # libcurl
source "package/libdaemon/Config.in"
source "package/libdb/Config.in"
source "package/libdnet/Config.in"
source "package/libelf/Config.in"
source "package/libevent/Config.in"
source "package/expat/Config.in" # libexpat
source "package/flac/Config.in"  # libflac
source "package/freetype/Config.in"  # libfreetype
source "package/base-files/Config.in" # libgcc
source "package/libgcrypt/Config.in"
source "package/libgd/Config.in"
source "package/libgdbm/Config.in"
source "package/gmp/Config.in"  # libgmp
source "package/gnutls/Config.in" ## libgnutls
source "package/libgpg-error/Config.in"
source "package/gsm/Config.in" # libgsm
source "package/libid3tag/Config.in"
source "package/jpeg/Config.in"  # libjpeg
source "package/libtool/Config.in"  # libltdl
source "package/liblzo/Config.in"
source "package/libmad/Config.in"
source "package/matrixssl/Config.in"  # libmatrixssl
source "package/mysql/Config.in"  # limysqlclient
source "package/ncurses/Config.in"  # libncurses
source "package/libnet/Config.in"
source "package/libnids/Config.in"
source "package/libogg/Config.in"
source "package/opencdk/Config.in"  # libopencdk
source "package/openldap/Config.in"  # libopenldap
source "package/openssl/Config.in"  # libopenssl
source "package/libosip2/Config.in"
source "package/libpcap/Config.in"
source "package/pcre/Config.in"  # libpcre
source "package/libpng/Config.in"
source "package/popt/Config.in"  # libpopt
source "package/postgresql/Config.in"  # libpq
source "package/libpthread/Config.in"
source "package/readline/Config.in"  # libreadline
source "package/cyrus-sasl/Config.in"  # libsasl2
source "package/speex/Config.in" # libspeex
source "package/sqlite/Config.in" # libsqlite
source "package/sqlite2/Config.in" # libsqlite2
source "package/libtasn1/Config.in"
source "package/libupnp/Config.in"
source "package/libusb/Config.in"
source "package/libvorbis/Config.in"
source "package/libvorbisidec/Config.in"
source "package/libxml2/Config.in"
source "package/libxslt/Config.in"
source "package/uclibc++/Config.in"
source "package/ustl/Config.in"
source "package/zlib/Config.in"

comment "Multimedia"
source "package/gmediaserver/Config.in"
source "package/icecast/Config.in"
source "package/madplay/Config.in"
source "package/mpd/Config.in"
source "package/mt-daapd/Config.in"
source "package/palantir/Config.in"
source "package/peercast/Config.in"
source "package/setpwc/Config.in"

comment "Serial communications & terminal emulation"
source "package/microcom/Config.in"
source "package/picocom/Config.in"
source "package/serdisplib/Config.in"
source "package/setserial/Config.in"

comment "Utilities"
source "package/bc/Config.in"
source "package/gdbserver/Config.in"
source "package/madwifi-tools/Config.in"
source "package/pcmcia-cs/Config.in"  # pcmcia-utils
source "package/usbutils/Config.in"  # lsusb
source "package/strace/Config.in"
source "package/udev/Config.in"

comment "FileSystems related"
source "package/dosfstools/Config.in"
source "package/e2fsprogs/Config.in"
source "package/fuse/Config.in"
source "package/shfs/Config.in"
source "package/util-linux/Config.in"

comment "Bluetooth"
source "package/bluez-libs/Config.in"
source "package/bluez-utils/Config.in"
source "package/miax/Config.in"

comment "Extra stuff"
source "package/sdk/Config.in"

config BR2_PACKAGE_IMAGEBUILDER
	bool "OpenWrt Image Builder"
	default y if CONFIG_DEVEL
	help
	  Build an OpenWrt Image Builder.
	  This package contains the necessary (precompiled) tools and all packages to generate
	  firmware images from package lists, without having to use the full buildroot.
	  Useful for building images with custom scripts or extra packages.

endmenu

source "package/Sysconf.in"
```

## package/aiccu/Config.in
```kconfig
config BR2_PACKAGE_AICCU
	prompt "aiccu............................. SixXS Automatic IPv6 Connectivity Client Utility"
	tristate
	default m if CONFIG_DEVEL
	select BR2_PACKAGE_KMOD_IPV6
	select BR2_PACKAGE_LIBPTHREAD
	help
	  SixXS Automatic IPv6 Connectivity Client Utility
	  
	  For more information about SixXS check http://www.sixxs.net/
```

## package/aircrack/Config.in
```kconfig
config BR2_PACKAGE_AIRCRACK
	prompt "aircrack.......................... A set of tools for auditing wireless networks"
	tristate
	default m if CONFIG_DEVEL
	select BR2_PACKAGE_LIBPTHREAD
	help
	  aircrack is a set of tools for auditing wireless networks:
	  
	   * aircrack: static WEP and WPA-PSK key cracker
	   * airdecap: decrypts WEP/WPA capture files
	   * aireplay: 802.11 packet injection program
	   * airodump: 802.11 packet capture program
	  
	  http://www.cr0.net:8040/code/network/aircrack/
```

## package/arpd/Config.in
```kconfig
config BR2_PACKAGE_ARPD
	prompt "arpd.............................. A daemon to fake ARP replies"
	tristate
	default m if CONFIG_DEVEL
	select BR2_PACKAGE_LIBPCAP
	select BR2_PACKAGE_LIBDNET
	select BR2_PACKAGE_LIBEVENT
	help
	  Generates ARP responses for (locally unused) IP addresses
	  
	  http://www.honeyd.org/tools.php
```

## package/arpwatch/Config.in
```kconfig
config BR2_PACKAGE_ARPWATCH
	tristate "arpwatch"
	default m
	help
	  Ethernet monitor program for keeping track of ethernet/ip address pairings
	  
```

## package/asterisk/Config.in
```kconfig
menu "asterisk - Complete open source PBX"

config BR2_PACKAGE_ASTERISK
	prompt "asterisk - Complete open source PBX"
	tristate
	default m if CONFIG_DEVEL
	help
 	  Asterisk is a complete PBX in software. It provides all of the features
	  you would expect from a PBX and more. Asterisk does voice over IP in three
	  protocols, and can interoperate with almost all standards-based telephony 
	  equipment using relatively inexpensive hardware.
	  
	  http://www.asterisk.org/
	  

config BR2_PACKAGE_ASTERISK_CHAN_BLUETOOTH
	prompt "...-chan-bluetooth - Bluetooth HandsFreeProfile support for Asterisk"
	tristate
	default m if CONFIG_DEVEL
	depends BR2_PACKAGE_ASTERISK
	select BR2_PACKAGE_BLUEZ_LIBS
	help
	  The Bluetooth HandsFreeProfile support for Asterisk

config BR2_PACKAGE_ASTERISK_CODEC_ILBC
	prompt "...-codec-ilbc - Internet Low Bitrate Codec (ILBC) Translator"
	tristate
	default m if CONFIG_DEVEL
	depends BR2_PACKAGE_ASTERISK
	help
	  The Internet Low Bitrate Codec (ILBC) Translator for Asterisk

config BR2_PACKAGE_ASTERISK_CODEC_LPC10
	prompt "...-codec-lpc10 - LPC10 (Linear Predictor Code) 2.4kbps Voice Coder"
	tristate
	default m if CONFIG_DEVEL
	depends BR2_PACKAGE_ASTERISK
	help
	  The LPC10 (Linear Predictor Code) 2.4kbps Voice Coder for Asterisk

config BR2_PACKAGE_ASTERISK_CODEC_SPEEX
	prompt "...-codec-speex - Speex/PCM16 Codec Translator"
	tristate
	default m if CONFIG_DEVEL
	depends BR2_PACKAGE_ASTERISK
	select BR2_PACKAGE_LIBSPEEX
	help
	  The Speex speech compression codec for Asterisk

config BR2_PACKAGE_ASTERISK_PBX_DUNDI
	prompt "...-pbx-dundi - Distributed Universal Number Discovery (DUNDi) support"
	tristate
	default m if CONFIG_DEVEL
	depends BR2_PACKAGE_ASTERISK
	help
	  Distributed Universal Number Discovery (DUNDi) support for Asterisk

config BR2_PACKAGE_ASTERISK_MYSQL
	prompt "...-mysql - MySQL modules"
	tristate
	default m if CONFIG_DEVEL
	depends BR2_PACKAGE_ASTERISK
	select BR2_PACKAGE_LIBMYSQLCLIENT
	help
	  MySQL modules for Asterisk

config BR2_PACKAGE_ASTERISK_PGSQL
	prompt "...-pgsql - PostgreSQL modules"
	tristate
	default m if CONFIG_DEVEL
	depends BR2_PACKAGE_ASTERISK
	select BR2_PACKAGE_LIBPQ
	help
	  PostgreSQL modules for Asterisk
	  
config BR2_PACKAGE_ASTERISK_SOUNDS
	prompt "...-sounds - Sound files"
	tristate
	default m if CONFIG_DEVEL
	depends BR2_PACKAGE_ASTERISK
	help
	  Sound files for Asterisk

config BR2_PACKAGE_ASTERISK_VOICEMAIL
	prompt "...-voicemail - Voicemail support"
	tristate
	default m if CONFIG_DEVEL
	depends BR2_PACKAGE_ASTERISK
	help
	  Voicemail related modules for Asterisk
	  
endmenu
```

## package/autossh/Config.in
```kconfig
config BR2_PACKAGE_AUTOSSH
	prompt "autossh........................... Auto handle ssh tunnels"
	tristate
	default m if CONFIG_DEVEL
	help
	      autossh is a program to start a copy of ssh and monitor it,
	      restarting it as necessary should it die or stop passing traffic.

	      http://www.harding.motd.ca/autossh/
```
