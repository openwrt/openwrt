## package/network/services/hostapd/Config.in
```kconfig
# wpa_supplicant config
config WPA_SUPPLICANT_NO_TIMESTAMP_CHECK
	bool "Disable timestamp check"
	depends on PACKAGE_wpa-supplicant || PACKAGE_wpa-supplicant-mesh || PACKAGE_wpa-supplicant-mini || PACKAGE_wpad || PACKAGE_wpad-mini || PACKAGE_wpad-mesh
	default n
	help
	  This disables the timestamp check for certificates in wpa_supplicant
	  Useful for devices without RTC that cannot reliably get the real date/time

choice
	prompt "Choose TLS provider"
	default WPA_SUPPLICANT_INTERNAL
	depends on PACKAGE_wpa-supplicant || PACKAGE_wpad || PACKAGE_wpad-mesh

config WPA_SUPPLICANT_INTERNAL
	bool "internal"
	depends on PACKAGE_wpa-supplicant || PACKAGE_wpad

config WPA_SUPPLICANT_OPENSSL
	bool "openssl"
	select PACKAGE_libopenssl

config WPA_SUPPLICANT_WOLFSSL
	bool "wolfssl"
	select PACKAGE_libwolfssl
	select WOLFSSL_HAS_AES_CCM
	select WOLFSSL_HAS_AES_GCM
	select WOLFSSL_HAS_ARC4
	select WOLFSSL_HAS_DES3
	select WOLFSSL_HAS_DH
	select WOLFSSL_HAS_ECC
	select WOLFSSL_HAS_OCSP
	select WOLFSSL_HAS_PSK
	select WOLFSSL_HAS_SESSION_TICKET
	select WOLFSSL_HAS_WPAS

endchoice

config WPA_RFKILL_SUPPORT
	bool "Add rfkill support"
	depends on PACKAGE_wpa-supplicant || PACKAGE_wpa-supplicant-mesh || PACKAGE_wpa-supplicant-mini || PACKAGE_wpad || PACKAGE_wpad-mini || PACKAGE_wpad-mesh
	default n

config WPA_MSG_MIN_PRIORITY
	int "Minimum debug message priority"
	default 3
	help
	  Useful values are:
	    0 = all messages
		1 = raw message dumps
		2 = most debugging messages
		3 = info messages
		4 = warnings
		5 = errors

config DRIVER_WEXT_SUPPORT
	bool
	default n

config DRIVER_11N_SUPPORT
	bool
	default n

config DRIVER_11AC_SUPPORT
	bool
	default n

config DRIVER_11W_SUPPORT
	bool
	default n
```

## package/network/services/nft-fullcone/src/Kconfig
```kconfig
#
# Nftables/netfilter fullcone expression support
#
config NFT_FULLCONE
	depends on NF_CONNTRACK
	depends on NF_NAT
	tristate "Netfilter nf_tables fullcone support"
	help
	  This options adds the "fullcone" expression that you can use
	  to perform NAT in the RFC3489-compatible full cone SNAT flavour.
	  Currently only UDP traffic is supported for full-cone NAT.
	  For other protos FULLCONENAT is equivalent to MASQUERADE.

	  To compile this code as a module, choose M here: the module will be
	  called nft_fullcone.

	  If unsure, say N.
```

## package/network/utils/curl/Config.in
```kconfig
menu "Configuration"
	depends on PACKAGE_libcurl

choice
	prompt "SSL library"
	default LIBCURL_POLARSSL

config LIBCURL_POLARSSL
	bool "PolarSSL"

config LIBCURL_CYASSL
	bool "CyaSSL"

config LIBCURL_AXTLS
	bool "axTLS"

config LIBCURL_OPENSSL
	bool "OpenSSL"

config LIBCURL_GNUTLS
	bool "GNUTLS"

config LIBCURL_NOSSL
	bool "No SSL support"

endchoice

config LIBCURL_COOKIES
	bool "Enable cookies support"
	default y

config LIBCURL_CRYPTO_AUTH
	bool "Enable cryptographic authentication"
	default n

config LIBCURL_DICT
	bool "Enable DICT support"
	default n

config LIBCURL_FILE
	bool "Enable FILE support"
	default y

config LIBCURL_FTP
	bool "Enable FTP support"
	default y

config LIBCURL_GOPHER
	bool "Enable Gopher support"
	default n

config LIBCURL_HTTP
	bool "Enable HTTP support"
	default y

config LIBCURL_HTTPS
	bool "Enable HTTPS support"
	default n

config LIBCURL_IMAP
	bool "Enable IMAP support"
	default n

config LIBCURL_LDAP
	bool "Enable LDAP support"
	default n

config LIBCURL_LDAPS
	bool "Enable LDAPS support"
	default n

config LIBCURL_LIBCURL_OPTION
	bool "Enable --libcurl C code generation support"
	default n

config LIBCURL_POP3
	bool "Enable POP3 support"
	default n

config LIBCURL_PROXY
	bool "Enable proxy support"
	default n

config LIBCURL_RTSP
	bool "Enable RTSP support"
	default n

config LIBCURL_SMTP
	bool "Enable SMTP support"
	default n

config LIBCURL_SSPI
	bool "Enable SSPI"
	default n

config LIBCURL_TELNET
	bool "Enable TELNET support"
	default n

config LIBCURL_TFTP
	bool "Enable TFTP support"
	default n

config LIBCURL_THREADED_RESOLVER
	bool "Enable threaded resolver"
	default n

config LIBCURL_TLS-SRP
	bool "Enable TLS-SRP authentication"
	default n

config LIBCURL_ZLIB
	bool "Use zlib"
	default n

endmenu
```

## package/network/utils/layerscape/restool/Config.in
```kconfig
config RESTOOL_BUSYBOX_SUPPORT
	bool
	depends on PACKAGE_restool
	select BUSYBOX_CUSTOM
	select BUSYBOX_CONFIG_USLEEP
	default y
```

## package/nfs-server/Config.in
```kconfig
config BR2_PACKAGE_NFS_SERVER
	prompt "nfs-server........................ User Space NFS server"
	tristate
	default m if CONFIG_DEVEL
	select BR2_PACKAGE_PORTMAP
	help
	  User Space NFS Server
```

## package/nmap/Config.in
```kconfig
config BR2_PACKAGE_NMAP
	prompt "nmap.............................. Network exploration and/or security auditing utility"
	tristate
	default m if CONFIG_DEVEL
	select BR2_PACKAGE_LIBDNET
	select BR2_PACKAGE_LIBPCAP
	select BR2_PACKAGE_LIBPCRE
	select BR2_PACKAGE_UCLIBCXX
	help
	  A free open source utility for network exploration or security auditing. 
	  
	  http://www.insecure.org/nmap/
```

## package/nocatsplash/Config.in
```kconfig
config BR2_PACKAGE_NOCATSPLASH
	prompt "nocatsplash....................... Open public network gateway daemon"
	tristate
	default m if CONFIG_DEVEL
	help
	  NoCatSplash is an Open Public Network Gateway Daemon.
	  It performs as a [captive/open/active] portal. When run on a gateway/router
	  on a network, all web requests are redirected until the client either logs
	  in or clicks "I Accept" to an AUP. The gateway daemon then changes the
	  firewall rules on the gateway to pass traffic for that client (based on IP
	  address and MAC address).
```

## package/ntpclient/Config.in
```kconfig
config BR2_PACKAGE_NTPCLIENT
	tristate "ntpclient - NTP (Network Time Protocol) client"
	default m if CONFIG_DEVEL
	help
	  NTP client for setting system time from NTP servers.
	  
	  http://doolittle.faludi.com/ntpclient/
	  
```

## package/olsrd/Config.in
```kconfig
menu "olsrd............................. OLSR (Optimized Link State Routing) daemon"

config BR2_PACKAGE_OLSRD
	prompt "olsrd............................. OLSR (Optimized Link State Routing) daemon"
	tristate
	default m if CONFIG_DEVEL
	help
	  The Optimized Link State Routing daemon
	  
	  http://www.olsr.org/

config BR2_PACKAGE_OLSRD_MOD_DOT_DRAW
	prompt   "olsrd-mod-dot-draw.............. Dot topology information plugin"
	tristate
	default m if CONFIG_DEVEL
	depends BR2_PACKAGE_OLSRD

config BR2_PACKAGE_OLSRD_MOD_DYN_GW
	prompt   "olsrd-mod-dyn-gw................ Dynamic internet gateway plugin"
	tristate
	default m if CONFIG_DEVEL
	depends BR2_PACKAGE_OLSRD

config BR2_PACKAGE_OLSRD_MOD_HTTPINFO
	prompt   "olsrd-mod-httpinfo.............. Small informative web server plugin"
	tristate
	default m if CONFIG_DEVEL
	depends BR2_PACKAGE_OLSRD

config BR2_PACKAGE_OLSRD_MOD_NAMESERVICE
	prompt   "olsrd-mod-nameservice........... Lightweight hostname resolver plugin"
	tristate
	default m if CONFIG_DEVEL
	depends BR2_PACKAGE_OLSRD

config BR2_PACKAGE_OLSRD_MOD_POWER
	prompt   "olsrd-mod-power................. Power status plugin"
	tristate
	default m if CONFIG_DEVEL
	depends BR2_PACKAGE_OLSRD

config BR2_PACKAGE_OLSRD_MOD_SECURE
	prompt   "olsrd-mod-secure................ Message signing plugin to secure olsrd routing domain"
	tristate
	default m if CONFIG_DEVEL
	depends BR2_PACKAGE_OLSRD

config BR2_PACKAGE_OLSRD_MOD_TAS
	prompt   "olsrd-mod-tas................... Tiny Application Server (TAS) plugin for olsrd"
	tristate
	default m if CONFIG_DEVEL
	depends BR2_PACKAGE_OLSRD

endmenu
```

## package/openldap/Config.in
```kconfig
config BR2_PACKAGE_OPENLDAP
	prompt "openldap - Open source LDAP (Lightweight Directory Access Protocol) implementation"
	bool
	default y if CONFIG_DEVEL
	help
	  OpenLDAP Software is an open source implementation of the 
	  Lightweight Directory Access Protocol (LDAP).
	  
	  http://www.openldap.org/
	  

config BR2_PACKAGE_LIBOPENLDAP
	tristate "libopenldap - client libraries"
	default m if CONFIG_DEVEL
	depends BR2_PACKAGE_OPENLDAP

config BR2_PACKAGE_OPENLDAP_UTILS
	tristate "openldap-utils - client utilities"
	default m if CONFIG_DEVEL
	depends BR2_PACKAGE_LIBOPENLDAP
```

## package/openntpd/Config.in
```kconfig
config BR2_PACKAGE_OPENNTPD
	tristate "Openntpd"
	default m
	help
	NTP server
	http://www.openntpd.org
```

## package/openssl/Config.in
```kconfig
menu "Configuration"
	depends on PACKAGE_libopenssl

config OPENSSL_ENGINE_CRYPTO
	bool
	prompt "Crypto acceleration support"

config OPENSSL_ENGINE_DIGEST
	bool
	depends OPENSSL_ENGINE_CRYPTO
	prompt "Digests acceleration support"

endmenu
```

## package/openswan/Config.in
```kconfig
config BR2_PACKAGE_OPENSWAN
	tristate "Openswan - VPN solution using IPsec"
	select BR2_PACKAGE_LIBGMP
	select BR2_PACKAGE_KMOD_OPENSWAN
	default m if CONFIG_DEVEL
	help
	  Openswan is an implementation of IPsec for Linux.
	  
	  http://www.openswan.org/
	  
```

## package/openvpn/Config.in
```kconfig
config BR2_PACKAGE_OPENVPN
	tristate "OpenVPN"
	default m
	select BR2_PACKAGE_KMOD_TUN
	select BR2_PACKAGE_OPENSSL
	select BR2_PACKAGE_LZO
	help
	  Open Source VPN solution using SSL

	  http://openvpn.net/
```

## package/osiris/Config.in
```kconfig
config BR_PACKAGE_OSIRIS
	bool
	default n
	depends BR2_PACKAGE_OSIRISD

config BR2_PACKAGE_OSIRISD
	tristate "osirisd - Host integrity monitoring system (scanning agent)"
	default m if CONFIG_DEVEL
	select BR2_PACKAGE_OSIRIS
	select BR2_PACKAGE_LIBOPENSSL
	help
	  An host integrity monitoring system (scanning agent)
	  
	  http://www.hostintegrity.com/osiris/
	  
	  Depends: openssl
	  
```

## package/p54/src/Kconfig
```kconfig
config P54_COMMON
       tristate "Softmac Prism54 support"
       depends on MAC80211 && WLAN_80211 && FW_LOADER && EXPERIMENTAL

config P54_USB
       tristate "Prism54 USB support"
       depends on P54_COMMON && USB
       select CRC32

config P54_PCI
       tristate "Prism54 PCI support"
       depends on P54_COMMON && PCI
```

## package/p910nd/Config.in
```kconfig
config BR2_PACKAGE_P910ND
	prompt "p910nd............................ A small non-spooling printer server"
	tristate
	default m if CONFIG_DEVEL
	help
	  p910nd  is a small daemon that copies any data received on
	  the port it is listening on to the  corresponding  printer
	  port.   It  is primarily intended for diskless Linux hosts
	  running as printer drivers but there is no reason  why  it
	  could  not  be used on diskful hosts.  Port 9100 is copied
	  to /dev/lp0, 9101 to /dev/lp1 and 9102 to  /dev/lp2.   The
	  default is port 9100 to /dev/lp0.
	  
	  http://www.etherboot.org/p910nd/
```

## package/palantir/Config.in
```kconfig
config BR2_PACKAGE_PALANTIR
	prompt "palantir.......................... A multichannel interactive streaming solution"
	tristate
	default m if CONFIG_DEVEL
	select BR2_PACKAGE_LIBJPEG
	help
	  Palantir is a Linux-based streaming system designed to transmit live 
	  video, audio and data over a TCP/IP network, as well as to control 
	  remote devices.
	  
	  http://www.fastpath.it/products/palantir/
```

## package/pciutils/Config.in
```kconfig
config BR2_PACKAGE_PCIUTILS
	prompt "pciutils.......................... Linux PCI Utilities"
	tristate
	default m if CONFIG_DEVEL
	help
	  This package contains various utilities for inspecting and setting of
	  devices connected to the PCI bus.
```
