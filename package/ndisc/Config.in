## package/ndisc/Config.in
```kconfig
menu "ndisc - ICMPv6 discovery tools"

config BR2_PACKAGE_NDISC
	bool
	default n
	depends BR2_PACKAGE_NDISC6 || BR2_PACKAGE_RDISC6

config BR2_PACKAGE_NDISC6
	tristate "ndisc6 - ICMPv6 neighbour discovery tool"
#	default m if CONFIG_DEVEL
	default n
	select BR2_PACKAGE_NDISC
	help
	  
	  ICMPv6 neighbour discovery tools
	  
	  http://people.via.ecp.fr/~rem/ndisc/
	  

config BR2_PACKAGE_RDISC6
	tristate "rdisc6 - ICMPv6 router discovery tool"
#	default m if CONFIG_DEVEL
	default n
	select BR2_PACKAGE_NDISC
	help
	  
	  ICMPv6 router discovery tool
	  
	  http://people.via.ecp.fr/~rem/ndisc/
	  

endmenu
```

## package/net-snmp/Config.in
```kconfig
menu "net-snmp - Open source SNMP (Simple Network Management Protocol) implementation"

config BR2_COMPILE_NET_SNMP
	bool
	default n
	depends BR2_PACKAGE_LIBNETSNMP || BR2_PACKAGE_SNMP_UTILS || BR2_PACKAGE_SNMPD || BR2_PACKAGE_SNMPD_STATIC
	select BR2_PACKAGE_LIBELF

config BR2_PACKAGE_LIBNETSNMP
	prompt "libnetsnmp - SNMP shared libraries"
	tristate
	default m if CONFIG_DEVEL
	select BR2_COMPILE_NET_SNMP
	help
	  Simple Network Management Protocol (SNMP) is a widely used 
	  protocol for monitoring the health and welfare of network 
	  equipment (eg. routers), computer equipment and even devices 
	  like UPSs. Net-SNMP is a suite of applications used to implement 
	  SNMP v1, SNMP v2c and SNMP v3 using both IPv4 and IPv6.
	  
	  http://www.net-snmp.org/
	  
	  This package contains shared libraries, needed by other programs.
	  

config BR2_PACKAGE_SNMP_UTILS
	prompt "snmp-utils - SNMP client utilities"
	tristate
	select BR2_COMPILE_NET_SNMP
	select BR2_PACKAGE_LIBNETSNMP
	default m if CONFIG_DEVEL
	help
	  Simple Network Management Protocol (SNMP) is a widely used 
	  protocol for monitoring the health and welfare of network 
	  equipment (eg. routers), computer equipment and even devices 
	  like UPSs. Net-SNMP is a suite of applications used to implement 
	  SNMP v1, SNMP v2c and SNMP v3 using both IPv4 and IPv6.
	  
	  http://www.net-snmp.org/
	  
	  This package contains the SNMP client utilities.
	  

config BR2_PACKAGE_SNMPD
	prompt "snmpd - SNMP agent"
	tristate
	select BR2_COMPILE_NET_SNMP
	select BR2_PACKAGE_LIBNETSNMP
	default m if CONFIG_DEVEL
	help
	  Simple Network Management Protocol (SNMP) is a widely used 
	  protocol for monitoring the health and welfare of network 
	  equipment (eg. routers), computer equipment and even devices 
	  like UPSs. Net-SNMP is a suite of applications used to implement 
	  SNMP v1, SNMP v2c and SNMP v3 using both IPv4 and IPv6.
	  
	  http://www.net-snmp.org/
	  
	  This package contains the SNMP agent, dynamically linked.
	  

config BR2_PACKAGE_SNMPD_STATIC
	prompt "snmpd-static - SNMP agent (static)"
	tristate
	select BR2_COMPILE_NET_SNMP
	default m if CONFIG_DEVEL
	help
	  Simple Network Management Protocol (SNMP) is a widely used 
	  protocol for monitoring the health and welfare of network 
	  equipment (eg. routers), computer equipment and even devices 
	  like UPSs. Net-SNMP is a suite of applications used to implement 
	  SNMP v1, SNMP v2c and SNMP v3 using both IPv4 and IPv6.
	  
	  http://www.net-snmp.org/
	  
	  This package contains the SNMP agent, statically linked.
	  

endmenu
```

## package/netstat-nat/Config.in
```kconfig
config BR2_PACKAGE_NETSTAT_NAT
	prompt "netstat-nat....................... A netstat variant for NAT connections"
	tristate
	default m if CONFIG_DEVEL
	help
	  Netstat-nat is a small program written in C.
	  It displays NAT connections, managed by netfilter/iptables which comes 
	  with the > 2.4.x linux kernels.
	  The program reads its information from '/proc/net/ip_conntrack', which 
	  is the temporary conntrack-storage of netfilter.
	  
	  http://tweegy.demon.nl/projects/netstat-nat/
```

## package/network/config/ltq-adsl-app/Config.in
```kconfig
config LTQ_DSL_ENABLE_SOAP
	bool "Enable SOAP support"
	depends on PACKAGE_ltq-dsl-app
	default n

config LTQ_DSL_ENABLE_DSL_EVENT_POLLING
	bool "Include Event Polling support"
	depends on PACKAGE_ltq-dsl-app
	default n
```
