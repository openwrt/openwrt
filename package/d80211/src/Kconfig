## package/d80211/src/Kconfig
```kconfig
config D80211
	tristate "Generic IEEE 802.11 Networking Stack (dscape)"
	select CRYPTO
	select CRYPTO_ECB
	select CRYPTO_ARC4
	select CRYPTO_AES
	select WIRELESS_EXT
	---help---
	This option enables the hardware independent IEEE 802.11
	networking stack.

config D80211_LEDS
	bool "Enable LED triggers"
	depends on D80211
	select NEW_LEDS
	select LEDS_TRIGGERS
	---help---
	This option enables a few LED triggers for different
	packet receive/transmit events.

config D80211_DEBUG
	bool "Enable debugging output"
	depends on D80211
	---help---
	  This option will enable debug tracing output for the
	  ieee80211 network stack.

	  If you are not trying to debug or develop the ieee80211
	  subsystem, you most likely want to say N here.

config D80211_VERBOSE_DEBUG
	bool "Verbose debugging output"
	depends on D80211_DEBUG

config D80211_LOWTX_FRAME_DUMP
	bool "Debug frame dumping"
	depends on D80211_DEBUG
	---help---
	  Selecting this option will cause the stack to
	  print a message for each frame that is handed
	  to the lowlevel driver for transmission. This
	  message includes all MAC addresses and the
	  frame control field.

	  If unsure, say N and insert the debugging code
	  you require into the driver you are debugging.

config TKIP_DEBUG
	bool "TKIP debugging"
	depends on D80211_DEBUG

config D80211_DEBUG_COUNTERS
	bool "Extra statistics for TX/RX debugging"
	depends on D80211_DEBUG

config HOSTAPD_WPA_TESTING
	bool "Support for TKIP countermeasures testing"
	depends on D80211_DEBUG

config D80211_IBSS_DEBUG
	bool "Support for IBSS testing"
	depends on D80211_DEBUG
	---help---
	  Say Y here if you intend to debug the IBSS code.

config D80211_VERBOSE_PS_DEBUG
	bool "Verbose powersave mode debugging"
	depends on D80211_DEBUG
	---help---
	  Say Y here to print out verbose powersave
	  mode debug messages.
```

## package/dhcp-forwarder/Config.in
```kconfig
config BR2_PACKAGE_DHCP_FORWARDER
	prompt "dhcp-forwarder.................... DHCP relay agent"
	tristate
	default m if CONFIG_DEVEL
	help
	  A DHCP relay agent
	  
	  http://www.nongnu.org/dhcp-fwd/
```

## package/dhcp/Config.in
```kconfig
#menu "dhcp.............................. ISC DHCP (Dynamic Host Configuration Protocol) implementation"

config BR2_COMPILE_DHCP
	tristate
	default n
	depends BR2_PACKAGE_DHCP_RELAY || BR2_PACKAGE_DHCP_SERVER

config BR2_PACKAGE_DHCP_RELAY
	prompt "dhcp-relay........................ ISC DHCP relay"
	tristate
	default m if CONFIG_DEVEL
	select BR2_COMPILE_DHCP
	help
	  ISC (Internet Software Consortium) DHCP (Dynamic Host Configuration 
	  Protocol) relay daemon.
	  
	  http://www.isc.org/

config BR2_PACKAGE_DHCP_SERVER
	prompt "dhcp-server....................... ISC DHCP server"
	tristate
	default m if CONFIG_DEVEL
	select BR2_COMPILE_DHCP
	help
	  ISC (Internet Software Consortium) DHCP (Dynamic Host Configuration 
	  Protocol) server daemon.
	  
	  http://www.isc.org/

#endmenu
```

## package/dnsmasq/Config.in
```kconfig
config BR2_PACKAGE_DNSMASQ
	tristate "dnsmasq - Lightweight DNS and DHCP server"
	default y
	help
	  A lightweight DNS and DHCP server.  It is intended to provide 
	  coupled DNS and DHCP service to a LAN.
	  
	  http://www.thekelleys.org.uk/dnsmasq/
	  
```

## package/dosfstools/Config.in
```kconfig
config BR2_PACKAGE_DOSFSTOOLS
	prompt "dosfstools........................ Utilities to create and check MS-DOS FAT filesystems"
	tristate
	default m if CONFIG_DEVEL
	help
	  Utilities to create and check MS-DOS FAT filesystems.
	  
	  ftp://ftp.uni-erlangen.de:/pub/Linux/LOCAL/dosfstools/
```

## package/dropbear/Config.in
```kconfig
config BR2_PACKAGE_DROPBEAR
	prompt "dropbear.......................... Small SSH 2 client/server"
	tristate
	default y
	help
	  A small SSH 2 server/client designed for small memory environments.
	  
	  http://matt.ucc.asn.au/dropbear/

config BR2_PACKAGE_DBCONVERT
	prompt   "dropbearconvert................. Utility for converting SSH keys"
	tristate
	default m if CONFIG_DEVEL
	depends BR2_PACKAGE_DROPBEAR
```

## package/dropbear_sshd/Config.in
```kconfig
config BR2_PACKAGE_DROPBEAR_SSHD
	bool "dropbear_sshd"
	select BR2_PACKAGE_ZLIB
	default n
	help
	  A small SSH 2 server designed for small memory environments.

	  http://matt.ucc.asn.au/dropbear/
```

## package/dsniff/Config.in
```kconfig
config BR2_PACKAGE_DSNIFF
	prompt "dsniff............................ A collection of tools for betwork auditing and penetration testing"
	tristate
	select BR2_PACKAGE_LIBPCAP
	select BR2_PACKAGE_LIBNIDS
	select BR2_PACKAGE_LIBNET
	select BR2_PACKAGE_LIBOPENSSL
	select BR2_PACKAGE_LIBGDBM
	default m if CONFIG_DEVEL
	help
	  A collection of tools for network auditing and penetration testing
	  
	  http://www.monkey.org/~dugsong/dsniff/
```

## package/ebtables/Config.in
```kconfig
config BR2_PACKAGE_EBTABLES
	prompt "ebtables.......................... Ethernet bridge firewall administration utility"
	tristate
	default m if CONFIG_DEVEL
	help
	  Ethernet Bridge Firewalling (ebtables)
	  
	  http://ebtables.sourceforge.net/
```

## package/ether-wake/Config.in
```kconfig
config BR2_PACKAGE_ETHER_WAKE
	tristate "ether-wake - A Wake-On-LAN (WOL) client"
	default y if DEVELOPER=1
	help
	  A Wake-On-LAN (WOL) client,
	  This program sends a magic packet to wake up sleeping networked machines.
	  
	  http://www.scyld.com/wakeonlan.html
	  
```

## package/ethtool/Config.in
```kconfig
config BR2_PACKAGE_ETHTOOL
	prompt "ethtool........................... Display or change ethernet card settings"
	tristate
	default m if CONFIG_DEVEL
	help
	  ethtool is used for querying settings of an ethernet device and changing them
	  
	  http://sourceforge.net/projects/gkernel/
```

## package/expat/Config.in
```kconfig
config BR2_COMPILE_EXPAT
	bool
	default n
	depends BR2_PACKAGE_LIBEXPAT

config BR2_PACKAGE_LIBEXPAT
	tristate "libexpat - a fast, non-validating, stream-oriented XML parsing library"
#	default m if CONFIG_DEVEL
	default n
	select BR2_COMPILE_EXPAT
	help
	  A fast, non-validating, stream-oriented XML parsing library
	  
	  http://expat.sourceforge.net/
	  
```

## package/ez-ipupdate/Config.in
```kconfig
config BR2_PACKAGE_EZIPUPDATE
	tristate "ez-ipupdate"
	default m
	help
	  A client for many Dynamic DNS services
```

## package/fakeidentd/Config.in
```kconfig
config BR2_PACKAGE_FAKEIDENTD
	prompt "fakeidentd........................ A static, secure identd."
	tristate
	default m if CONFIG_DEVEL
	help
	  A static secure identd, only one source file.
	
	  http://www.guru-group.fi/~too/sw/releases/
```

## package/firewall/Config.in
```kconfig
choice
        prompt "Choose firewall"
        default FIREWALL_OLD
		depends PACKAGE_firewall

config FIREWALL_OLD
	bool "old firewall"

config FIREWALL_NEW
	bool "new uci firewall"
	select PACKAGE_iptables-mod-conntrack
	select PACKAGE_iptables-mod-extra 
	select PACKAGE_iptables-mod-ipopt
	select PACKAGE_iptables-mod-ulog
	select PACKAGE_kmod-ipt-nathelper

endchoice
```

## package/firmware/phicommk3-firmware/Config.in
```kconfig
choice
    prompt "Select the wireless firmware"
    default K3_WF_AC88U
    depends on PACKAGE_phicommk3-firmware

    config K3_WF_AC88U
        bool "AC88U"

    config K3_WF_EA9500
        bool "EA9500"

    config K3_WF_K3
        bool "K3"
        
    config K3_WF_DHD24
        bool "ASUS dhd24"

endchoice
```

## package/fprobe-ulog/Config.in
```kconfig
config BR2_PACKAGE_FPROBE_ULOG
	prompt "fprobe-ulog....................... NetFlow probe (ulog-based)"
	tristate
	default m if CONFIG_DEVEL
	select BR2_PACKAGE_LIBPTHREAD
	help
	  A NetFlow probe obtaining packets through linux netfilter code 
	  (iptables ULOG target).
	  
	  http://fprobe.sourceforge.net/
```

## package/freeradius/Config.in
```kconfig
menu "freeradius........................ A Flexible RADIUS server implementation"

config BR2_PACKAGE_FREERADIUS
	prompt "freeradius........................ Flexible RADIUS server"
	tristate
	default m if CONFIG_DEVEL
	select BR2_PACKAGE_LIBLTDL
	select BR2_PACKAGE_LIBOPENSSL
	select BR2_PACKAGE_LIBPTHREAD
	help
	  A flexible RADIUS server
	  
	  http://www.freeradius.org/
	  
	  Depends:
	    - libltdl
	    - libopenssl
	    - libpthread
	    - libmysqlclient (for MySQL support)
	    - libopenldap (for LDAP support)
	    - libpq (for PostgreSQL support)

config BR2_PACKAGE_FREERADIUS_DEMOCERTS
	prompt   "freeradius-democerts............ Demo certificates to test the server"
	tristate
	default m if CONFIG_DEVEL
	depends BR2_PACKAGE_FREERADIUS

config BR2_PACKAGE_FREERADIUS_MOD_CHAP
	prompt   "freeradius-mod-chap............. CHAP module"
	tristate
	default m if CONFIG_DEVEL
	depends BR2_PACKAGE_FREERADIUS

config BR2_PACKAGE_FREERADIUS_MOD_DETAIL
	prompt   "freeradius-mod-detail........... Detailed accounting module"
	tristate
	default m if CONFIG_DEVEL
	depends BR2_PACKAGE_FREERADIUS

config BR2_PACKAGE_FREERADIUS_MOD_EAP
	prompt   "freeradius-mod-eap.............. Base EAP module"
	tristate
	default m if CONFIG_DEVEL
	depends BR2_PACKAGE_FREERADIUS

config BR2_PACKAGE_FREERADIUS_MOD_EAP_GTC
	prompt     "freeradius-mod-eap-gtc........ EAP/GTC module"
	tristate
	default m if CONFIG_DEVEL
	depends BR2_PACKAGE_FREERADIUS_MOD_EAP

config BR2_PACKAGE_FREERADIUS_MOD_EAP_MD5
	prompt     "freeradius-mod-eap-md5........ EAP/MD5 module"
	tristate
	default m if CONFIG_DEVEL
	depends BR2_PACKAGE_FREERADIUS_MOD_EAP

config BR2_PACKAGE_FREERADIUS_MOD_EAP_MSCHAPV2
	prompt     "freeradius-mod-eap-mschapv2... EAP/MS-CHAPv2 module"
	tristate
	default m if CONFIG_DEVEL
	depends BR2_PACKAGE_FREERADIUS_MOD_EAP

config BR2_PACKAGE_FREERADIUS_MOD_EAP_PEAP
	prompt     "freeradius-mod-eap-peap....... EAP/PEAP module"
	tristate
	default m if CONFIG_DEVEL
	depends BR2_PACKAGE_FREERADIUS_MOD_EAP

config BR2_PACKAGE_FREERADIUS_MOD_EAP_TLS
	prompt     "freeradius-mod-eap-tls........ EAP/TLS module"
	tristate
	default m if CONFIG_DEVEL
	depends BR2_PACKAGE_FREERADIUS_MOD_EAP

config BR2_PACKAGE_FREERADIUS_MOD_EAP_TTLS
	prompt       "freeradius-mod-eap-ttls..... EAP/TTLS module"
	tristate
	default m if CONFIG_DEVEL
	depends BR2_PACKAGE_FREERADIUS_MOD_EAP_TLS

config BR2_PACKAGE_FREERADIUS_MOD_FILES
	prompt   "freeradius-mod-files............ Module using local files for authorization"
	tristate
	default m if CONFIG_DEVEL
	depends BR2_PACKAGE_FREERADIUS

config BR2_PACKAGE_FREERADIUS_MOD_LDAP
	prompt   "freeradius-mod-ldap............. LDAP module"
	tristate
	default m if CONFIG_DEVEL
	select BR2_PACKAGE_LIBOPENLDAP
	depends BR2_PACKAGE_FREERADIUS

config BR2_PACKAGE_FREERADIUS_MOD_MSCHAP
	prompt   "freeradius-mod-mschap........... MS-CHAP and MS-CHAPv2 module"
	tristate
	default m if CONFIG_DEVEL
	depends BR2_PACKAGE_FREERADIUS

config BR2_PACKAGE_FREERADIUS_MOD_PAP
	prompt   "freeradius-mod-pap.............. PAP module"
	tristate
	default m if CONFIG_DEVEL
	depends BR2_PACKAGE_FREERADIUS

config BR2_PACKAGE_FREERADIUS_MOD_PREPROCESS
	prompt   "freeradius-mod-preprocess....... Request pre-processing module"
	tristate
	default m if CONFIG_DEVEL
	depends BR2_PACKAGE_FREERADIUS

config BR2_PACKAGE_FREERADIUS_MOD_REALM
	prompt   "freeradius-mod-realm............ Realms handling module"
	tristate
	default m if CONFIG_DEVEL
	depends BR2_PACKAGE_FREERADIUS

config BR2_PACKAGE_FREERADIUS_MOD_SQL
	prompt   "freeradius-mod-sql.............. Base SQL module"
	tristate
	default m if CONFIG_DEVEL
	depends BR2_PACKAGE_FREERADIUS

config BR2_PACKAGE_FREERADIUS_MOD_SQL_MYSQL
	prompt     "freeradius-mod-sql-mysql...... MySQL module"
	tristate
	default m if CONFIG_DEVEL
	depends BR2_PACKAGE_FREERADIUS_MOD_SQL
	select BR2_PACKAGE_LIBMYSQLCLIENT

config BR2_PACKAGE_FREERADIUS_MOD_SQL_PGSQL
	prompt     "freeradius-mod-sql-pgsql...... PostgreSQL module"
	tristate
	default m if CONFIG_DEVEL
	depends BR2_PACKAGE_FREERADIUS_MOD_SQL
	select BR2_PACKAGE_LIBPQ

config BR2_PACKAGE_FREERADIUS_MOD_SQLCOUNTER
	prompt     "freeradius-mod-sqlcounter..... Generic SQL Counter module"
	tristate
	default m if CONFIG_DEVEL
	depends BR2_PACKAGE_FREERADIUS_MOD_SQL

config BR2_PACKAGE_FREERADIUS_UTILS
	prompt   "freeradius-utils................ Misc. client utilities"
	tristate
	default m if CONFIG_DEVEL
	depends BR2_PACKAGE_FREERADIUS

endmenu
```

## package/fuse/Config.in
```kconfig
config BR2_COMPILE_FUSE
	tristate
	default n
	depends BR2_PACKAGE_LIBFUSE

config BR2_PACKAGE_LIBFUSE
	prompt "libfuse........................... FUSE library"
	tristate
	default m if CONFIG_DEVEL
	select BR2_COMPILE_FUSE
	select BR2_PACKAGE_KMOD_FUSE
	select BR2_PACKAGE_LIBPTHREAD
	help
	  With FUSE it is possible to implement a fully functional 
	  filesystem in a userspace program.
	  
	  Features include:
	  
	   * Simple library API
	   * Simple installation (no need to patch or recompile the kernel)
	   * Secure implementation
	   * Userspace - kernel interface is very efficient
	   * Usable by non privileged users
	   * Runs on Linux kernels 2.4.X and 2.6.X
	   * Has proven very stable over time
	  
	  http://fuse.sourceforge.net/
	  
	  This package contains the fuse shared library, needed by other programs.
	  
	  Depends: libpthread

config BR2_PACKAGE_FUSE_UTILS
	prompt   "fuse-utils...................... FUSE utilities"
	tristate
	default m if CONFIG_DEVEL
	depends BR2_PACKAGE_LIBFUSE
	select BR2_PACKAGE_LIBPTHREAD
	help
	  With FUSE it is possible to implement a fully functional 
	  filesystem in a userspace program.
	  
	  Features include:
	  
	   * Simple library API
	   * Simple installation (no need to patch or recompile the kernel)
	   * Secure implementation
	   * Userspace - kernel interface is very efficient
	   * Usable by non privileged users
	   * Runs on Linux kernels 2.4.X and 2.6.X
	   * Has proven very stable over time
	  
	  http://fuse.sourceforge.net/
	  
	  This package contains the fusermount userland utility.
```

## package/glib/Config.in
```kconfig
config BR2_PACKAGE_GLIB
	tristate "glib 1.2"
	default m
	help
	  GLib is a library containing many useful C routines for things such
	  as trees, hashes, and lists.
```

## package/gmediaserver/Config.in
```kconfig
config BR2_PACKAGE_GMEDIASERVER
	prompt "gmediaserver...................... An UPnP music media server"
	tristate
	default m if CONFIG_DEVEL
	select BR2_PACKAGE_ID3LIB
	select BR2_PACKAGE_LIBUPNP
	help
	  An UPnP music media server.
	  
	  http://www.nongnu.org/gmediaserver/
	  
	  Depends: id3lib, libupnp
```

## package/gmp/Config.in
```kconfig
config BR2_PACKAGE_GMP
	tristate "libgmp"
	default m if CONFIG_DEVEL
	help
	  libgmp
	  
```
