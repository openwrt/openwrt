## package/gnutls/Config.in
```kconfig
config BR2_COMPILE_GNUTLS
	tristate
	default n
	depends BR2_PACKAGE_LIBGNUTLS

config BR2_PACKAGE_LIBGNUTLS
	prompt "libgnutls......................... The GNU TLS library"
	tristate
	default m if CONFIG_DEVEL
	select BR2_COMPILE_GNUTLS
	select BR2_PACKAGE_LIBGCRYPT
	help
	  GnuTLS is a project that aims to develop a library which provides a 
	  secure layer, over a reliable transport layer. Currently the GnuTLS 
	  library implements the proposed standards by the IETF's TLS working 
	  group.
	  
	  Quoting from RFC2246 - the TLS 1.0 protocol specification:
	  
	  "The TLS protocol provides communications privacy over the Internet.
	   The protocol allows client/server applications to communicate in a 
	   way that is designed to prevent eavesdropping, tampering, or message 
	   forgery."
	  
	  Features
	  
	    * Support for TLS 1.1 and SSL 3.0 protocols
	    * Support for TLS extensions
	    * Support for authentication using the SRP protocol
	    * Support for authentication using both X.509 certificates
	    * and OpenPGP keys Support for X.509 and OpenPGP certificate handling.
	    * Supports all the strong encryption algorithms
	  
	  http://www.gnu.org/software/gnutls/
	  
	  This packages contains the GnuTLS shared libraries, needed by other programs.

config BR2_PACKAGE_GNUTLS_UTILS
	prompt   "gnutls-utils.................... The GNU TLS utilities"
	tristate
	default m if CONFIG_DEVEL
	depends BR2_PACKAGE_LIBGNUTLS
	help
	  GnuTLS is a project that aims to develop a library which provides a 
	  secure layer, over a reliable transport layer. Currently the GnuTLS 
	  library implements the proposed standards by the IETF's TLS working 
	  group.
	  
	  Quoting from RFC2246 - the TLS 1.0 protocol specification:
	  
	  "The TLS protocol provides communications privacy over the Internet.
	   The protocol allows client/server applications to communicate in a 
	   way that is designed to prevent eavesdropping, tampering, or message 
	   forgery."
	  
	  Features
	  
	    * Support for TLS 1.1 and SSL 3.0 protocols
	    * Support for TLS extensions
	    * Support for authentication using the SRP protocol
	    * Support for authentication using both X.509 certificates
	    * and OpenPGP keys Support for X.509 and OpenPGP certificate handling.
	    * Supports all the strong encryption algorithms
	  
	  http://www.gnu.org/software/gnutls/
	  
	  This packages contains some GnuTLS utilities.

config BR2_PACKAGE_LIBGNUTLS_OPENSSL
	prompt   "libgnutls-openssl............... The GNU TLS OpenSSL compatibility layer library"
	tristate
	default m if CONFIG_DEVEL
	depends BR2_PACKAGE_LIBGNUTLS
	help
	  GnuTLS is a project that aims to develop a library which provides a 
	  secure layer, over a reliable transport layer. Currently the GnuTLS 
	  library implements the proposed standards by the IETF's TLS working 
	  group.
	  
	  Quoting from RFC2246 - the TLS 1.0 protocol specification:
	  
	  "The TLS protocol provides communications privacy over the Internet.
	   The protocol allows client/server applications to communicate in a 
	   way that is designed to prevent eavesdropping, tampering, or message 
	   forgery."
	  
	  Features
	  
	    * Support for TLS 1.1 and SSL 3.0 protocols
	    * Support for TLS extensions
	    * Support for authentication using the SRP protocol
	    * Support for authentication using both X.509 certificates
	    * and OpenPGP keys Support for X.509 and OpenPGP certificate handling.
	    * Supports all the strong encryption algorithms
	  
	  http://www.gnu.org/software/gnutls/
	  
	  This packages contains the GnuTLS OpenSSL compatibility layer shared library.
```

## package/gsm/Config.in
```kconfig
config BR2_COMPILE_GSM
	tristate
	default n
	depends BR2_PACKAGE_LIBGSM
	
config BR2_PACKAGE_LIBGSM
	prompt "libgsm............................ A GSM 06.10 full-rate speech transcoding implementation (library)"
	tristate
	default m if CONFIG_DEVEL
	select BR2_COMPILE_GSM
	help
	  An implementation of the European GSM 06.10 provisional standard 
	  for full-rate speech transcoding, prI-ETS 300 036, which uses 
	  RPE/LTP (residual pulse excitation/long term prediction) coding 
	  at 13 kbit/s.
	  
	  ftp://ftp.cs.tu-berlin.de/pub/local/kbs/tubmik/gsm/

config BR2_PACKAGE_GSM_UTILS
	prompt   "gsm-utils....................... A GSM 06.10 full-rate speech transcoding implementation (utilities)"
	tristate
	default m if CONFIG_DEVEL
	depends BR2_PACKAGE_LIBGSM
	help
	  An implementation of the European GSM 06.10 provisional standard 
	  for full-rate speech transcoding, prI-ETS 300 036, which uses 
	  RPE/LTP (residual pulse excitation/long term prediction) coding 
	  at 13 kbit/s.
	  
	  ftp://ftp.cs.tu-berlin.de/pub/local/kbs/tubmik/gsm/
```

## package/haserl/Config.in
```kconfig
config BR2_PACKAGE_HASERL
	tristate "haserl"
	default m
	help
	  A CGI wrapper to embed shell scripts in HTML documents.
	  
	  http://haserl.sourceforge.net/
	  
```
