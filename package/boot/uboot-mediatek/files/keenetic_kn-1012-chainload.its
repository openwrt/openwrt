## package/boot/uboot-mediatek/files/keenetic_kn-1012-chainload.its
```
// SPDX-License-Identifier: GPL-2.0-or-later OR MIT
/dts-v1/;

/* The stock loader boots only this vendor shape, fdt node included. */
/ {
	description = "FIT";
	#address-cells = <1>;

	images {
		kernel@1 {
			description = "Linux 4.9";
			data = /incbin/("u-boot.bin.lzma");
			type = "kernel";
			arch = "arm64";
			os = "linux";
			compression = "lzma";
			load = <0x48080000>;
			entry = <0x48080000>;
			hash@1 { algo = "crc32"; };
			hash@2 { algo = "sha1"; };
		};
		fdt@1 {
			description = "KN-1012 DTB";
			data = /incbin/("dts/dt.dtb");
			type = "flat_dt";
			arch = "arm64";
			compression = "none";
			hash@1 { algo = "crc32"; };
			hash@2 { algo = "sha1"; };
		};
		firmware@1 {
			description = "EN8811H firmware";
			data = /incbin/("EthMD32.bin.gz");
			type = "firmware";
			arch = "arm64";
			compression = "gzip";
			hash@1 { algo = "crc32"; };
		};
	};

	configurations {
		default = "config@1";
		config@1 {
			description = "NDMS";
			kernel = "kernel@1";
			fdt = "fdt@1";
		};
	};
};
```

## target/linux/realtek/files-6.18/Documentation/devicetree/bindings/net/wireless/realtek,rtl8852ae.yaml
```yaml
# SPDX-License-Identifier: (GPL-2.0-only OR BSD-2-Clause)
%YAML 1.2
---
$id: http://devicetree.org/schemas/net/wireless/realtek,rtl8852ae.yaml#
$schema: http://devicetree.org/meta-schemas/core.yaml#

title: Realtek RTL8852AE PCIe wireless controller

maintainers:
  - wjjsn <wjjsn@qq.com>

allOf:
  - $ref: /schemas/net/wireless/ieee80211.yaml#

properties:
  compatible:
    const: pci10ec,8852

  reg:
    maxItems: 1

  ieee80211-freq-limit: true

  realtek,efuse-file:
    $ref: /schemas/types.yaml#/definitions/string
    description:
      Firmware-relative path to a 1536-byte logical eFuse map containing
      board calibration. The map is used when the on-chip eFuse does not
      provide a valid MAC address or RF front-end type.

required:
  - compatible
  - reg

additionalProperties: false

examples:
  - |
    pcie {
        #address-cells = <3>;
        #size-cells = <2>;

        wifi@1,0 {
            compatible = "pci10ec,8852";
            reg = <0x800 0 0 0 0>;
            ieee80211-freq-limit = <4900000 5925000>;
            realtek,efuse-file = "rtw89/tcl-t20-pro-5g-efuse.bin";
        };
    };
```

## target/linux/siflower/files-6.18/drivers/net/ethernet/siflower/Kconfig
```kconfig
# SPDX-License-Identifier: GPL-2.0
#
# Siflower network device configuration
#

config NET_VENDOR_SIFLOWER
	bool "Siflower Ethernet"
	default y
	depends on ARCH_SIFLOWER

if NET_VENDOR_SIFLOWER

config NET_SIFLOWER_ETH_DPNS
	tristate "Siflower DPNS driver"
	help
	  Support the Dataplane network subsystem of SiFlower SF21A6826/SF21H8898 SoC.
	  This driver only initializes the DPNS for basic packet forwarding to the
	  host. Leave it disabled when the out-of-tree kmod-sf21-dpns package
	  (with hardware flow offload) drives the DPNS instead.

config NET_SIFLOWER_ETH_XGMAC
	tristate "Siflower Ethernet MAC driver"
	select MII
	select PAGE_POOL
	select PHYLINK
	select NET_SIFLOWER_ETH_DMA
        select NET_SIFLOWER_ETH_XPCS
	help
	  Support the Ethernet controller of SiFlower SF21A6826/SF21H8898 SoC.

config NET_SIFLOWER_ETH_DMA
	tristate "Siflower Ethernet DMA driver"
	select PAGE_POOL
	help
	  Support the Ethernet controller of SiFlower SF21A6826/SF21H8898 SoC.

config NET_SIFLOWER_ETH_XPCS
	tristate "Siflower Ethernet XPCS driver"
	select PAGE_POOL
	help
	  Support the PCS block of SiFlower SF21A6826/SF21H8898 SoC.

if NET_SIFLOWER_ETH_DMA

config NET_SIFLOWER_ETH_USE_INTERNAL_SRAM
	bool "Use internal SRAM for DMA descriptors"
	select SRAM
	help
	  Use internal SRAM instead of system memory for DMA descriptors.

endif # NET_SIFLOWER_ETH_DMA

endif # NET_VENDOR_SIFLOWER
```
