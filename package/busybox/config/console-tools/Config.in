## package/cbtt/Config.in
```kconfig
config BR2_PACKAGE_CBTT
	prompt "cbtt.............................. a C BitTorrent Tracker"
	tristate
	default m if CONFIG_DEVEL
	select BR2_PACKAGE_ZLIB
	help
	 A C BitTorrent Tracker
	  
config BR2_PACKAGE_CBTT_MYSQL
	prompt "cbtt-mysql........................ a C BitTorrent Tracker (mysql)"
	tristate
	default m if CONFIG_DEVEL
	select BR2_PACKAGE_ZLIB
	select BR2_PACKAGE_LIBMYSQLCLIENT
	help
	 A C BitTorrent Tracker 
```

## package/cgilib/Config.in
```kconfig
config BR2_PACKAGE_CGILIB
	prompt "cgilib............................ Simple CGI Library"
	tristate
#	default m if CONFIG_DEVEL
	default n
	help
	  This library provides a simple programming API to the Common Gateway
	  Interface (CGI).  It features HTTP Redirect, provides read access to
	  FORM variables, sets HTTP Cookies and reads them.
	  
	  http://www.infodrom.org/projects/cgilib/
```

## package/chillispot/Config.in
```kconfig
config BR2_PACKAGE_CHILLISPOT
	prompt "chillispot........................ Wireless LAN access point controller"
	tristate
	default m if CONFIG_DEVEL
	select BR2_PACKAGE_KMOD_TUN
	help
	  ChilliSpot is an open source captive portal or wireless LAN
	  access point controller. It is used for authenticating users
	  of a wireless LAN. It supports web based login which is today's
	  standard for public HotSpots and it supports Wireless Protected
	  Access (WPA) which is the standard of the future. Authentication,
	  authorization and accounting (AAA) is handled by your favorite 
	  radius server.
	  
	  http://www.chillispot.org/
```

## package/click/Config.in
```kconfig
config BR2_PACKAGE_CLICK
	prompt "click............................. The Click Modular Router"
	tristate
	select BR2_PACKAGE_KMOD_TUN
	default m if CONFIG_DEVEL
	help
		http://pdos.csail.mit.edu/click/

config BR2_PACKAGE_ROOFNET
	prompt   "roofnet......................... roofnet mesh networking scripts"
	tristate
	depends BR2_PACKAGE_CLICK
	select BR2_PACKAGE_KMOD_MADWIFI
	default m if CONFIG_DEVEL
	help
		http://pdos.csail.mit.edu/roofnet/
```

## package/collectd/Config.in
```kconfig
menu "collectd.......................... Lightweight system statistics collection daemon"

config BR2_PACKAGE_COLLECTD
	prompt "collectd........................... Lightweight system statistics collection daemon"
	tristate
	default m if CONFIG_DEVEL
	help
		collectd is a small daemon which collects system information
		every 10 seconds. The values are then sent to a multicast group
		to be stored in RRD files by a server process.
		
		http://verplant.org/collectd/

config BR2_PACKAGE_COLLECTD_CPU
        prompt "Enable cpu support"
	bool
	default y
	depends BR2_PACKAGE_COLLECTD

config BR2_PACKAGE_COLLECTD_LOAD
        prompt "Enable load support"
	bool
	default y
	depends BR2_PACKAGE_COLLECTD

config BR2_PACKAGE_COLLECTD_MEMORY
	prompt "Enable memory support"
	bool
	default y
	depends BR2_PACKAGE_COLLECTD

config BR2_PACKAGE_COLLECTD_PING
	prompt "Enable ping support"
	bool
	default y
	depends BR2_PACKAGE_COLLECTD

config BR2_PACKAGE_COLLECTD_TRAFFIC
	prompt "Enable traffic support"
	bool
	default y
	depends BR2_PACKAGE_COLLECTD
endmenu
```

## package/compcache/Config.in
```kconfig
menu "Configuration"
	depends on PACKAGE_kmod-compcache

config COMPCACHE_ENABLE
	bool "enabled on boot"
	default n
	help
	  Enables compressed ram swap devices.

config COMPCACHE_RAM_REPORTED
	string "swap space reported to kernel in kb"
	default "2048"
	help
	  This is the amount of memory that will be reported 
	  to the kernel as swap. The real ram in use will differ, 
	  because of lzo compression.
	  Example:
	    16 MB = 2048 KB 
	    32 MB = 4098 KB

config COMPCACHE_BACKUP_DEV
	string "Backup device for compcache"
	default ""
	help
	  Compcache will use this as a backup device for swap.
	  Example:
	         /dev/sda5

endmenu
```

## package/cups/Config.in
```kconfig
config BR2_PACKAGE_CUPS
	tristate "cups - Common UNIX Printing System"
	default m if CONFIG_DEVEL
	help
	  A printer spooling system for devices with USB or LP support
	  
	  http://www.cups.org/
	  
```

## package/curl/Config.in
```kconfig
config BR2_COMPILE_CURL
	bool
	default n
	depends BR2_PACKAGE_LIBCURL

config BR2_PACKAGE_LIBCURL
	tristate "libcurl - A client-side URL transfer library"
#	default m if CONFIG_DEVEL
	default n
	select BR2_COMPILE_CURL
	select BR2_PACKAGE_LIBOPENSSL
	select BR2_PACKAGE_ZLIB
	help
	  A client-side URL transfer library.
	  
	  http://curl.haxx.se/
	  

config BR2_PACKAGE_CURL
	tristate "curl - A client-side URL transfer tool"
#	default m if CONFIG_DEVEL
	default n
	depends BR2_PACKAGE_LIBCURL
	help
	  A client-side URL transfer tool.
	  
	  http://curl.haxx.se/
	  
```

## package/cutter/Config.in
```kconfig
config BR2_PACKAGE_CUTTER
	prompt "cutter............................ allows an user to abort TCP/IP connections"
	tristate
	default m if CONFIG_DEVEL
	help
		"Cutter" is an open source program that allows Linux firewall 
		administrators to abort TCP/IP connections routed over the 
		firewall or router on which it is run.

		http://www.lowth.com/cutter/
```

## package/cyrus-sasl/Config.in
```kconfig
config BR2_COMPILE_CYRUS_SASL
	tristate
	default n
	depends BR2_PACKAGE_LIBSASL2

config BR2_PACKAGE_LIBSASL2
	prompt "libsasl2.......................... General purpose authentication library"
	tristate
	default m if CONFIG_DEVEL
	select BR2_COMPILE_CYRUS_SASL
	help
	  A general purpose authentication library.
	  
	  http://asg.web.cmu.edu/sasl/
```
