## package/busybox/config/console-tools/Config.in
```kconfig
#
# For a description of the syntax of this configuration file,
# see scripts/kbuild/config-language.txt.
#

menu "Console Utilities"

config BUSYBOX_CONFIG_CHVT
	bool "chvt"
	default n
	help
	  This program is used to change to another terminal.
	  Example: chvt 4 (change to terminal /dev/tty4)

config BUSYBOX_CONFIG_CLEAR
	bool "clear"
	default y
	help
	  This program clears the terminal screen.

config BUSYBOX_CONFIG_DEALLOCVT
	bool "deallocvt"
	default n
	help
	  This program deallocates unused virtual consoles.

config BUSYBOX_CONFIG_DUMPKMAP
	bool "dumpkmap"
	default n
	help
	  This program dumps the kernel's keyboard translation table to
	  stdout, in binary format. You can then use loadkmap to load it.

config BUSYBOX_CONFIG_KBD_MODE
	bool "kbd_mode"
	default n
	help
	  This program reports and sets keyboard mode.

config BUSYBOX_CONFIG_LOADFONT
	bool "loadfont"
	default n
	help
	  This program loads a console font from standard input.

config BUSYBOX_CONFIG_LOADKMAP
	bool "loadkmap"
	default n
	help
	  This program loads a keyboard translation table from
	  standard input.

config BUSYBOX_CONFIG_OPENVT
	bool "openvt"
	default n
	help
	  This program is used to start a command on an unused
	  virtual terminal.

config BUSYBOX_CONFIG_RESET
	bool "reset"
	default y
	help
	  This program is used to reset the terminal screen, if it
	  gets messed up.

config BUSYBOX_CONFIG_RESIZE
	bool "resize"
	default n
	help
	  This program is used to (re)set the width and height of your current
	  terminal.

config BUSYBOX_CONFIG_FEATURE_RESIZE_PRINT
	bool "Print environment variables"
	default n
	depends on BUSYBOX_CONFIG_RESIZE
	help
	  Prints the newly set size (number of columns and rows) of
	  the terminal.
	  E.g.:
	  COLUMNS=80;LINES=44;export COLUMNS LINES;

config BUSYBOX_CONFIG_SETCONSOLE
	bool "setconsole"
	default n
	help
	  This program redirects the system console to another device,
	  like the current tty while logged in via telnet.

config BUSYBOX_CONFIG_FEATURE_SETCONSOLE_LONG_OPTIONS
	bool "Enable long options"
	default n
	depends on BUSYBOX_CONFIG_SETCONSOLE && BUSYBOX_CONFIG_LONG_OPTS
	help
	  Support long options for the setconsole applet.

config BUSYBOX_CONFIG_SETFONT
	bool "setfont"
	default n
	help
	  Allows to load console screen map. Useful for i18n.

config BUSYBOX_CONFIG_FEATURE_SETFONT_TEXTUAL_MAP
	bool "Support reading textual screen maps"
	default n
	depends on BUSYBOX_CONFIG_SETFONT
	help
	  Support reading textual screen maps.

config BUSYBOX_CONFIG_DEFAULT_SETFONT_DIR
	string "Default directory for console-tools files"
	default n
	depends on BUSYBOX_CONFIG_SETFONT
	help
	  Directory to use if setfont's params are simple filenames
	  (not /path/to/file or ./file). Default is "" (no default directory).

config BUSYBOX_CONFIG_SETKEYCODES
	bool "setkeycodes"
	default n
	help
	  This program loads entries into the kernel's scancode-to-keycode
	  map, allowing unusual keyboards to generate usable keycodes.

config BUSYBOX_CONFIG_SETLOGCONS
	bool "setlogcons"
	default n
	help
	  This program redirects the output console of kernel messages.

config BUSYBOX_CONFIG_SHOWKEY
	bool "showkey"
	default n
	help
	  Shows keys pressed.

endmenu
```
