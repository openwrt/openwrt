## package/busybox/config/editors/Config.in
```kconfig
#
# For a description of the syntax of this configuration file,
# see scripts/kbuild/config-language.txt.
#

menu "Editors"

config BUSYBOX_CONFIG_AWK
	bool "awk"
	default y
	help
	  Awk is used as a pattern scanning and processing language.  This is
	  the BusyBox implementation of that programming language.

config BUSYBOX_CONFIG_FEATURE_AWK_MATH
	bool "Enable math functions (requires libm)"
	default y
	depends on BUSYBOX_CONFIG_AWK
	help
	  Enable math functions of the Awk programming language.
	  NOTE: This will require libm to be present for linking.

config BUSYBOX_CONFIG_CMP
	bool "cmp"
	default n
	help
	  cmp is used to compare two files and returns the result
	  to standard output.

config BUSYBOX_CONFIG_DIFF
	bool "diff"
	default y
	help
	  diff compares two files or directories and outputs the
	  differences between them in a form that can be given to
	  the patch command.

config BUSYBOX_CONFIG_FEATURE_DIFF_BINARY
	bool "Enable checks for binary files"
	default n
	depends on BUSYBOX_CONFIG_DIFF
	help
	  This option enables support for checking for binary files
	  before a comparison is carried out.

config BUSYBOX_CONFIG_FEATURE_DIFF_DIR
	bool "Enable directory support"
	default n
	depends on BUSYBOX_CONFIG_DIFF
	help
	  This option enables support for directory and subdirectory
	  comparison.

config BUSYBOX_CONFIG_FEATURE_DIFF_MINIMAL
	bool "Enable -d option to find smaller sets of changes"
	default n
	depends on BUSYBOX_CONFIG_DIFF
	help
	  Enabling this option allows the use of -d to make diff
	  try hard to find the smallest possible set of changes.

config BUSYBOX_CONFIG_ED
	bool "ed"
	default n
	help
	  The original 1970's Unix text editor, from the days of teletypes.
	  Small, simple, evil.  Part of SUSv3.  If you're not already using
	  this, you don't need it.

config BUSYBOX_CONFIG_PATCH
	bool "patch"
	default n
	help
	  Apply a unified diff formatted patch.

config BUSYBOX_CONFIG_SED
	bool "sed"
	default y
	help
	  sed is used to perform text transformations on a file
	  or input from a pipeline.

config BUSYBOX_CONFIG_VI
	bool "vi"
	default y
	help
	  'vi' is a text editor.  More specifically, it is the One True
	  text editor <grin>.  It does, however, have a rather steep
	  learning curve.  If you are not already comfortable with 'vi'
	  you may wish to use something else.

config BUSYBOX_CONFIG_FEATURE_VI_MAX_LEN
	int "Maximum screen width in vi"
	range 256 16384
	default 1024
	depends on BUSYBOX_CONFIG_VI
	help
	  Contrary to what you may think, this is not eating much.
	  Make it smaller than 4k only if you are very limited on memory.

config BUSYBOX_CONFIG_FEATURE_VI_8BIT
	bool "Allow vi to display 8-bit chars (otherwise shows dots)"
	default n
	depends on BUSYBOX_CONFIG_VI
	help
	  If your terminal can display characters with high bit set,
	  you may want to enable this. Note: vi is not Unicode-capable.
	  If your terminal combines several 8-bit bytes into one character
	  (as in Unicode mode), this will not work properly.

config BUSYBOX_CONFIG_FEATURE_VI_COLON
	bool "Enable \":\" colon commands (no \"ex\" mode)"
	default y
	depends on BUSYBOX_CONFIG_VI
	help
	  Enable a limited set of colon commands for vi.  This does not
	  provide an "ex" mode.

config BUSYBOX_CONFIG_FEATURE_VI_YANKMARK
	bool "Enable yank/put commands and mark cmds"
	default y
	depends on BUSYBOX_CONFIG_VI
	help
	  This will enable you to use yank and put, as well as mark in
	  busybox vi.

config BUSYBOX_CONFIG_FEATURE_VI_SEARCH
	bool "Enable search and replace cmds"
	default y
	depends on BUSYBOX_CONFIG_VI
	help
	  Select this if you wish to be able to do search and replace in
	  busybox vi.

config BUSYBOX_CONFIG_FEATURE_VI_USE_SIGNALS
	bool "Catch signals"
	default y
	depends on BUSYBOX_CONFIG_VI
	help
	  Selecting this option will make busybox vi signal aware.  This will
	  make busybox vi support SIGWINCH to deal with Window Changes, catch
	  Ctrl-Z and Ctrl-C and alarms.

config BUSYBOX_CONFIG_FEATURE_VI_DOT_CMD
	bool "Remember previous cmd and \".\" cmd"
	default y
	depends on BUSYBOX_CONFIG_VI
	help
	  Make busybox vi remember the last command and be able to repeat it.

config BUSYBOX_CONFIG_FEATURE_VI_READONLY
	bool "Enable -R option and \"view\" mode"
	default y
	depends on BUSYBOX_CONFIG_VI
	help
	  Enable the read-only command line option, which allows the user to
	  open a file in read-only mode.

config BUSYBOX_CONFIG_FEATURE_VI_SETOPTS
	bool "Enable set-able options, ai ic showmatch"
	default y
	depends on BUSYBOX_CONFIG_VI
	help
	  Enable the editor to set some (ai, ic, showmatch) options.

config BUSYBOX_CONFIG_FEATURE_VI_SET
	bool "Support for :set"
	default y
	depends on BUSYBOX_CONFIG_VI
	help
	  Support for ":set".

config BUSYBOX_CONFIG_FEATURE_VI_WIN_RESIZE
	bool "Handle window resize"
	default y
	depends on BUSYBOX_CONFIG_VI
	help
	  Make busybox vi behave nicely with terminals that get resized.

config BUSYBOX_CONFIG_FEATURE_VI_OPTIMIZE_CURSOR
	bool "Optimize cursor movement"
	default y
	depends on BUSYBOX_CONFIG_VI
	help
	  This will make the cursor movement faster, but requires more memory
	  and it makes the applet a tiny bit larger.

config BUSYBOX_CONFIG_FEATURE_ALLOW_EXEC
	bool "Allow vi and awk to execute shell commands"
	default y
	depends on BUSYBOX_CONFIG_VI || BUSYBOX_CONFIG_AWK
	help
	  Enables vi and awk features which allows user to execute
	  shell commands (using system() C call).

endmenu
```

## package/busybox/config/init/Config.in
```kconfig
#
# For a description of the syntax of this configuration file,
# see scripts/kbuild/config-language.txt.
#

menu "Init Utilities"

config BUSYBOX_CONFIG_INIT
	bool "init"
	default y
	select BUSYBOX_CONFIG_FEATURE_SYSLOG
	help
	  init is the first program run when the system boots.

config BUSYBOX_CONFIG_FEATURE_USE_INITTAB
	bool "Support reading an inittab file"
	default y
	depends on BUSYBOX_CONFIG_INIT
	help
	  Allow init to read an inittab file when the system boot.

config BUSYBOX_CONFIG_FEATURE_KILL_REMOVED
	bool "Support killing processes that have been removed from inittab"
	default n
	depends on BUSYBOX_CONFIG_FEATURE_USE_INITTAB
	help
	  When respawn entries are removed from inittab and a SIGHUP is
	  sent to init, this feature will kill the processes that have
	  been removed.

config BUSYBOX_CONFIG_FEATURE_KILL_DELAY
	int "How long to wait between TERM and KILL (0 - send TERM only)" if FEATURE_KILL_REMOVED
	range 0 1024
	default 0
	depends on BUSYBOX_CONFIG_FEATURE_KILL_REMOVED
	help
	  With nonzero setting, init sends TERM, forks, child waits N
	  seconds, sends KILL and exits. Setting it too high is unwise
	  (child will hang around for too long and could actually kill
	  the wrong process!)

config BUSYBOX_CONFIG_FEATURE_INIT_SCTTY
	bool "Run commands with leading dash with controlling tty"
	default n
	depends on BUSYBOX_CONFIG_INIT
	help
	  If this option is enabled, init will try to give a controlling
	  tty to any command which has leading hyphen (often it's "-/bin/sh").
	  More precisely, init will do "ioctl(STDIN_FILENO, TIOCSCTTY, 0)".
	  If device attached to STDIN_FILENO can be a ctty but is not yet
	  a ctty for other session, it will become this process' ctty.
	  This is not the traditional init behavour, but is often what you want
	  in an embedded system where the console is only accessed during
	  development or for maintenance.
	  NB: using cttyhack applet may work better.

config BUSYBOX_CONFIG_FEATURE_INIT_SYSLOG
	bool "Enable init to write to syslog"
	default y
	depends on BUSYBOX_CONFIG_INIT

config BUSYBOX_CONFIG_FEATURE_EXTRA_QUIET
	bool "Be _extra_ quiet on boot"
	default n
	depends on BUSYBOX_CONFIG_INIT
	help
	  Prevent init from logging some messages to the console during boot.

config BUSYBOX_CONFIG_FEATURE_INIT_COREDUMPS
	bool "Support dumping core for child processes (debugging only)"
	default n
	depends on BUSYBOX_CONFIG_INIT
	help
	  If this option is enabled and the file /.init_enable_core
	  exists, then init will call setrlimit() to allow unlimited
	  core file sizes. If this option is disabled, processes
	  will not generate any core files.

config BUSYBOX_CONFIG_FEATURE_INITRD
	bool "Support running init from within an initrd (not initramfs)"
	default n
	depends on BUSYBOX_CONFIG_INIT
	help
	  Legacy support for running init under the old-style initrd. Allows
	  the name linuxrc to act as init, and it doesn't assume init is PID 1.

	  This does not apply to initramfs, which runs /init as PID 1 and
	  requires no special support.

config BUSYBOX_CONFIG_HALT
	bool "poweroff, halt, and reboot"
	default y
	help
	  Stop all processes and either halt, reboot, or power off the system.

config BUSYBOX_CONFIG_MESG
	bool "mesg"
	default y
	help
	  Mesg controls access to your terminal by others. It is typically
	  used to allow or disallow other users to write to your terminal

endmenu
```

## package/busybox/config/ipsvd/Config.in
```kconfig
#
# For a description of the syntax of this configuration file,
# see scripts/kbuild/config-language.txt.
#

menu "ipsvd utilities"

config BUSYBOX_CONFIG_TCPSVD
	bool "tcpsvd"
	default n
	help
	  tcpsvd listens on a tcp port and runs a program for each new connection

config BUSYBOX_CONFIG_UDPSVD
	bool "udpsvd"
	default n
	help
	  udpsvd listens on a udp port and runs a program for each new connection

endmenu
```

## package/busybox/config/libbb/Config.in
```kconfig
#
# For a description of the syntax of this configuration file,
# see scripts/kbuild/config-language.txt.
#

menu "Busybox Library Tuning"

config BUSYBOX_CONFIG_PASSWORD_MINLEN
	int "Minimum password length"
	default 6
	range 5 32
	help
	  Minimum allowable password length.

config BUSYBOX_CONFIG_MD5_SIZE_VS_SPEED
	int "MD5: Trade bytes for speed (0:fast, 3:slow)"
	default 2
	range 0 3
	help
	  Trade binary size versus speed for the md5sum algorithm.
	  Approximate values running uClibc and hashing
	  linux-2.4.4.tar.bz2 were:
	                    user times (sec)  text size (386)
	  0 (fastest)         1.1                6144
	  1                   1.4                5392
	  2                   3.0                5088
	  3 (smallest)        5.1                4912

config BUSYBOX_CONFIG_FEATURE_FAST_TOP
	bool "Faster /proc scanning code (+100 bytes)"
	default y
	help
	  This option makes top (and ps) ~20% faster (or 20% less CPU hungry),
	  but code size is slightly bigger.

config BUSYBOX_CONFIG_FEATURE_ETC_NETWORKS
	bool "Support for /etc/networks"
	default n
	help
	  Enable support for network names in /etc/networks. This is
	  a rarely used feature which allows you to use names
	  instead of IP/mask pairs in route command.

config BUSYBOX_CONFIG_FEATURE_EDITING
	bool "Command line editing"
	default y
	help
	  Enable line editing (mainly for shell command line).

config BUSYBOX_CONFIG_FEATURE_EDITING_MAX_LEN
	int "Maximum length of input"
	range 128 8192
	default 512
	depends on BUSYBOX_CONFIG_FEATURE_EDITING
	help
	  Line editing code uses on-stack buffers for storage.
	  You may want to decrease this parameter if your target machine
	  benefits from smaller stack usage.

config BUSYBOX_CONFIG_FEATURE_EDITING_VI
	bool "vi-style line editing commands"
	default n
	depends on BUSYBOX_CONFIG_FEATURE_EDITING
	help
	  Enable vi-style line editing. In shells, this mode can be
	  turned on and off with "set -o vi" and "set +o vi".

config BUSYBOX_CONFIG_FEATURE_EDITING_HISTORY
	int "History size"
	range 0 99999
	default 256
	depends on BUSYBOX_CONFIG_FEATURE_EDITING
	help
	  Specify command history size.

config BUSYBOX_CONFIG_FEATURE_EDITING_SAVEHISTORY
	bool "History saving"
	default n
	depends on BUSYBOX_CONFIG_ASH && BUSYBOX_CONFIG_FEATURE_EDITING
	help
	  Enable history saving in ash shell.

config BUSYBOX_CONFIG_FEATURE_TAB_COMPLETION
	bool "Tab completion"
	default y
	depends on BUSYBOX_CONFIG_FEATURE_EDITING
	help
	  Enable tab completion.

config BUSYBOX_CONFIG_FEATURE_USERNAME_COMPLETION
	bool "Username completion"
	default n
	depends on BUSYBOX_CONFIG_FEATURE_TAB_COMPLETION
	help
	  Enable username completion.

config BUSYBOX_CONFIG_FEATURE_EDITING_FANCY_PROMPT
	bool "Fancy shell prompts"
	default y
	depends on BUSYBOX_CONFIG_FEATURE_EDITING
	help
	  Setting this option allows for prompts to use things like \w and
	  \$ and escape codes.

config BUSYBOX_CONFIG_FEATURE_EDITING_ASK_TERMINAL
	bool "Query cursor position from terminal"
	default n
	depends on BUSYBOX_CONFIG_FEATURE_EDITING
	help
	  Allow usage of "ESC [ 6 n" sequence. Terminal answers back with
	  current cursor position. This information is used to make line
	  editing more robust in some cases.
	  If you are not sure whether your terminals respond to this code
	  correctly, or want to save on code size (about 300 bytes),
	  then do not turn this option on.

config BUSYBOX_CONFIG_FEATURE_NON_POSIX_CP
	bool "Non-POSIX, but safer, copying to special nodes"
	default y
	help
	  With this option, "cp file symlink" will delete symlink
	  and create a regular file. This does not conform to POSIX,
	  but prevents a symlink attack.
	  Similarly, "cp file device" will not send file's data
	  to the device.

config BUSYBOX_CONFIG_FEATURE_VERBOSE_CP_MESSAGE
	bool "Give more precise messages when copy fails (cp, mv etc)"
	default n
	help
	  Error messages with this feature enabled:
	    $ cp file /does_not_exist/file
	    cp: cannot create '/does_not_exist/file': Path does not exist
	    $ cp file /vmlinuz/file
	    cp: cannot stat '/vmlinuz/file': Path has non-directory component
	  If this feature is not enabled, they will be, respectively:
	    cp: cannot remove '/does_not_exist/file': No such file or directory
	    cp: cannot stat '/vmlinuz/file': Not a directory
	  respectively.
	  This will cost you ~60 bytes.

config BUSYBOX_CONFIG_FEATURE_COPYBUF_KB
	int "Copy buffer size, in kilobytes"
	range 1 1024
	default 4
	help
	  Size of buffer used by cp, mv, install etc.
	  Buffers which are 4 kb or less will be allocated on stack.
	  Bigger buffers will be allocated with mmap, with fallback to 4 kb
	  stack buffer if mmap fails.

config BUSYBOX_CONFIG_MONOTONIC_SYSCALL
	bool "Use clock_gettime(CLOCK_MONOTONIC) syscall"
	default n
	help
	  Use clock_gettime(CLOCK_MONOTONIC) syscall for measuring
	  time intervals (time, ping, traceroute etc need this).
	  Probably requires Linux 2.6+. If not selected, gettimeofday
	  will be used instead (which gives wrong results if date/time
	  is reset).

config BUSYBOX_CONFIG_IOCTL_HEX2STR_ERROR
	bool "Use ioctl names rather than hex values in error messages"
	default y
	help
	  Use ioctl names rather than hex values in error messages
	  (e.g. VT_DISALLOCATE rather than 0x5608). If disabled this
	  saves about 1400 bytes.

config BUSYBOX_CONFIG_FEATURE_HWIB
	bool "Support infiniband HW"
	default n
	help
	  Support for printing infiniband addresses in
	  network applets.

endmenu
```
