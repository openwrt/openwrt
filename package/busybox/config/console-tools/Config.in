## package/busybox/config/networking/udhcp/Config.in
```kconfig
#
# For a description of the syntax of this configuration file,
# see scripts/kbuild/config-language.txt.
#

config BUSYBOX_CONFIG_APP_UDHCPD
	bool "udhcp Server (udhcpd)"
	default n
	help
	  uDHCPd is a DHCP server geared primarily toward embedded systems,
	  while striving to be fully functional and RFC compliant.

	  See http://udhcp.busybox.net for further details.

config BUSYBOX_CONFIG_APP_DHCPRELAY
	bool "dhcprelay"
	default n
	depends on BUSYBOX_CONFIG_APP_UDHCPD
	help
	  dhcprelay listens for dhcp requests on one or more interfaces
	  and forwards these requests to a different interface or dhcp
	  server.

config BUSYBOX_CONFIG_APP_DUMPLEASES
	bool "Lease display utility (dumpleases)"
	default n
	depends on BUSYBOX_CONFIG_APP_UDHCPD
	help
	  dumpleases displays the leases written out by the udhcpd server.
	  Lease times are stored in the file by time remaining in lease, or
	  by the absolute time that it expires in seconds from epoch.

	  See http://udhcp.busybox.net for further details.

config BUSYBOX_CONFIG_APP_UDHCPC
	bool "udhcp Client (udhcpc)"
	default y
	help
	  uDHCPc is a DHCP client geared primarily toward embedded systems,
	  while striving to be fully functional and RFC compliant.

	  The udhcp client negotiates a lease with the DHCP server and
	  notifies a set of scripts when a lease is obtained or lost.

	  See http://udhcp.busybox.net for further details.

config BUSYBOX_CONFIG_FEATURE_UDHCP_SYSLOG
	bool "Log udhcp messages to syslog"
	default n
	depends on BUSYBOX_CONFIG_APP_UDHCPD || BUSYBOX_CONFIG_APP_UDHCPC
	select BUSYBOX_CONFIG_FEATURE_SYSLOG
	help
	  If not daemonized, udhcpd prints its messages to stdout/stderr.
	  If this option is selected, it will also log them to syslog.

	  See http://udhcp.busybox.net for further details.

config BUSYBOX_CONFIG_FEATURE_UDHCP_DEBUG
	bool "Compile udhcp with noisy debugging messages"
	default n
	depends on BUSYBOX_CONFIG_APP_UDHCPD || BUSYBOX_CONFIG_APP_UDHCPC
	help
	  If selected, udhcpd will output extra debugging output.  If using
	  this option, compile uDHCP with "-g", and do not fork the daemon to
	  the background.

	  See http://udhcp.busybox.net for further details.
```

## package/busybox/config/procps/Config.in
```kconfig
#
# For a description of the syntax of this configuration file,
# see scripts/kbuild/config-language.txt.
#

menu "Process Utilities"

config BUSYBOX_CONFIG_SMEMCAP
	bool "smemcap"
	default n
	help
	  smemcap is a tool for capturing process data for smem,
	  a memory usage statistic tool.

config BUSYBOX_CONFIG_FREE
	bool "free"
	default y
	help
	  free displays the total amount of free and used physical and swap
	  memory in the system, as well as the buffers used by the kernel.
	  The shared memory column should be ignored; it is obsolete.

config BUSYBOX_CONFIG_FUSER
	bool "fuser"
	default n
	help
	  fuser lists all PIDs (Process IDs) that currently have a given
	  file open. fuser can also list all PIDs that have a given network
	  (TCP or UDP) port open.

config BUSYBOX_CONFIG_KILL
	bool "kill"
	default y
	help
	  The command kill sends the specified signal to the specified
	  process or process group. If no signal is specified, the TERM
	  signal is sent.

config BUSYBOX_CONFIG_KILLALL
	bool "killall"
	default y
	depends on BUSYBOX_CONFIG_KILL
	help
	  killall sends a signal to all processes running any of the
	  specified commands. If no signal name is specified, SIGTERM is
	  sent.

config BUSYBOX_CONFIG_KILLALL5
	bool "killall5"
	default n
	depends on BUSYBOX_CONFIG_KILL

config BUSYBOX_CONFIG_NMETER
	bool "nmeter"
	default n
	help
	  Prints selected system stats continuously, one line per update.

config BUSYBOX_CONFIG_PGREP
	bool "pgrep"
	default y
	help
	  Look for processes by name.

config BUSYBOX_CONFIG_PIDOF
	bool "pidof"
	default y
	help
	  Pidof finds the process id's (pids) of the named programs. It prints
	  those id's on the standard output.

config BUSYBOX_CONFIG_FEATURE_PIDOF_SINGLE
	bool "Enable argument for single shot (-s)"
	default n
	depends on BUSYBOX_CONFIG_PIDOF
	help
	  Support argument '-s' for returning only the first pid found.

config BUSYBOX_CONFIG_FEATURE_PIDOF_OMIT
	bool "Enable argument for omitting pids (-o)"
	default n
	depends on BUSYBOX_CONFIG_PIDOF
	help
	  Support argument '-o' for omitting the given pids in output.
	  The special pid %PPID can be used to name the parent process
	  of the pidof, in other words the calling shell or shell script.

config BUSYBOX_CONFIG_PKILL
	bool "pkill"
	default y
	help
	  Send signals to processes by name.

config BUSYBOX_CONFIG_PS
	bool "ps"
	default y
	help
	  ps gives a snapshot of the current processes.

config BUSYBOX_CONFIG_FEATURE_PS_WIDE
	bool "Enable wide output option (-w)"
	default n
	depends on BUSYBOX_CONFIG_PS
	help
	  Support argument 'w' for wide output.
	  If given once, 132 chars are printed, and if given more
	  than once, the length is unlimited.

config BUSYBOX_CONFIG_FEATURE_PS_TIME
	bool "Enable time and elapsed time output"
	default n
	depends on BUSYBOX_CONFIG_PS && BUSYBOX_CONFIG_DESKTOP
	help
	  Support -o time and -o etime output specifiers.

config BUSYBOX_CONFIG_FEATURE_PS_ADDITIONAL_COLUMNS
	bool "Enable additional ps columns"
	default n
	depends on BUSYBOX_CONFIG_PS && BUSYBOX_CONFIG_DESKTOP
	help
	  Support -o rgroup, -o ruser, -o nice output specifiers.

config BUSYBOX_CONFIG_FEATURE_PS_UNUSUAL_SYSTEMS
	bool "Support Linux prior to 2.4.0 and non-ELF systems"
	default n
	depends on BUSYBOX_CONFIG_FEATURE_PS_TIME
	help
	  Include support for measuring HZ on old kernels and non-ELF systems
	  (if you are on Linux 2.4.0+ and use ELF, you don't need this)

config BUSYBOX_CONFIG_RENICE
	bool "renice"
	default n
	help
	  Renice alters the scheduling priority of one or more running
	  processes.

config BUSYBOX_CONFIG_BB_SYSCTL
	bool "sysctl"
	default y
	help
	  Configure kernel parameters at runtime.

config BUSYBOX_CONFIG_TOP
	bool "top"
	default y
	help
	  The top program provides a dynamic real-time view of a running
	  system.

config BUSYBOX_CONFIG_FEATURE_TOP_CPU_USAGE_PERCENTAGE
	bool "Show CPU per-process usage percentage"
	default y
	depends on BUSYBOX_CONFIG_TOP
	help
	  Make top display CPU usage for each process.
	  This adds about 2k.

config BUSYBOX_CONFIG_FEATURE_TOP_CPU_GLOBAL_PERCENTS
	bool "Show CPU global usage percentage"
	default y
	depends on BUSYBOX_CONFIG_FEATURE_TOP_CPU_USAGE_PERCENTAGE
	help
	  Makes top display "CPU: NN% usr NN% sys..." line.
	  This adds about 0.5k.

config BUSYBOX_CONFIG_FEATURE_TOP_SMP_CPU
	bool "SMP CPU usage display ('c' key)"
	default n
	depends on BUSYBOX_CONFIG_FEATURE_TOP_CPU_GLOBAL_PERCENTS
	help
	  Allow 'c' key to switch between individual/cumulative CPU stats
	  This adds about 0.5k.

config BUSYBOX_CONFIG_FEATURE_TOP_DECIMALS
	bool "Show 1/10th of a percent in CPU/mem statistics"
	default n
	depends on BUSYBOX_CONFIG_FEATURE_TOP_CPU_USAGE_PERCENTAGE
	help
	  Show 1/10th of a percent in CPU/mem statistics.
	  This adds about 0.3k.

config BUSYBOX_CONFIG_FEATURE_TOP_SMP_PROCESS
	bool "Show CPU process runs on ('j' field)"
	default n
	depends on BUSYBOX_CONFIG_TOP
	help
	  Show CPU where process was last found running on.
	  This is the 'j' field.

config BUSYBOX_CONFIG_FEATURE_TOPMEM
	bool "Topmem command ('s' key)"
	default n
	depends on BUSYBOX_CONFIG_TOP
	help
	  Enable 's' in top (gives lots of memory info).

config BUSYBOX_CONFIG_FEATURE_SHOW_THREADS
	bool "Support for showing threads in ps/top"
	default n
	depends on BUSYBOX_CONFIG_PS || BUSYBOX_CONFIG_TOP
	help
	  Enables ps -T option and 'h' command in top

config BUSYBOX_CONFIG_UPTIME
	bool "uptime"
	default y
	help
	  uptime gives a one line display of the current time, how long
	  the system has been running, how many users are currently logged
	  on, and the system load averages for the past 1, 5, and 15 minutes.

config BUSYBOX_CONFIG_WATCH
	bool "watch"
	default n
	help
	  watch is used to execute a program periodically, showing
	  output to the screen.

endmenu
```

## package/busybox/config/runit/Config.in
```kconfig
#
# For a description of the syntax of this configuration file,
# see scripts/kbuild/config-language.txt.
#

menu "Runit Utilities"

config BUSYBOX_CONFIG_RUNSV
	bool "runsv"
	default n
	help
	  runsv starts and monitors a service and optionally an appendant log
	  service.

config BUSYBOX_CONFIG_RUNSVDIR
	bool "runsvdir"
	default n
	help
	  runsvdir starts a runsv process for each subdirectory, or symlink to
	  a directory, in the services directory dir, up to a limit of 1000
	  subdirectories, and restarts a runsv process if it terminates.

config BUSYBOX_CONFIG_SV
	bool "sv"
	default n
	help
	  sv reports the current status and controls the state of services
	  monitored by the runsv supervisor.

config BUSYBOX_CONFIG_SVLOGD
	bool "svlogd"
	default n
	help
	  svlogd continuously reads log data from its standard input, optionally
	  filters log messages, and writes the data to one or more automatically
	  rotated logs.

config BUSYBOX_CONFIG_CHPST
	bool "chpst"
	default n
	help
	  chpst changes the process state according to the given options, and
	  execs specified program.

config BUSYBOX_CONFIG_SETUIDGID
	bool "setuidgid"
	help
	  Sets soft resource limits as specified by options

config BUSYBOX_CONFIG_ENVUIDGID
	bool "envuidgid"
	help
	  Sets $UID to account's uid and $GID to account's gid

config BUSYBOX_CONFIG_ENVDIR
	bool "envdir"
	help
	  Sets various environment variables as specified by files
	  in the given directory

config BUSYBOX_CONFIG_SOFTLIMIT
	bool "softlimit"
	help
	  Sets soft resource limits as specified by options

endmenu
```
