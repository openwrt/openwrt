## package/hostapd/Config.in
```kconfig
# wpa_supplicant config
config WPA_SUPPLICANT_NO_TIMESTAMP_CHECK
	bool "Disable timestamp check"
	depends PACKAGE_wpa-supplicant || PACKAGE_wpa-supplicant-mini || PACKAGE_wpad || PACKAGE_wpad-mini
	default n
	help
	  This disables the timestamp check for certificates in wpa_supplicant
	  Useful for devices without RTC that cannot reliably get the real date/time

choice
	prompt "Choose TLS provider"
	default WPA_SUPPLICANT_INTERNAL
	depends PACKAGE_wpa-supplicant || PACKAGE_wpad

config WPA_SUPPLICANT_INTERNAL
	bool "internal"

config WPA_SUPPLICANT_OPENSSL
	bool "openssl"
	select PACKAGE_libopenssl

endchoice

config WPA_RFKILL_SUPPORT
	bool "Add rfkill support"
	depends PACKAGE_wpa-supplicant || PACKAGE_wpa-supplicant-mini || PACKAGE_wpad || PACKAGE_wpad-mini
	default n


config DRIVER_WEXT_SUPPORT
	bool
	default n
```

## package/howl/Config.in
```kconfig
config BR2_PACKAGE_HOWL
	bool "howl - Zeroconf networking implementation"
	default y if CONFIG_DEVEL
	help
	  A cross-platform implementation of Zeroconf networking.
	  
	  http://www.porchdogsoft.com/products/howl/
	  

config BR2_PACKAGE_LIBHOWL
	depends BR2_PACKAGE_HOWL
	tristate "libhowl - howl library"
	default m if CONFIG_DEVEL

config BR2_PACKAGE_HOWL_UTILS
	depends BR2_PACKAGE_LIBHOWL
	tristate "howl-utils - howl client utilities"
	default m if CONFIG_DEVEL

config BR2_PACKAGE_MDNSRESPONDER
	depends BR2_PACKAGE_LIBHOWL
	tristate "mdnsresponder - an mDNS (Multicast DNS) service responder daemon"
	default m if CONFIG_DEVEL

config BR2_PACKAGE_AUTOIPD
	depends BR2_PACKAGE_LIBHOWL
	tristate "autoipd - an IPv4 Link-Local address self-assigner daemon"
	default m if CONFIG_DEVEL

config BR2_PACKAGE_NIFD
	depends BR2_PACKAGE_LIBHOWL
	tristate "nifd - a network interface monitor daemon"
	default m if CONFIG_DEVEL
```

## package/htpdate/Config.in
```kconfig
config BR2_PACKAGE_HTPDATE
	tristate "htpdate - an HTP (Hypertext Time Protocol) implementation"
	default m if CONFIG_DEVEL
	help
	  An HTP (Hypertext Time Protocol) implementation
	  
	  http://www.clevervest.com/htp/
	  
```

## package/httping/Config.in
```kconfig
menu "httping........................... Httping is like 'ping' but for http-requests."

config BR2_PACKAGE_HTTPING
	prompt "httping............................ Httping is like 'ping' but for http-requests."
	tristate
	default m if CONFIG_DEVEL
	help
		Httping is like 'ping' but for http-requests.
		Give it an url, and it'll show you how long it takes to connect, send a 
		request and retrieve the reply (only the headers). Be aware that the 
		transmission across the network also takes time!

		http://www.vanheusden.com/httping/

config BR2_PACKAGE_HTTPING_WITH_SSL
	prompt "Enable SSL support"
	bool
	default y
	depends BR2_PACKAGE_HTTPING

endmenu
```

## package/id3lib/Config.in
```kconfig
config BR2_PACKAGE_ID3LIB
	prompt "id3lib............................ An ID3v1/ID3v2 tagging library"
	tristate
	default m if CONFIG_DEVEL
	select BR2_PACKAGE_UCLIBCXX
	select BR2_PACKAGE_ZLIB
	help
	  An ID3v1/ID3v2 tagging library.
	  
	  http://www.id3lib.org/
	  
	  Depends: uClibc++, zlib
```

## package/ifx-tapidemo/Config.in
```kconfig
menu "Configuration"
	depends on PACKAGE_ifx-tapidemo
choice
	prompt "board selection"
	default VOICE_CPE_TAPIDEMO_BOARD_EASY50712_V3  if TARGET_ifxmips_platform_danube
	default VOICE_CPE_TAPIDEMO_BOARD_EASY508xx     if TARGET_ifxmips_platform_ar9
	default VOICE_CPE_TAPIDEMO_BOARD_EASY80910     if TARGET_ifxmips_platform_vr9
	default VOICE_CPE_TAPIDEMO_BOARD_EASY50812
	help
		Select the target platform.

	config VOICE_CPE_TAPIDEMO_BOARD_EASY50712
		bool "Danube reference board"

	config VOICE_CPE_TAPIDEMO_BOARD_EASY50712_V3
		bool "Danube reference board V3"

	config VOICE_CPE_TAPIDEMO_BOARD_EASY508xx
		bool "AR9/GR9 reference board"

	config VOICE_CPE_TAPIDEMO_BOARD_EASY80910
		bool "VR9 reference board"
endchoice

config VOICE_CPE_TAPIDEMO_QOS
	bool "enable QOS support"
	default n
	help
		Option to enable the KPI2UDP RTP packet acceleration path
		(highly recommended for VoIP).

config  VOICE_CPE_TAPIDEMO_FAX_T.38_FW
	bool "enable T.38 fax relay"
	depends on (TARGET_ifxmips_platform_ar9 || TARGET_ifxmips_platform_vr9)
	default n
	help
		enable T.38 fax relay demo.

endmenu
```

## package/ifxmips-dsl-api/Config.in
```kconfig
menu "Configuration"
	depends on PACKAGE_kmod-ifxmips-dsl-api

choice
	prompt "Firmware"
	default IFXMIPS_ANNEX_B
	help
	  This option controls which firmware is loaded

config IFXMIPS_ANNEX_A
	bool "Annex-A"
	help
	  Annex-A

config IFXMIPS_ANNEX_B
	bool "Annex-B"
	help
	  Annex-B

endchoice

config IFXMIPS_DSL_FIRMWARE
	bool "ifxmips-dsl firmware extractor"
	default y
	help
	  Say Y, if you need ifxmips-dsl to auto extract the firmware for you from the a800 firmware image

config IFXMIPS_DSL_DEBUG
	bool "ifxmips-dsl debugging"
	help
	  Say Y, if you need ifxmips-dsl to display debug messages.

endmenu
```

## package/igmpproxy/Config.in
```kconfig
config BR2_PACKAGE_IGMPPROXY
	prompt "igmpproxy......................... Multicast Routing Daemon"
	tristate
	default m if CONFIG_DEVEL
	help
	  IGMPproxy is a simple dynamic Multicast Routing Daemon using 
	  only IGMP signalling (Internet Group Management Protocol).

	  http://sourceforge.net/projects/igmpproxy
```

## package/iperf/Config.in
```kconfig
config BR2_PACKAGE_IPERF
	prompt "iperf............................. Internet Protocol bandwidth measuring tool"
	tristate
	default m if CONFIG_DEVEL
	help
	  Iperf is a modern alternative for measuring TCP and UDP bandwidth 
	  performance, allowing the tuning of various parameters and 
	  characteristics.
	  
	  http://dast.nlanr.net/Projects/Iperf/
```

## package/ipkg/Config.in
```kconfig
config BR2_PACKAGE_IPKG
	prompt "ipkg.............................. The itsy package management system"
	tristate
	default n if BUSYBOX_CONFIG_IPKG
	default y if ! BUSYBOX_CONFIG_IPKG
	help
	  Lightweight package management system
	  ipkg is the Itsy Package Management System, for handling
	  installation and removal of packages on a system. It can
	  recursively follow dependencies and download all packages
	  necessary to install a particular package.
	  
	  ipkg knows how to install both .ipk and .deb packages.
	  
	  ipkg is intended to serve the same functions (and more) for
	  Familiar that dpkg and apt serve for Debian, (while taking
	  up much less space).
```

## package/iproute2/Config.in
```kconfig
config BR2_PACKAGE_IPROUTE2
	tristate
	depends BR2_PACKAGE_IPROUTE2_IP || BR2_PACKAGE_IPROUTE2_TC
	default n

config BR2_PACKAGE_IPROUTE2_IP
	tristate "iproute2 routing control (ip)"
	default m if CONFIG_DEVEL
	select BR2_PACKAGE_IPROUTE2

config BR2_PACKAGE_IPROUTE2_TC
	tristate "iproute2 traffic control (tc)"
	default m if CONFIG_DEVEL
	select BR2_PACKAGE_IPROUTE2
	select BR2_PACKAGE_KMOD_SCHED

	
```

## package/ipsec-tools/Config.in
```kconfig
config BR2_PACKAGE_IPSEC_TOOLS
	prompt "ipsec-tools....................... IPsec management tools"
	tristate
	depends BR2_LINUX_2_6
	select BR2_PACKAGE_LIBOPENSSL
	default m if CONFIG_DEVEL
	help
	  IPsec management tools
	  
	  http://ipsec-tools.sourceforge.net/
```

## package/iptables-snmp/Config.in
```kconfig
config BR2_PACKAGE_IPTABLES_SNMP
	prompt "iptables-snmp..................... An snmpd plugin to access iptables rules"
	tristate
	default m if CONFIG_DEVEL
	select BR2_PACKAGE_IPTABLES
	select BR2_PACKAGE_SNMPD
	help
	  This is a plugin that makes iptables rules accessable from snmpd.
	  
	  http://www.nobiscuit.com/iptables-snmp/
```

## package/iptables/Config.in
```kconfig
config BR2_PACKAGE_IPTABLES
	tristate "iptables"
	default y
	help
	  Linux kernel (2.4+) firewall, NAT, and packet mangling tools.

	  http://www.iptables.org/

config BR2_PACKAGE_IPTABLES_UTILS
	tristate "save and restore"
	default m if CONFIG_DEVEL
	depends BR2_PACKAGE_IPTABLES
	help
	  iptables-save and iptables-restore

config BR2_PACKAGE_IPTABLES_EXTRA
	tristate "extra modules"
	default m if CONFIG_DEVEL
	depends BR2_PACKAGE_IPTABLES
	help
	  Extra modules for iptables (kernel and user space)

config BR2_PACKAGE_IP6TABLES
	tristate "ip6tables"
	default m if CONFIG_DEVEL
	depends BR2_PACKAGE_IPTABLES
	select BR2_PACKAGE_KMOD_IPV6
	help
	  IPv6 firewalling
```

## package/iptraf/Config.in
```kconfig
config BR2_PACKAGE_IPTRAF
	tristate "iptraf - A console-based network monitoring program"
	default m if CONFIG_DEVEL
	help
	  IPTraf is a console-based network statistics utility for Linux. It gathers 
	  a variety of figures such as TCP connection packet and byte counts, 
	  interface statistics and activity indicators, TCP/UDP traffic breakdowns, 
	  and LAN station packet and byte counts.
	  
	  http://iptraf.seul.org/
	  
```

## package/irssi/Config.in
```kconfig
config BR2_PACKAGE_IRSSI
	prompt "irssi............................. console irc client"
	tristate
	default m if CONFIG_DEVEL
	select BR2_PACKAGE_GLIB1
	select BR2_PACKAGE_LIBNCURSES
	help
	  IRC client for the text console
	  
	  http://irssi.org
```

## package/jamvm/Config.in
```kconfig
config BR2_PACKAGE_JAMVM
        prompt "jamvm............................. A compact Java Virtual Machine"
	tristate
        default m if CONFIG_DEVEL
	select BR2_PACKAGE_ZLIB
	select BR2_PACKAGE_LIBFFI_SABLE
	select BR2_PACKAGE_LIBSABLEVM_CLASSPATH
        help
	  JamVM is a new Java Virtual Machine which conforms to the JVM
	  specification version (blue book). In comparison to most other VM's
	  (free and commercial) it is extremely small.However, unlike other
	  small VMs (e.g. KVM) it is designed to support the full
	  specification, and includes support for object finalisation,
	  Soft/Weak/Phantom References, the Java Native Interface (JNI) and the
	  Reflection API.

	  http://sourceforge.net/projects/jamvm
```

## package/jpeg/Config.in
```kconfig
config BR2_COMPILE_JPEG
	tristate
	default n
	depends BR2_PACKAGE_LIBJPEG

config BR2_PACKAGE_LIBJPEG
	prompt "libjpeg........................... The Independent JPEG Group's JPEG runtime library"
	tristate
	default m if CONFIG_DEVEL
	select BR2_COMPILE_JPEG
	help
	  The Independent JPEG Group's JPEG runtime library.
	  
	  http://www.ijg.org/
```

## package/kernel/gpio-nxp-74hc153/src/Kconfig
```kconfig
config GPIO_NXP_74HC153
	tristate "NXP 74HC153 Dual 4-input multiplexer"
	help
	  Platform driver for NXP 74HC153 Dual 4-input Multiplexer.
	  This provides a GPIO interface supporting input mode only.
```

## package/kernel/hasivo-stc8-hwmon/Documentation/devicetree/bindings/hwmon/hasivo,stc8-hwmon.yaml
```yaml
# SPDX-License-Identifier: GPL-2.0-only OR BSD-2-Clause
%YAML 1.2
---
$id: http://devicetree.org/schemas/hwmon/hasivo,stc8-hwmon.yaml#
$schema: http://devicetree.org/meta-schemas/core.yaml#

title: Hasivo STC8 microcontroller hwmon

maintainers:
  - Carlo Szelinsky <github@szelinsky.de>

description: |
  hwmon child of the Hasivo STC8 MFD (compatible "hasivo,stc8-mfd").
  Exposes CPU and system temperatures plus a 3-state fan control knob
  (auto / force-on / force-off) and a fan-running alarm. The STC8
  microcontroller manages fan speed internally; there is no host-side
  PWM duty register and no tach feedback register.

  The driver reads the chip identity at register 0xFD (expected 0x91)
  and the capability byte at 0xFE to decide which temperature channels
  and fan controls to expose. Register addresses are fixed by the STC8
  firmware and are not described in DT.

properties:
  compatible:
    const: hasivo,stc8-hwmon

required:
  - compatible

additionalProperties: false

examples:
  - |
    i2c {
        #address-cells = <1>;
        #size-cells = <0>;

        stc8: stc8-mfd@4d {
            compatible = "hasivo,stc8-mfd", "syscon";
            reg = <0x4d>;
            hasivo,execute-bit = <0x40>;
            hasivo,execute-bit-registers = <0x01 0x02>;

            hwmon {
                compatible = "hasivo,stc8-hwmon";
            };
        };
    };
```

## package/kernel/i2c-aw9523-expander/src/Kconfig
```kconfig
config I2C_LED_AW9523
	tristate "AW9523 GPIO-based I2C expander LED driver"
	depends on LEDS_CLASS && I2C
	help
	  This is an I2C driver to register AW9523 LEDs expander.

	  This support is also available as a module.  If so, the module
	  will be called i2c-led-aw9523.
```

## package/kernel/intel/vrx518_ep/src/Kconfig
```kconfig
config TEST
	tristate "Intel(R) VRX518 SmartPHY DSL Test Driver"
	depends on VRX518
	---help---
	  This driver supports Intel(R) VRX518 DSL interrupt and ACA test.

	  To compile this driver as a module, choose M here. The module
	  will be called vrx518.  MSI interrupt support is required for
	  this driver to work correctly.
```

## package/kernel/xradio/src/Kconfig
```kconfig
config WLAN_VENDOR_XRADIO
       tristate "XRADIO WLAN support"
       depends on MAC80211
       default m
       help

         This is an experimental driver for the XRADIO chip-set.
         Enabling this option enables the generic driver without
         any platform support.
         Please select the appropriate platform below.

if WLAN_VENDOR_XRADIO

config XRADIO_NON_POWER_OF_TWO_BLOCKSIZES
	bool "Platform supports non-power-of-two SDIO transfer"
	depends on WLAN_VENDOR_XRADIO
	default y
	---help---
	  Say N here only if you are running the driver on a platform
	  which does not have support for non-power-of-two SDIO transfer.
	  If unsure, say Y.

config XRADIO_5GHZ_SUPPORT
	bool "5GHz band support"
	depends on WLAN_VENDOR_XRADIO
	default n
	---help---
	  Say Y if your device supports 5GHz band. If unsure, say N.

config XRADIO_WAPI_SUPPORT
	bool "WAPI support"
	depends on WLAN_VENDOR_XRADIO
	default n
	---help---
	  Say Y if your compat-wireless support WAPI.
	  If unsure, say N.

config XRADIO_USE_EXTENSIONS
	bool "Extensions for WFD and PS mode"
	depends on WLAN_VENDOR_XRADIO
	default y
	---help---
	  Say Y if you want to include XR extensions
	  If unsure, say Y.

endif
```

## package/kismet/Config.in
```kconfig
#menu "kismet............................ An 802.11 layer2 wireless network detector, sniffer, and intrusion detection system"

config BR2_COMPILE_KISMET
	tristate
	default n
	depends BR2_PACKAGE_KISMET_CLIENT || BR2_PACKAGE_KISMET_DRONE || BR2_PACKAGE_KISMET_SERVER

config BR2_PACKAGE_KISMET_CLIENT
	prompt "kismet-client..................... The Kismet client"
	tristate
	default m if CONFIG_DEVEL
	select BR2_COMPILE_KISMET
	select BR2_PACKAGE_LIBNCURSES
	select BR2_PACKAGE_UCLIBCXX
	help
	  
	  An 802.11 layer2 wireless network detector, sniffer, and intrusion detection system.
	  
	  http://www.kismetwireless.net/
	  
	  This package contains the kismet text interface client.
	  
	  Depends:
	    - libncurses
	    - libpcap
	    - uClibc++

config BR2_PACKAGE_KISMET_DRONE
	prompt "kismet-drone...................... The Kismet drone"
	tristate
	default m if CONFIG_DEVEL
	select BR2_COMPILE_KISMET
	select BR2_PACKAGE_LIBPCAP
	select BR2_PACKAGE_UCLIBCXX
	help
	  
	  An 802.11 layer2 wireless network detector, sniffer, and intrusion detection system.
	  
	  http://www.kismetwireless.net/
	  
	  This package contains the kismet remote sniffing.and monitoring drone.
	  
	  Depends:
	    - libpcap
	    - uClibc++

config BR2_PACKAGE_KISMET_SERVER
	prompt "kismet-server..................... The Kismet server"
	tristate
	default m if CONFIG_DEVEL
	select BR2_COMPILE_KISMET
	select BR2_PACKAGE_LIBPCAP
	select BR2_PACKAGE_UCLIBCXX
	help
	  
	  An 802.11 layer2 wireless network detector, sniffer, and intrusion detection system.
	  
	  http://www.kismetwireless.net/
	  
	  This package contains the kismet server.
	  
	  Depends:
	    - libpcap
	    - uClibc++

#endmenu
```
