## package/knock/Config.in
```kconfig
config BR2_COMPILE_KNOCK
	tristate
	default n
	depends BR2_PACKAGE_KNOCK || BR2_PACKAGE_KNOCKD

config BR2_PACKAGE_KNOCK
	prompt "knock............................. A port-knocking client"
	tristate
	default m if CONFIG_DEVEL 
	select BR2_COMPILE_KNOCK
	help
	  It listens to all traffic on an ethernet (or PPP) interface, 
	  looking for special "knock" sequences of port-hits. A client 
	  makes these port-hits by sending a TCP (or UDP) packet to a 
	  port on the server. This port need not be open -- since 
	  knockd listens at the link-layer level, it sees all traffic 
	  even if it's destined for a closed port. When the server 
	  detects a specific sequence of port-hits, it runs a command 
	  defined in its configuration file. This can be used to open 
	  up holes in a firewall for quick access.
	  
	  http://www.zeroflux.org/cgi-bin/cvstrac/knock/wiki

config BR2_PACKAGE_KNOCKD
	prompt "knockd............................ A port-knocking server"
	tristate
	default m if CONFIG_DEVEL 
	select BR2_COMPILE_KNOCK
	help
	  It listens to all traffic on an ethernet (or PPP) interface, 
	  looking for special "knock" sequences of port-hits. A client 
	  makes these port-hits by sending a TCP (or UDP) packet to a 
	  port on the server. This port need not be open -- since 
	  knockd listens at the link-layer level, it sees all traffic 
	  even if it's destined for a closed port. When the server 
	  detects a specific sequence of port-hits, it runs a command 
	  defined in its configuration file. This can be used to open 
	  up holes in a firewall for quick access.
	  
	  http://www.zeroflux.org/cgi-bin/cvstrac/knock/wiki
```
