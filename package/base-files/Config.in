## package/boot/uboot-lantiq-easybox904xdsl/config/scripts_platform/Kconfig
```kconfig
#
# For a description of the syntax of this configuration file,
# see Linux Documentation
#
#

config UBOOT_CONFIG_IFX_UBOOT_OPTIMIZED
      bool
      default y

config UBOOT_CONFIG_CONFIG_REMOVE_GZIP
      bool
    default y

config UBOOT_CONFIG_CONFIG_IFX_MIPS
      bool
      default y

config UBOOT_CONFIG_CROSS_COMPILE_UCLIBC
      bool
      default y

config UBOOT_CONFIG_LANTIQ_UART
	  bool
	  default y

menu "Build Options"

choice
    prompt 'Boot From'
    default UBOOT_CONFIG_BOOT_FROM_NAND

config UBOOT_CONFIG_BOOT_FROM_NOR
    bool "NOR Flash"
    select UBOOT_CONFIG_ENV_IS_IN_FLASH
	depends on !UBOOT_CONFIG_LANTIQ_UBOOT_ar10

config UBOOT_CONFIG_BOOT_FROM_SPI
    bool "SPI Flash"
    select UBOOT_CONFIG_ENV_IS_IN_SPI_FLASH
    select UBOOT_CONFIG_SPI_FLASH
    select UBOOT_CONFIG_FIRMWARE_IN_ROOTFS if ( UBOOT_CONFIG_SPI_FLASH_256K || UBOOT_CONFIG_SPI_FLASH_512K)
    select UBOOT_CONFIG_ENV_IS_IN_SPI_FLASH if ( !UBOOT_CONFIG_SPI_FLASH_256K && !UBOOT_CONFIG_SPI_FLASH_512K )
    select UBOOT_CONFIG_ENV_IS_IN_NAND if ( UBOOT_CONFIG_SPI_FLASH_256K || UBOOT_CONFIG_SPI_FLASH_512K )
    help
    Boots from SPI flash.

config UBOOT_CONFIG_BOOT_FROM_NAND
    bool "NAND Flash"
    select UBOOT_CONFIG_NAND_FLASH
    select UBOOT_CONFIG_NAND_U_BOOT
	help
    Boots from NAND flash.

config UBOOT_CONFIG_BOOT_FROM_ETHERNET
    bool "ETHERNET"
	select UBOOT_CONFIG_ENV_IS_NOWHERE
    help
    Boots from ethernet port.

config UBOOT_CONFIG_BOOT_FROM_UART
    bool "UART"
    select UBOOT_CONFIG_ENV_IS_IN_FLASH
    help
    Boots from asc port.

config UBOOT_CONFIG_BOOT_WITH_NO_FLASH
    bool "NO FLASH"
    select UBOOT_CONFIG_ENV_IS_NOWHERE

endchoice

config UBOOT_CONFIG_ENV_IS_NOWHERE
    bool 
	default n

config UBOOT_CONFIG_ENV_IS_IN_FLASH
    bool

config UBOOT_CONFIG_ENV_IS_IN_SPI_FLASH
    bool

config UBOOT_CONFIG_ENV_IS_IN_NAND
    bool
	default y
	depends on UBOOT_CONFIG_BOOT_FROM_NAND && !UBOOT_CONFIG_ENV_IS_NOWHERE

config UBOOT_CONFIG_ENV_IS_NOWHERE
    bool

config UBOOT_CONFIG_NAND_U_BOOT
    bool

config UBOOT_CONFIG_RAM_TEXT_BASE
    hex "RAM TEXTBASE" 
	default "0xA0400000"

config UBOOT_CONFIG_BOOTSTRAP_TEXT_BASE
    hex "BOOTSTRAP TEXT_BASE"
	default "0xB0000000" if ( UBOOT_CONFIG_BOOT_FROM_NOR )
	default "0xA0100000" if ( !UBOOT_CONFIG_BOOT_FROM_NOR )

config UBOOT_CONFIG_NAND_PRELOAD_TEXT_BASE
	hex "NAND_PRELOAD_TEXT_BASE"
	default "0xBE1A0000" if LANTIQ_UBOOT_ar9
	default "0xBE220000" if LANTIQ_UBOOT_vr9
	default "0xBE1A0000" if LANTIQ_UBOOT_ar10

config UBOOT_CONFIG_NAND_SPL_TEXT_BASE
    hex "NAND_SPL_TEXT_BASE"
	default "0xBE1a0400"  if LANTIQ_UBOOT_ar9
    default "0xBE220400"  if LANTIQ_UBOOT_vr9
	default "0xBE1A0000"  if LANTIQ_UBOOT_ar10
	depends on UBOOT_CONFIG_BOOT_FROM_NAND

config UBOOT_CONFIG_SFDDR_TEXT_BASE
	hex "UBOOT_CONFIG_SFDDR_TEXT_BASE"
	default "0xBE1A0000" if LANTIQ_UBOOT_ar9
	default "0xBE220500" if LANTIQ_UBOOT_vr9
	depends on UBOOT_CONFIG_BOOT_FROM_SPI

choice
     prompt "OS COMPRESSION TYPE"
     default UBOOT_CONFIG_OS_LZMA

config UBOOT_CONFIG_OS_GZIP
     bool "GZIP"

config UBOOT_CONFIG_OS_LZMA
     bool "LZMA"

config UBOOT_CONFIG_OS_LZO
     bool "LZO"

config UBOOT_CONFIG_OS_BZIP2
     bool "BZIP2"

endchoice
						   


config UBOOT_CONFIG_IFX_IMAGE_EXTRA_CHECKS
    bool "IFX IMAGE EXTRA CHECK"
	default n
		
config UBOOT_CONFIG_VENDOR_NAME
    string 
	default "LANTIQ"
	depends on UBOOT_CONFIG_IFX_IMAGE_EXTRA_CHECKS

config UBOOT_CONFIG_SW_VERSION
    string 
	default "4.2.0"
	depends on UBOOT_CONFIG_IFX_IMAGE_EXTRA_CHECKS

config UBOOT_CONFIG_DEBUG
    bool "VERBOSE"
	default y

endmenu

menu "Board Settings"

config UBOOT_CONFIG_IFX_MEMORY_SIZE
        int "RAM Size(M)"
        default 128

config UBOOT_CONFIG_ASC_BAUDRATE
  string "ASC BAUDRATE"
  default "115200"


config UBOOT_CONFIG_NOR_FLASH
        bool "NOR FLASH SUPPORT"
        default n
        select UBOOT_CONFIG_CMD_FLASH
		depends on !UBOOT_CONFIG_LANTIQ_UBOOT_ar10

config UBOOT_CONFIG_SYS_NO_FLASH
       bool
	   default y
	   depends on !UBOOT_CONFIG_NOR_FLASH

config UBOOT_CONFIG_FLASH_CFI_DRIVER
       bool
	   default y
	   depends on UBOOT_CONFIG_NOR_FLASH

config UBOOT_CONFIG_SYS_FLASH_CFI
       bool
	   default y
	   depends on UBOOT_CONFIG_NOR_FLASH

config UBOOT_CONFIG_FLASH_CFI_MTD
	   bool "MTD SUPPORT"
	   default n
	   depends on UBOOT_CONFIG_NOR_FLASH

choice
     prompt "NOR Flash Size(M)"
	### ctc ###
#     depends on UBOOT_CONFIG_BOOT_FROM_NOR
     depends on UBOOT_CONFIG_NOR_FLASH
	###########
     default UBOOT_CONFIG_NOR_FLASH_8M

config UBOOT_CONFIG_NOR_FLASH_32M
     bool "32M"

config UBOOT_CONFIG_NOR_FLASH_16M
     bool "16M"

config UBOOT_CONFIG_NOR_FLASH_8M
     bool "8M"

config UBOOT_CONFIG_NOR_FLASH_4M
     bool "4M"

config UBOOT_CONFIG_NOR_FLASH_2M
     bool "2M"

config UBOOT_CONFIG_NOR_FLASH_AUTO
     bool "auto detect"

endchoice


config UBOOT_CONFIG_SPI_FLASH
      bool "SPI FLASH SUPPORT"
      select UBOOT_CONFIG_LANTIQ_SPI
      select UBOOT_CONFIG_CMD_SF

choice
     prompt "SPI Flash Size(M)"
	 depends on UBOOT_CONFIG_BOOT_FROM_SPI
	 default UBOOT_CONFIG_SPI_FLASH_8M

config UBOOT_CONFIG_SPI_FLASH_8M
     bool "8M"

config UBOOT_CONFIG_SPI_FLASH_4M
     bool "4M"

config UBOOT_CONFIG_SPI_FLASH_2M
     bool "2M"

config UBOOT_CONFIG_SPI_FLASH_1M
     bool "1M"

config UBOOT_CONFIG_SPI_FLASH_512K
     bool "512K"

config UBOOT_CONFIG_SPI_FLASH_256K
     bool "256K"

endchoice
							  

config UBOOT_CONFIG_SPI_FLASH_ATMEL
        bool "ATMEL SFLASH SUPPORT"
    depends on UBOOT_CONFIG_SPI_FLASH

config UBOOT_CONFIG_SPI_FLASH_STMICRO
        bool  "STMICRO SFLASH SUPPORT"
    depends on UBOOT_CONFIG_SPI_FLASH

config UBOOT_CONFIG_SPI_FLASH_SST
        bool "SST SFLASH SUPPORT"
        depends on UBOOT_CONFIG_SPI_FLASH

config UBOOT_CONFIG_SPI_FLASH_SPANSION
        bool "SPANSION SFLASH SUPPORT"
    depends on UBOOT_CONFIG_SPI_FLASH

config UBOOT_CONFIG_SPI_FLASH_MXIC
        bool "MXIC SFLASH SUPPORT"
    depends on UBOOT_CONFIG_SPI_FLASH

config UBOOT_CONFIG_SPI_FLASH_WINBOND
        bool "WINBOND SFLASH SUPPORT"
    depends on UBOOT_CONFIG_SPI_FLASH

config UBOOT_CONFIG_LANTIQ_SPI
        bool

config  UBOOT_CONFIG_SF_DEFAULT_SPEED
        int "SPI FLASH BAUDRATE(Hz)"
    default "1000000"
        depends on UBOOT_CONFIG_SPI_FLASH

config UBOOT_CONFIG_SF_DEFAULT_MODE
        int "SFLASH SPI MODE"
    default "0"
    depends on UBOOT_CONFIG_LANTIQ_SPI

config UBOOT_CONFIG_SPI_EEPROM
        bool "SPI EEPROM SUPPORT"
    select UBOOT_CONFIG_CMD_EEPROM
    select UBOOT_CONFIG_LANTIQ_SPI
    select UBOOT_CONFIG_SPI_EEPROM_ATMEL


config UBOOT_CONFIG_SPI_EEPROM_ATMEL
        bool "ATMEL 250X0 SUPPORT"
        depends on UBOOT_CONFIG_SPI_EEPROM


config  UBOOT_CONFIG_EEPROM_DEFAULT_SPEED
        int "EEPROM BAUDRATE(Hz)"
    default "1000000"
    depends on UBOOT_CONFIG_SPI_EEPROM

config  UBOOT_CONFIG_EEPROM_DEFAULT_MODE
        int "EEPROM SPI MODE"
        default "0"
        depends on UBOOT_CONFIG_SPI_EEPROM


config UBOOT_CONFIG_NAND_FLASH
      bool "NAND FLASH_SUPPORT"
      select UBOOT_CONFIG_CMD_NAND
      select UBOOT_CONFIG_NAND_LANTIQ

choice 
      prompt "ECC MODE"
	  depends on UBOOT_CONFIG_NAND_FLASH
	  default UBOOT_CONFIG_NAND_ECC_SOFT

config UBOOT_CONFIG_NAND_ECC_SOFT
       bool "SOFTWARE"
	  
config UBOOT_CONFIG_NAND_ECC_HW_HAMMING
       bool "HARDWARE HAMMING"

config UBOOT_CONFIG_NAND_ECC_HW_REED_SOLOMON
       bool "HARDWARE REED SOLOMON"

endchoice

choice 
     prompt "ECC LOCATION"
     depends on UBOOT_CONFIG_NAND_ECC_HW_REED_SOLOMON
     default UBOOT_CONFIG_NAND_HW_ECC_SPARE_AREA

config UBOOT_CONFIG_NAND_HW_ECC_SPARE_AREA
      bool "ECC IN OOB AREA"

config UBOOT_CONFIG_NAND_HW_ECC_EMBEDDED
      bool "ECC EMBEDDED IN DATA AREA"
	  
endchoice


config UBOOT_CONFIG_NAND_ECC_HW
	  bool
	  depends on UBOOT_CONFIG_NAND_ECC_HW_HAMMING || UBOOT_CONFIG_NAND_ECC_HW_REED_SOLOMON
	  default y

config UBOOT_CONFIG_NAND_BBT_SCAN
        bool "BAD NAND BLOCK SCAN"
        depends on UBOOT_CONFIG_NAND_FLASH
	default y

config UBOOT_CONFIG_NAND_LANTIQ
       bool
       depends on UBOOT_CONFIG_NAND_FLASH

config UBOOT_CONFIG_NAND_CS0
       bool "NAND FLASH ON CS0"
	   default y
	   depends on UBOOT_CONFIG_NAND_FLASH 
	   depends on UBOOT_CONFIG_LANTIQ_UBOOT_ar10

choice
     prompt "NAND Flash Size(M)"
	### ctc ###
#	 depends on UBOOT_CONFIG_BOOT_FROM_NAND
	 depends on UBOOT_CONFIG_NAND_FLASH
	###########
	 default UBOOT_CONFIG_NAND_FLASH_512M

config UBOOT_CONFIG_NAND_FLASH_4096M
	 bool "4096M" 

config UBOOT_CONFIG_NAND_FLASH_128M
     bool "128M"

config UBOOT_CONFIG_NAND_FLASH_512M
     bool "512M"

config UBOOT_CONFIG_NAND_FLASH_64M
     bool "64M"

config UBOOT_CONFIG_NAND_FLASH_32M
     bool "32M"

### ctc ###
config UBOOT_CONFIG_NAND_FLASH_16M
     bool "16M"
###########

config UBOOT_CONFIG_NAND_FLASH_8M
     bool "8M"

config UBOOT_CONFIG_NAND_FLASH_4M
     bool "4M"

config UBOOT_CONFIG_NAND_FLASH_2M
     bool "2M"

endchoice


config UBOOT_CONFIG_NAND_FLASH_SIZE
  ### ctc ###
#    hex 
	int
  ###########
	default "2" if ( UBOOT_CONFIG_NAND_FLASH_2M )
	default "4" if ( UBOOT_CONFIG_NAND_FLASH_4M )
	default "8" if ( UBOOT_CONFIG_NAND_FLASH_8M )
	default "32" if ( UBOOT_CONFIG_NAND_FLASH_32M )
	default "64" if ( UBOOT_CONFIG_NAND_FLASH_64M )
	default "128" if ( UBOOT_CONFIG_NAND_FLASH_128M )
	default "512" if ( UBOOT_CONFIG_NAND_FLASH_512M )
	default "4096" if ( UBOOT_CONFIG_NAND_FLASH_4096M )

config UBOOT_CONFIG_NAND_PAGE_SIZE
     hex "NAND flash page size(bytes)"
     default "0x800"
	### ctc ###
#     depends on ( UBOOT_CONFIG_TUNE_DDR && UBOOT_CONFIG_BOOT_FROM_NAND)
     depends on UBOOT_CONFIG_NAND_FLASH
	###########


config UBOOT_CONFIG_FIRMWARE_IN_ROOTFS
     bool "firmware in rootfs"
     default y

config UBOOT_CONFIG_OVERLAY
	 bool "overlay fs support"
	 default n
	 depends on UBOOT_CONFIG_DRIVER_VR9 || UBOOT_CONFIG_DRIVER_AR9 || UBOOT_CONFIG_DRIVER_DANUBE

if LANTIQ_UBOOT_ar9
   source ../board/ar9/Kconfig
endif

if LANTIQ_UBOOT_danube
   source ../board/danube/Kconfig
endif

if LANTIQ_UBOOT_amazon_se
   source ../board/amazon_se/Kconfig
endif

if LANTIQ_UBOOT_vr9
   source ../board/vr9/Kconfig
endif

if LANTIQ_UBOOT_ar10
   source ../board/ar10/Kconfig
endif
   

endmenu


menu "Network Settings"
config UBOOT_CONFIG_IP_ADDRESS
    string "IP address"
    default "192.168.2.1"

config UBOOT_CONFIG_SERVER_IP_ADDRESS
    string "Server IP address"
    default "192.168.2.100"

config UBOOT_CONFIG_ETHERNET_ADDRESS
    string "Ethernet Address"
    default "00:E0:92:00:01:40"

config UBOOT_CONFIG_ETHERNET_DEVICE
    string "Ethernet Interface"
    default "eth0"
endmenu

menu "Environment Settings"

config UBOOT_CONFIG_ENV_REDUND
    bool "redundant env"
	default no
	depends on UBOOT_CONFIG_ENV_IS_IN_FLASH

config UBOOT_CONFIG_ENV_OVERWRITE
	bool "enable env overwrite"
	default y

config UBOOT_CONFIG_TFTP_LOAD_ADDRESS
    string "tftp load address"
    default "0x80800000"
    
config UBOOT_CONFIG_MEM
    string "mem"
    default "116M"

config UBOOT_CONFIG_PHYM
    string "phym"
    default "128M"

config UBOOT_CONFIG_BOOTDELAY
    int "BOOTDELAY(seconds)"
    default 3

config UBOOT_CONFIG_ROOT_PATH
    string "rootpath"
    default ""


config UBOOT_CONFIG_CONSOLE
	string "console"
	default "ttyS0"

config UBOOT_CONFIG_TFTPPATH
	string ""
	default ""

config UBOOT_CONFIG_ROOTFSMTD
    string "rootfsmtd"
	default "/dev/mtdblock1" if ( UBOOT_CONFIG_BOOT_FROM_NAND && UBOOT_CONFIG_FIRMWARE_IN_ROOTFS )
	default "/dev/mtdblock3" if ( UBOOT_CONFIG_BOOT_FROM_NAND && !UBOOT_CONFIG_FIRMWARE_IN_ROOTFS )
	default "/dev/mtdblock1" if ( UBOOT_CONFIG_FIRMWARE_IN_ROOTFS )
	default "/dev/mtdblock2" if ( UBOOT_CONFIG_BOOT_FROM_NOR && !UBOOT_CONFIG_FIRMWARE_IN_ROOTFS )
	default "/dev/mtdblock2" if ( UBOOT_CONFIG_BOOT_FROM_SPI && !UBOOT_CONFIG_FIRMWARE_IN_ROOTFS )	

config UBOOT_CONFIG_NFSARGS
    string "nfsargs"
    default ""

config UBOOT_CONFIG_RAMARGS
    string "ramargs"
    default ""

config UBOOT_CONFIG_FLASHARGS
    string "flashargs"
    default "setenv bootargs root=$(rootfsmtd) rw rootfstype=squashfs,jffs2"
config UBOOT_CONFIG_ADDIP
    string "addip"
    default "setenv bootargs $(bootargs) ip=$(ipaddr):$(serverip):$(gatewayip):$(netmask):$(hostname):$(netdev):on"

config UBOOT_CONFIG_ADDMISC
    string "addmisc"
	default "setenv bootargs $(bootargs) console=$(console),$(baudrate) ethaddr=$(ethaddr) phym=$(phym) mem=$(mem) panic=1 mtdparts=$(mtdparts) init=/etc/preinit vpe1_load_addr=0x87e00000 vpe1_mem=2M"

config UBOOT_CONFIG_BOOTFILE
    string "bootfile"
    default "uImage"

config UBOOT_CONFIG_U_BOOT
    string "u-boot"
    default "u-boot.lq"

config UBOOT_CONFIG_SYSCONFIG
	string "sysconfig"
	default "sysconfig.jffs2-128k.nand"

config UBOOT_CONFIG_ROOTFS
    string "rootfs"
    default "root.squash"

config UBOOT_CONFIG_FIRMWARE
    string "firmware"
    default ""

config UBOOT_CONFIG_FULLIMAGE
    string "fullimage"
	default "fullimage.img"

config UBOOT_CONFIG_TOTALIMAGE
    string "totalimage"
	default ""

config UBOOT_CONFIG_USE_DEFAULT_MTDPARTS
    bool "use default MTDPARTS"
	default y


if LANTIQ_UBOOT_danube
config UBOOT_CONFIG_MTDPARTS
    string
	default "ifx_nor0:64k(uboot),256k(firmware),7744k(rootfs),64k(sysconfig),4k(ubootconfig),4k(fwdiag),4k(caliberation),-(res)" if ( UBOOT_CONFIG_BOOT_FROM_NOR && UBOOT_CONFIG_NOR_FLASH_8M  && !UBOOT_CONFIG_FIRMWARE_IN_ROOTFS && !UBOOT_CONFIG_OVERLAY )
  default "ifx_nor0:64k(uboot),256k(firmware),7424k(rootfs),320k(overlay),64k(sysconfig),4k(ubootconfig),4k(fwdiag),4k(caliberation),-(res)" if ( UBOOT_CONFIG_BOOT_FROM_NOR && UBOOT_CONFIG_NOR_FLASH_8M  && !UBOOT_CONFIG_FIRMWARE_IN_ROOTFS && UBOOT_CONFIG_OVERLAY )
  default "ifx_nor0:64k(uboot),8000k(rootfs),64k(sysconfig),4k(ubootconfig),4k(fwdiag),4k(caliberation),-(res)" if ( UBOOT_CONFIG_BOOT_FROM_NOR && UBOOT_CONFIG_NOR_FLASH_8M && UBOOT_CONFIG_FIRMWARE_IN_ROOTFS && !UBOOT_CONFIG_OVERLAY)
  default "ifx_nor0:64k(uboot),7680k(rootfs),320k(overlay),64k(sysconfig),4k(ubootconfig),4k(fwdiag),4k(caliberation),-(res)" if ( UBOOT_CONFIG_BOOT_FROM_NOR && UBOOT_CONFIG_NOR_FLASH_8M && UBOOT_CONFIG_FIRMWARE_IN_ROOTFS && UBOOT_CONFIG_OVERLAY )
	default "ifx_nor0:64k(uboot),-(rootfs)" if ( UBOOT_CONFIG_BOOT_FROM_UART )
	default "" if ( UBOOT_CONFIG_NOR_FLASH_AUTO )
	depends on UBOOT_CONFIG_USE_DEFAULT_MTDPARTS
endif

if LANTIQ_UBOOT_amazon_se
config UBOOT_CONFIG_MTDPARTS
    string
    default "ifx_nor0:64k(uboot),3904k(rootfs),32k(sysconfig),4k(ubootconfig),4k(fwdiag),-(res)" if ( UBOOT_CONFIG_BOOT_FROM_NOR && UBOOT_CONFIG_NOR_FLASH_4M && UBOOT_CONFIG_FIRMWARE_IN_ROOTFS )  
    default "ifx_nor0:64k(uboot),192k(firmware),3796k(rootfs),32k(sysconfig),4k(ubootconfig),4k(fwdiag),-(res)" if ( UBOOT_CONFIG_BOOT_FROM_NOR && UBOOT_CONFIG_NOR_FLASH_4M && !UBOOT_CONFIG_FIRMWARE_IN_ROOTFS )
	default "ifx_nor0:64k(uboot),256k(firmware),7744k(rootfs),64k(sysconfig),4k(ubootconfig),4k(fwdiag),4k(caliberation),-(res)" if ( UBOOT_CONFIG_BOOT_FROM_NOR && UBOOT_CONFIG_NOR_FLASH_8M  && !UBOOT_CONFIG_FIRMWARE_IN_ROOTFS )
	default "ifx_nor0:64k(uboot),8000k(rootfs),64k(sysconfig),4k(ubootconfig),4k(fwdiag),4k(caliberation),-(res)" if ( UBOOT_CONFIG_BOOT_FROM_NOR && UBOOT_CONFIG_NOR_FLASH_8M && UBOOT_CONFIG_FIRMWARE_IN_ROOTFS )
	default "ifx_sflash:64k(uboot),3904k(rootfs),32k(sysconfig),4k(ubootconfig),4k(fwdiag),-(res)" if ( UBOOT_CONFIG_BOOT_FROM_SPI && UBOOT_CONFIG_SPI_FLASH_4M && UBOOT_CONFIG_FIRMWARE_IN_ROOTFS )
	default "ifx_sflash:64k(uboot),192k(firmware),3796k(rootfs),32k(sysconfig),4k(ubootconfig),4k(fwdiag),-(res)" if ( UBOOT_CONFIG_BOOT_FROM_SPI && UBOOT_CONFIG_SPI_FLASH_4M && !UBOOT_CONFIG_FIRMWARE_IN_ROOTFS )
	default "ifx_sflash:64kk(uboot),192k(firmware),7744k(rootfs),64k(sysconfig),4k(ubootconfig),4k(fwdiag),4k(caliberation),-(res)" if ( UBOOT_CONFIG_BOOT_FROM_SPI && UBOOT_CONFIG_SPI_FLASH_8M && !UBOOT_CONFIG_FIRMWARE_IN_ROOTFS )
	default "ifx_sflash:64k(uboot),-(rootfs)" if ( UBOOT_CONFIG_BOOT_FROM_SPI && UBOOT_CONFIG_FIRMWARE_IN_ROOTFS )
	default "ifx_nand:64k(uboot),-(rootfs)" if ( UBOOT_CONFIG_BOOT_FROM_NAND && UBOOT_CONFIG_FIRMWARE_IN_ROOTFS )
	default "ifx_nand:64k(uboot),192k(firmware),-(rootfs)" if ( UBOOT_CONFIG_BOOT_FROM_NAND && !UBOOT_CONFIG_FIRMWARE_IN_ROOTFS )
	default "ifx_nor0:64k(uboot),-(rootfs)" if ( UBOOT_CONFIG_BOOT_FROM_UART )
	default "" if ( UBOOT_CONFIG_NOR_FLASH_AUTO )
	depends on UBOOT_CONFIG_USE_DEFAULT_MTDPARTS
endif


if LANTIQ_UBOOT_ar9
config UBOOT_CONFIG_MTDPARTS
    string
	default "ifx_nor0:64k(uboot),192k(firmware),-(rootfs)" if ( UBOOT_CONFIG_BOOT_FROM_NOR && UBOOT_CONFIG_NOR_FLASH_4M && !UBOOT_CONFIG_FIRMWARE_IN_ROOTFS )
	default "ifx_sflash:64k(uboot),3904k(rootfs),32k(sysconfig),4k(ubootconfig),-(res)" if ( UBOOT_CONFIG_BOOT_FROM_SPI && UBOOT_CONFIG_SPI_FLASH_4M && !UBOOT_CONFIG_FIRMWARE_IN_ROOTFS )
	default "ifx_nor0:64k(uboot),256k(firmware),7744k(rootfs),64k(sysconfig),4k(ubootconfig),4k(fwdiag),4k(caliberation),-(res)" if ( UBOOT_CONFIG_BOOT_FROM_NOR && UBOOT_CONFIG_NOR_FLASH_8M  && !UBOOT_CONFIG_FIRMWARE_IN_ROOTFS && !UBOOT_CONFIG_OVERLAY )
  default "ifx_nor0:64k(uboot),256k(firmware),7424k(rootfs),320k(overlay),64k(sysconfig),4k(ubootconfig),4k(fwdiag),4k(caliberation),-(res)" if ( UBOOT_CONFIG_BOOT_FROM_NOR && UBOOT_CONFIG_NOR_FLASH_8M  && !UBOOT_CONFIG_FIRMWARE_IN_ROOTFS && UBOOT_CONFIG_OVERLAY )
  default "ifx_nor0:64k(uboot),8000k(rootfs),64k(sysconfig),4k(ubootconfig),4k(fwdiag),4k(caliberation),-(res)" if ( UBOOT_CONFIG_BOOT_FROM_NOR && UBOOT_CONFIG_NOR_FLASH_8M && UBOOT_CONFIG_FIRMWARE_IN_ROOTFS && !UBOOT_CONFIG_OVERLAY )
  default "ifx_nor0:64k(uboot),7680k(rootfs),320k(overlay),64k(sysconfig),4k(ubootconfig),4k(fwdiag),4k(caliberation),-(res)" if ( UBOOT_CONFIG_BOOT_FROM_NOR && UBOOT_CONFIG_NOR_FLASH_8M && UBOOT_CONFIG_FIRMWARE_IN_ROOTFS && UBOOT_CONFIG_OVERLAY )
  default "ifx_sflash:128k(uboot),192k(firmware),-(rootfs)" if ( UBOOT_CONFIG_BOOT_FROM_SPI && UBOOT_CONFIG_SPI_FLASH_1M && !UBOOT_CONFIG_FIRMWARE_IN_ROOTFS )
	default "ifx_sflash:128k(uboot),192k(firmware),7744k(rootfs),64k(sysconfig),4k(ubootconfig),4k(fwdiag),4k(caliberation),-(res)" if ( UBOOT_CONFIG_BOOT_FROM_SPI && UBOOT_CONFIG_SPI_FLASH_8M && !UBOOT_CONFIG_FIRMWARE_IN_ROOTFS )
	default "ifx_sflash:128k(uboot),-(rootfs)" if ( UBOOT_CONFIG_BOOT_FROM_SPI && UBOOT_CONFIG_FIRMWARE_IN_ROOTFS )
	default "ifx_nand:128k(uboot),2688k(kernel),28800k(rootfs),64k(sysconfig),16k(ubootconfig),16k(fwdiag),-(res)" if ( UBOOT_CONFIG_BOOT_FROM_NAND && UBOOT_CONFIG_FIRMWARE_IN_ROOTFS )
	default "ifx_nand:128k(uboot),192k(firmware),-(rootfs)" if ( UBOOT_CONFIG_BOOT_FROM_NAND && !UBOOT_CONFIG_FIRMWARE_IN_ROOTFS )
	default "ifx_nor0:64k(uboot),-(rootfs)" if ( UBOOT_CONFIG_BOOT_FROM_UART )
	default "" if ( UBOOT_CONFIG_NOR_FLASH_AUTO )
	depends on UBOOT_CONFIG_USE_DEFAULT_MTDPARTS
endif



if LANTIQ_UBOOT_vr9
config UBOOT_CONFIG_MTDPARTS
    string "mtdparts"

#	default "ifx_nor0:128k(uboot),-(rootfs)" if ( UBOOT_CONFIG_BOOT_FROM_NOR && UBOOT_CONFIG_FIRMWARE_IN_ROOTFS && !UBOOT_CONFIG_NOR_FLASH_32M && !UBOOT_CONFIG_NOR_FLASH_16M  )
#	default "ifx_nor0:128k(uboot),512k(firmware),-(rootfs)" if ( UBOOT_CONFIG_BOOT_FROM_NOR && !UBOOT_CONFIG_FIRMWARE_IN_ROOTFS )
#	default "ifx_nor0:128k(uboot),13184k(rootfs),2m(kernel),768k(sysconfig),128k(ubootconfig),128k(fwdiag)" if ( UBOOT_CONFIG_BOOT_FROM_NOR && !UBOOT_CONFIG_NAND_FLASH && UBOOT_CONFIG_FIRMWARE_IN_ROOTFS && UBOOT_CONFIG_NOR_FLASH_16M && !UBOOT_CONFIG_IN_SUPERTASK )
#	default "ifx_nor0:256k(uboot),13056k(rootfs),2m(kernel),768k(sysconfig),128k(ubootconfig),128k(fwdiag)" if ( UBOOT_CONFIG_BOOT_FROM_NOR && UBOOT_CONFIG_NAND_FLASH && UBOOT_CONFIG_FIRMWARE_IN_ROOTFS && UBOOT_CONFIG_NOR_FLASH_16M && !UBOOT_CONFIG_IN_SUPERTASK )
#	default "ifx_nor0:128k(uboot),8448k(supertask1),128k(uboot-bin),7296k(rootfs),128k(linux-cfg),256k(supertask2)" if ( UBOOT_CONFIG_BOOT_FROM_NOR && UBOOT_CONFIG_FIRMWARE_IN_ROOTFS && UBOOT_CONFIG_NOR_FLASH_16M && UBOOT_CONFIG_IN_SUPERTASK )
#	default "ifx_nor0:128k(uboot),29568k(rootfs),2m(kernel),768k(sysconfig),128k(ubootconfig),128k(fwdiag)" if ( UBOOT_CONFIG_BOOT_FROM_NOR && !UBOOT_CONFIG_NAND_FLASH && UBOOT_CONFIG_FIRMWARE_IN_ROOTFS && UBOOT_CONFIG_NOR_FLASH_32M && !UBOOT_CONFIG_IN_SUPERTASK )
#	default "ifx_nor0:256k(uboot),29448k(rootfs),2m(kernel),768k(sysconfig),128k(ubootconfig),128k(fwdiag)" if ( UBOOT_CONFIG_BOOT_FROM_NOR && UBOOT_CONFIG_NAND_FLASH && UBOOT_CONFIG_FIRMWARE_IN_ROOTFS && UBOOT_CONFIG_NOR_FLASH_32M && !UBOOT_CONFIG_IN_SUPERTASK )
#	default "ifx_nor0:128k(uboot),8448k(supertask1),128k(uboot-bin),7296k(rootfs),128k(linux-cfg),16640k(supertask2)" if ( UBOOT_CONFIG_BOOT_FROM_NOR && UBOOT_CONFIG_FIRMWARE_IN_ROOTFS && UBOOT_CONFIG_NOR_FLASH_32M && UBOOT_CONFIG_IN_SUPERTASK )
#	default "ifx_sflash:192k(uboot),512k(firmware),-(rootfs)" if ( UBOOT_CONFIG_BOOT_FROM_SPI && !UBOOT_CONFIG_FIRMWARE_IN_ROOTFS )
#	default "ifx_sflash:192k(uboot),-(rootfs)" if ( UBOOT_CONFIG_BOOT_FROM_SPI && UBOOT_CONFIG_FIRMWARE_IN_ROOTFS )
#    default "ifx_nand:256k(uboot),-(rootfs)" if ( UBOOT_CONFIG_BOOT_FROM_NAND && UBOOT_CONFIG_FIRMWARE_IN_ROOTFS && ( ( !UBOOT_CONFIG_NAND_FLASH_32M && !UBOOT_CONFIG_NAND_FLASH_512M ) || !UBOOT_CONFIG_JFFS2_PART ) )
#    default "ifx_nand:256k(uboot),29440k(rootfs),2m(kernel),864k(sysconfig),48k(ubootconfig),48k(fwdiag),-(BBT)" if ( UBOOT_CONFIG_BOOT_FROM_NAND && UBOOT_CONFIG_FIRMWARE_IN_ROOTFS && UBOOT_CONFIG_NAND_FLASH_32M && UBOOT_CONFIG_JFFS2_PART )
#    default "ifx_nand:256k(uboot),517888k(rootfs),3m(kernel),1536k(sysconfig),256k(ubootconfig),256k(fwdiag),-(BBT)" if ( UBOOT_CONFIG_BOOT_FROM_NAND && UBOOT_CONFIG_FIRMWARE_IN_ROOTFS && UBOOT_CONFIG_NAND_FLASH_512M && UBOOT_CONFIG_JFFS2_PART )
#	default "ifx_nand:256k(uboot),512k(firmware),-(rootfs)" if ( UBOOT_CONFIG_BOOT_FROM_NAND && !UBOOT_CONFIG_FIRMWARE_IN_ROOTFS )
#    default "ifx_nand:9232k(uboot),3600k(rootfs),1600k(kernel),640k(sysconfig),224k(ubootconfig)" if ( UBOOT_CONFIG_BOOT_FROM_NAND && UBOOT_CONFIG_FIRMWARE_IN_ROOTFS && UBOOT_CONFIG_NAND_FLASH_32M && UBOOT_CONFIG_IN_SUPERTASK )
#	default "ifx_nor0:128k(uboot),-(rootfs)" if ( UBOOT_CONFIG_BOOT_FROM_UART )

        default "mtdparts=ifx_nand:256k(uboot),60m(rootfs),5m(kernel),1m(tmp1),2m(tmp2),1m(sysconfig),1m(ubootconfig),768k(fwdiag),3m(lcdimage),1m(mfgconfig),1m(sipdata),64m(voice),306m(misc),60m(rootfs2),5m(kernel2),1m(mystery)"
	depends on UBOOT_CONFIG_USE_DEFAULT_MTDPARTS

endif


if LANTIQ_UBOOT_ar10
config UBOOT_CONFIG_MTDPARTS
    string 
    default "ifx_nand:64k(uboot),-(rootfs)"
	depends on UBOOT_CONFIG_USE_DEFAULT_MTDPARTS
endif

config UBOOT_CONFIG_MTDPARTS
    string "MTDPARTS"
	default "ifx_nor0:128k(uboot),13184k(rootfs),2m(kernel),768k(sysconfig),128k(ubootconfig),128k(fwdiag)" if ( ( UBOOT_CONFIG_NOR_FLASH_16M || UBOOT_CONFIG_NOR_FLASH_32M ) && UBOOT_CONFIG_FIRMWARE_IN_ROOTFS )
	default "ifx_nor0:64k(uboot),-(rootfs)" if ( !UBOOT_CONFIG_NOR_FLASH_16M && !UBOOT_CONFIG_NOR_FLASH_32M || !UBOOT_CONFIG_FIRMWARE_IN_ROOTFS )
	depends on !UBOOT_CONFIG_USE_DEFAULT_MTDPARTS


config UBOOT_CONFIG_NET_RAM
    string "net_ram"
    default ""

config UBOOT_CONFIG_NET_FLASH
    string "net_flash"
    default ""

config UBOOT_CONFIG_FLASH_NFS
    string "flash_nfs"
    default ""

config UBOOT_CONFIG_NET_NFS
    string "net_nfs"
    default ""

config UBOOT_CONFIG_FLASH_FLASH
	string "flash_flash"
	default "run flashargs addip addmisc; bootm $(f_kernel_addr)" if ( !UBOOT_CONFIG_BOOT_FROM_NAND )
	default "nand read.e $(loadaddr) $(part2_begin) 190000 ; run flashargs addip addmisc; bootm $(loadaddr)" if ( UBOOT_CONFIG_BOOT_FROM_NAND && UBOOT_CONFIG_FIRMWARE_IN_ROOTFS && UBOOT_CONFIG_NAND_FLASH_32M && UBOOT_CONFIG_IN_SUPERTASK )
	default "nand read.e $(loadaddr) $(f_kernel_addr) $(f_kernel_size); run flashargs addip addmisc; bootm $(loadaddr)" if ( UBOOT_CONFIG_BOOT_FROM_NAND )

config UBOOT_CONFIG_UPDATE_NANDBOOT
    string "update_nandboot"
	default ""
	depends on UBOOT_CONFIG_BOOT_FROM_NAND


if !UBOOT_CONFIG_BOOT_FROM_SPI || !UBOOT_CONFIG_SPI_FLASH_256K && !UBOOT_CONFIG_SPI_FLASH_512K

config UBOOT_CONFIG_ROOTFSMTD
    string "rootfsmtd"
	default "/dev/mtdblock2" if ( UBOOT_CONFIG_BOOT_FROM_NAND && UBOOT_CONFIG_FIRMWARE_IN_ROOTFS && UBOOT_CONFIG_NAND_FLASH_128M )
	default "/dev/mtdblock3" if ( UBOOT_CONFIG_BOOT_FROM_NAND && !UBOOT_CONFIG_FIRMWARE_IN_ROOTFS && UBOOT_CONFIG_NAND_FLASH_128M )
	default "/dev/mtdblock1" if ( UBOOT_CONFIG_BOOT_FROM_NOR && UBOOT_CONFIG_FIRMWARE_IN_ROOTFS && !UBOOT_CONFIG_IN_SUPERTASK )
	default "/dev/mtdblock3" if ( UBOOT_CONFIG_BOOT_FROM_NOR && UBOOT_CONFIG_FIRMWARE_IN_ROOTFS && UBOOT_CONFIG_IN_SUPERTASK )
	default "/dev/mtdblock2" if ( UBOOT_CONFIG_BOOT_FROM_NOR && !UBOOT_CONFIG_FIRMWARE_IN_ROOTFS )
	default "/dev/mtdblock2" if ( UBOOT_CONFIG_BOOT_FROM_SPI && !UBOOT_CONFIG_FIRMWARE_IN_ROOTFS )

config UBOOT_CONFIG_FIRMWARE
    string "firmware"
    default "firmware.img"

config UBOOT_CONFIG_FULLIMAGE
    string "fullimage"
	default "fullimage.img"

config UBOOT_CONFIG_TOTALIMAGE
    string "totalimage"
	default "totalimage.img"

config UBOOT_CONFIG_U_BOOT
    string "u-boot"
    default "u-boot.ifx"

config UBOOT_CONFIG_U_BOOT_BIN
    string "u-boot-bin"
	depends on PACKAGE_open_uboot_KPN || PACKAGE_open_uboot_DT_921
    default "u-boot.bin"

config UBOOT_CONFIG_JFFS2_PART
    bool "writable JFFS2 partition support"
	depends on UBOOT_CONFIG_NAND_FLASH_32M || UBOOT_CONFIG_NAND_FLASH_512M
    default n

config UBOOT_CONFIG_ROOTFS
    string "rootfs"
    default "rootfs.img" if ( !UBOOT_CONFIG_JFFS2_PART || ( !UBOOT_CONFIG_NAND_FLASH_32M && !UBOOT_CONFIG_NAND_FLASH_512M ) )
    default "root.jffs2-16k.nand" if ( UBOOT_CONFIG_JFFS2_PART && UBOOT_CONFIG_NAND_FLASH_32M )
    default "root.jffs2-256k.nand" if ( UBOOT_CONFIG_JFFS2_PART && UBOOT_CONFIG_NAND_FLASH_512M )

config UBOOT_CONFIG_SYSCFG
    string "sysconfig"
	depends on UBOOT_CONFIG_JFFS2_PART && ( UBOOT_CONFIG_NAND_FLASH_32M || UBOOT_CONFIG_NAND_FLASH_512M )
    default "sysconfig.jffs2-16k.nand" if ( UBOOT_CONFIG_JFFS2_PART && UBOOT_CONFIG_NAND_FLASH_32M )
    default "sysconfig.jffs2-256k.nand" if ( UBOOT_CONFIG_JFFS2_PART && UBOOT_CONFIG_NAND_FLASH_512M )

config UBOOT_CONFIG_USE_DEFAULT_MTDPARTS
    bool "use default MTDPARTS"
	default y

config UBOOT_CONFIG_JFFS2IMAGE
    string "jffs2image"
	default "root.jffs2-128k.nor" if ( UBOOT_CONFIG_BOOT_FROM_NOR &&  ( UBOOT_CONFIG_NOR_FLASH_16M || UBOOT_CONFIG_NOR_FLASH_32M ) )
	default "root.jffs2-64k.nor"  if ( UBOOT_CONFIG_BOOT_FROM_NOR && !( UBOOT_CONFIG_NOR_FLASH_16M || UBOOT_CONFIG_NOR_FLASH_32M ) )
	default "root.jffs2-128k.nand" if ( UBOOT_CONFIG_BOOT_FROM_NAND )

config UBOOT_CONFIG_UPDATE_UBOOT
    string "update_uboot"
    default "tftpboot $(loadaddr) $(tftppath)$(u-boot); erase b0000000 +20000;cp.b $(loadaddr) b0000000 $(filesize); reset" if ( !UBOOT_CONFIG_NAND_FLASH )
    default "tftpboot $(loadaddr) $(tftppath)$(u-boot); erase b0000000 +30000;cp.b $(loadaddr) b0000000 $(filesize); reset" if ( UBOOT_CONFIG_BOOT_FROM_NOR && UBOOT_CONFIG_NAND_FLASH )
    default "tftpboot $(loadaddr) $(tftppath)$(u-boot); nand erase $(f_uboot_addr) $(f_uboot_size); nand write $(loadaddr) $(f_uboot_addr) $(filesize)" if ( UBOOT_CONFIG_BOOT_FROM_NAND )

config UBOOT_CONFIG_UPDATE_UBOOT_BIN
    string "update_uboot_bin"
    default "tftpboot $(loadaddr) $(tftppath)$(u-boot-bin); erase b0870000 b088ffff; cp.b $(loadaddr) b0870000 $(filesize); reset"
	depends on UBOOT_CONFIG_U_BOOT_BIN

config UBOOT_CONFIG_UPDATE_KERNEL
	string "update_kernel"
	default "tftpboot $(loadaddr) $(tftppath)$(bootfile); upgrade $(loadaddr) $(filesize)" if ( !UBOOT_CONFIG_BOOT_FROM_NAND )
	default "tftpboot $(loadaddr) $(tftppath)$(bootfile); nand erase $(part2_begin) 190000; nand write.fw $(loadaddr) $(part2_begin) $(filesize)" if ( UBOOT_CONFIG_BOOT_FROM_NAND && UBOOT_CONFIG_FIRMWARE_IN_ROOTFS && UBOOT_CONFIG_NAND_FLASH_32M && UBOOT_CONFIG_IN_SUPERTASK )
	default "tftpboot $(loadaddr) $(tftppath)$(bootfile); nand erase $(f_kernel_addr) $(f_kernel_size); nand write.e $(loadaddr) $(f_kernel_addr) $(filesize)" if ( UBOOT_CONFIG_BOOT_FROM_NAND )

config UBOOT_CONFIG_UPDATE_ROOTFS
	string "update_rootfs"
	default "tftpboot $(loadaddr) $(tftppath)$(rootfs); upgrade $(loadaddr) $(filesize)" if ( !UBOOT_CONFIG_BOOT_FROM_NAND )
	default "tftpboot 80800000 $(tftppath)$(rootfs); nand erase $(f_rootfs_addr) 384000; nand write.fw 80800040 $(f_rootfs_addr) $(filesize)" if ( UBOOT_CONFIG_BOOT_FROM_NAND && UBOOT_CONFIG_FIRMWARE_IN_ROOTFS && UBOOT_CONFIG_NAND_FLASH_32M && UBOOT_CONFIG_IN_SUPERTASK )
	default "tftpboot $(loadaddr) $(tftppath)$(rootfs); nand erase $(f_rootfs_addr) $(f_rootfs_size); cal $(loadaddr) 40 loadaddr; cal $(filesize) -40 filesize; nand write.e $(loadaddr) $(f_rootfs_addr) $(filesize); cal $(loadaddr) -40 loadaddr" if ( UBOOT_CONFIG_BOOT_FROM_NAND )

config UBOOT_CONFIG_UPDATE_ALL
	string "update_all"
	default "run update_kernel; run update_rootfs"

config UBOOT_CONFIG_UPDATE_FIRMWARE
    string "update_firmware"
    default ""

config UBOOT_CONFIG_UPDATE_FULLIMAGE
    string "update_fullimage"
	default ""

config UBOOT_CONFIG_UPDATE_TOTALIMAGE
    string "update_totalimage"
	default ""

config UBOOT_CONFIG_UPDATE_JFFS2IMAGE
    string "update_jffs2image"
	default "tftpboot $(loadaddr) $(tftppath)$(jffs2image); erase $(f_rootfs_addr) $(f_rootfs_size); upgrade $(loadaddr) $(filesize)"  if ( UBOOT_CONFIG_BOOT_FROM_NOR && UBOOT_CONFIG_NOR_FLASH_8M  )
	default "tftpboot $(loadaddr) $(tftppath)$(jffs2image); erase $(f_rootfs_addr) +$(f_rootfs_size); upgrade $(loadaddr) $(filesize)"  if ( UBOOT_CONFIG_BOOT_FROM_NOR && UBOOT_CONFIG_NOR_FLASH_16M )
	default "tftpboot $(loadaddr) $(tftppath)$(jffs2image); erase $(f_rootfs_addr) +$(f_rootfs_size); upgrade $(loadaddr) $(filesize)"  if ( UBOOT_CONFIG_BOOT_FROM_NOR && UBOOT_CONFIG_NOR_FLASH_32M )
	default "tftpboot $(loadaddr) $(tftppath)$(jffs2image); nand erase $(f_rootfs_addr) $(f_rootfs_size); cal $(loadaddr) 40 loadaddr; cal $(filesize) -40 filesize; nand write.e $(loadaddr) $(f_rootfs_addr) $(filesize); cal $(loadaddr) -40 loadaddr"  if ( UBOOT_CONFIG_BOOT_FROM_NAND )

config UBOOT_CONFIG_UPDATE_FLASH
    string "update_flash"
	default "tftp $(loadaddr) flash3.img; protect off b1000000 +800000; erase b1000000 +800000; cp.b $(loadaddr) b1000000 800000;  tftp $(loadaddr) flash2.img; protect off b0800000 +800000; erase b0800000 +800000; cp.b $(loadaddr) b0800000 800000;  tftp $(loadaddr) flash4.img; protect off b1800000 +800000; erase b1800000 +800000; cp.b $(loadaddr) b1800000 800000;  tftp $(loadaddr) flash1.img; protect off b0000000 +800000; erase b0000000 +800000; cp.b $(loadaddr) b0000000 800000"  if ( UBOOT_CONFIG_BOOT_FROM_NOR && UBOOT_CONFIG_NOR_FLASH_32M )
	default "tftp $(loadaddr) flash2.img; protect off b0800000 +800000; erase b0800000 +800000; cp.b $(loadaddr) b0800000 800000;  tftp $(loadaddr) flash1.img; protect off b0000000 +800000; erase b0000000 +800000; cp.b $(loadaddr) b0000000 800000"  if ( UBOOT_CONFIG_BOOT_FROM_NOR && UBOOT_CONFIG_NOR_FLASH_16M )
	default "tftp $(loadaddr) flash.img; protect off b0000000 +$(filesize); erase b0000000 +$(filesize); cp.b $(loadaddr) b0000000 $(filesize)"  if ( UBOOT_CONFIG_BOOT_FROM_NOR && !UBOOT_CONFIG_NOR_FLASH_16M && !UBOOT_CONFIG_NOR_FLASH_32M )

config UBOOT_CONFIG_UPDATE_SYSCONFIG
	string "update_sysconfig"
	depends on UBOOT_CONFIG_NAND_FLASH_32M || UBOOT_CONFIG_NAND_FLASH_512M
	default "tftpboot $(loadaddr) $(tftppath)$(sysconfig); nand erase $(f_sysconfig_addr) $(f_sysconfig_size); nand write.partial $(loadaddr) $(f_sysconfig_addr) $(filesize)"

config UBOOT_CONFIG_UPDATE_KERNEL2
	string "update_kernel2"
	depends on UBOOT_CONFIG_DUAL_IMAGE
	default  "tftpboot $(loadaddr) $(tftppath)$(bootfile); nand erase $(f_kernel2_addr) $(f_kernel2_size); nand write.e $(loadaddr) $(f_kernel2_addr) $(filesize)"

config UBOOT_CONFIG_UPDATE_ROOTFS2
	string  "update_rootfs2"
	depends on UBOOT_CONFIG_DUAL_IMAGE
	default	"tftpboot $(loadaddr) $(tftppath)$(rootfs); nand erase $(f_rootfs2_addr) $(f_rootfs2_size); cal $(loadaddr) 40 loadaddr; cal $(filesize) -40 filesize; nand write.e $(loadaddr) $(f_rootfs2_addr) $(filesize); cal $(loadaddr) -40 loadaddr"

config UBOOT_CONFIG_UPDATE_JFFS2IMAGE2
	string
	depends on UBOOT_CONFIG_DUAL_IMAGE
	default "tftpboot $(loadaddr) $(tftppath)$(jffs2image); nand erase $(f_rootfs2_addr) $(f_rootfs2_size); cal $(loadaddr) 40 loadaddr; cal $(filesize) -40 filesize; nand write.e $(loadaddr) $(f_rootfs2_addr) $(filesize); cal $(loadaddr) -40 loadaddr"

config UBOOT_CONFIG_UPDATE_ALL2
	string "upadte_all2"
	depends on UBOOT_CONFIG_DUAL_IMAGE
	default "run update_kernel2; run update_rootfs2"

config UBOOT_CONFIG_UPDATE_DUAL
	string "update_dual"
	depends on UBOOT_CONFIG_DUAL_IMAGE
	default "run update_kernel; run update_rootfs; run update_kernel2; run update_rootfs2"
endif

if UBOOT_CONFIG_BOOT_FROM_SPI && ( UBOOT_CONFIG_SPI_FLASH_256K || UBOOT_CONFIG_SPI_FLASH_512K )

config UBOOT_CONFIG_ROOTFSMTD
    string "rootfsmtd"
	default "/dev/mtdblock1"

config UBOOT_CONFIG_U_BOOT
    string "u-boot"
    default "u-boot.sflash"

config UBOOT_CONFIG_ROOTFS
    string "rootfs"
    default "rootfs.img"

config UBOOT_CONFIG_JFFS2IMAGE
    string "jffs2image"
	default "root.jffs2-16k.nand"

config UBOOT_CONFIG_UPDATE_UBOOT
    string "update_uboot"
	default "tftpboot $(loadaddr) $(tftppath)$(u-boot); sf erase 0 40000; sf write $(loadaddr) 0 $(filesize); reset" if ( UBOOT_CONFIG_SPI_FLASH_256K )
	default "tftpboot $(loadaddr) $(tftppath)$(u-boot); sf erase 0 80000; sf write $(loadaddr) 0 $(filesize); reset" if ( UBOOT_CONFIG_SPI_FLASH_512K )

config UBOOT_CONFIG_UPDATE_KERNEL
    string "update_kernel"
    default "tftpboot $(loadaddr) $(tftppath)$(bootfile); nand erase $(f_kernel_addr) $(f_kernel_size); nand write $(loadaddr) $(f_kernel_addr) $(f_kernel_size)"

config UBOOT_CONFIG_UPDATE_ROOTFS
    string "update_rootfs"
    default "tftpboot $(loadaddr) $(tftppath)$(jffs2image); nand erase $(f_rootfs_addr) $(f_rootfs_size); nand write.jffs2 $(loadaddr) $(f_rootfs_addr) $(filesize)"

config UBOOT_CONFIG_UPDATE_FLASH
    string "update_flash"
	default "nand erase; tftp $(loadaddr) part0.img; nand write $(loadaddr) f_$(data_block0)_addr $(filesize); tftp $(loadaddr) part1.img; nand write $(loadaddr) f_$(data_block1)_addr $(filesize); tftp $(loadaddr) part2.img; nand write $(loadaddr) f_$(data_block2)_addr $(filesize); tftp $(loadaddr) part3.img; nand write $(loadaddr) f_$(data_block3)_addr $(filesize); tftp $(loadaddr) part4.img; nand write $(loadaddr) f_$(data_block4)_addr $(filesize); tftp $(loadaddr) part5.img; nand write $(loadaddr) f_$(data_block5)_addr $(filesize); tftp $(loadaddr) part6.img; nand write $(loadaddr) f_$(data_block6)_addr $(filesize)"

endif

config UBOOT_CONFIG_BOOTCOMMAND
    string "bootcmd"
	default "run flash_flash$(bootid)"

config UBOOT_CONFIG_RESET_UBOOT_CONFIG
	string "reset_uboot_config"
	default "prot off $(f_ubootconfig_addr) $(f_ubootconfig_end); erase $(f_ubootconfig_addr) $(f_ubootconfig_end)" if ( UBOOT_CONFIG_BOOT_FROM_NOR )
	default "sf probe 3; sf write 80400000 $(f_ubootconfig_addr) $(f_ubootconfig_size)"  if ( UBOOT_CONFIG_BOOT_FROM_SPI && UBOOT_CONFIG_LANTIQ_UBOOT_ar9 ) 
	default "sf probe 0; sf write 80400000 $(f_ubootconfig_addr) $(f_ubootconfig_size)"  if ( UBOOT_CONFIG_BOOT_FROM_SPI && UBOOT_CONFIG_LANTIQ_UBOOT_amazon_se )
	default "sf probe 3; sf write 80400000 $(f_ubootconfig_addr) $(f_ubootconfig_size)"  if ( UBOOT_CONFIG_BOOT_FROM_SPI && UBOOT_CONFIG_LANTIQ_UBOOT_vr9 )
	default "sf probe 3; sf write 80400000 $(f_ubootconfig_addr) $(f_ubootconfig_size)"  if ( UBOOT_CONFIG_BOOT_FROM_SPI && UBOOT_CONFIG_LANTIQ_UBOOT_ar10 )
	default "nand write.e 80400000 $(f_ubootconfig_addr) $(f_ubootconfig_size)" if ( UBOOT_CONFIG_BOOT_FROM_NAND )

config UBOOT_CONFIG_RESET_DDR_CONFIG
    string "reset_ddr_config"
	default "prot off $(f_ddrconfig_addr) $(f_ddrconfig_end); erase $(f_ddrconfig_addr) $(f_ddrconfig_end)" if ( UBOOT_CONFIG_BOOT_FROM_NOR )
    default "sf probe 3; sf write 80400000 $(f_ddrconfig_addr) $(f_ddrconfig_size)"  if ( UBOOT_CONFIG_BOOT_FROM_SPI && UBOOT_CONFIG_LANTIQ_UBOOT_ar9 )
    default "sf probe 0; sf write 80400000 $(f_ddrconfig_addr) $(f_ddrconfig_size)"  if ( UBOOT_CONFIG_BOOT_FROM_SPI && UBOOT_CONFIG_LANTIQ_UBOOT_amazon_se	)
    default "sf probe 3; sf write 80400000 $(f_ddrconfig_addr) $(f_ddrconfig_size)"  if ( UBOOT_CONFIG_BOOT_FROM_SPI && UBOOT_CONFIG_LANTIQ_UBOOT_vr9 )
    default "sf probe 3; sf write 80400000 $(f_ddrconfig_addr) $(f_ddrconfig_size)"  if ( UBOOT_CONFIG_BOOT_FROM_SPI && UBOOT_CONFIG_LANTIQ_UBOOT_ar10 )
	default "nand write.partial 80400000 $(f_ddrconfig_addr) $(f_ddrconfig_size)" if ( UBOOT_CONFIG_BOOT_FROM_NAND )

config UBOOT_CONFIG_SW_VERSION
    string "sw_version"
	default "AT904X-03.10-arny1"

config UBOOT_CONFIG_HW_VERSION
    string "hw_version"
	default "VR9"

config UBOOT_CONFIG_SERIAL
    string "serial"
	default "00000000"

if UBOOT_CONFIG_DUAL_IMAGE

config UBOOT_CONFIG_ROOTFSMTD2
    string "rootmtd2"
	default "/dev/mtdblock13"

config UBOOT_CONFIG_FLASHARGS2
    string "flashargs2"
    default "setenv bootargs root=$(rootfsmtd2) rw rootfstype=squashfs,jffs2 init=/etc/preinit"

config UBOOT_CONFIG_FLASH_FLASH2
	string "flash_flash2"
	default "run flashargs2 addip addmisc; bootm $(f_kernel2_addr)" if ( !UBOOT_CONFIG_BOOT_FROM_NAND )
	default "nand read.e $(loadaddr) $(f_kernel2_addr) $(f_kernel2_size); run flashargs2 addip addmisc; bootm $(loadaddr)" if ( UBOOT_CONFIG_BOOT_FROM_NAND )

endif

endmenu

source ../lib/Kconfig
source ../common/Kconfig
```
