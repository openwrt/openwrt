## package/boot/uboot-lantiq-easybox904xdsl/config/board/ar10/Kconfig
```kconfig
config UBOOT_CONFIG_DRIVER_AR10
      bool
	  default y

config UBOOT_CONFIG_BOARD_NAME
    string 
	default "EASY80920"
	depends on UBOOT_CONFIG_IFX_IMAGE_EXTRA_CHECKS

config UBOOT_CONFIG_BOARD_VERSION
    string
	default "1.2"
	depends on UBOOT_CONFIG_IFX_IMAGE_EXTRA_CHECKS

config UBOOT_CONFIG_CHIP_NAME
    string
    default "XRX200"
    depends on UBOOT_CONFIG_IFX_IMAGE_EXTRA_CHECKS

config UBOOT_CONFIG_CHIP_VERSION
    string
    default "1.2"
    depends on UBOOT_CONFIG_IFX_IMAGE_EXTRA_CHECKS

		

menu "CPU/DDR FREQUENCY"


choice 
    prompt "DDR TYPE SELECTION"
    default UBOOT_CONFIG_AR10_DDR2

config UBOOT_CONFIG_AR10_DDR1
    bool "DDR1"

config UBOOT_CONFIG_AR10_DDR2
    bool "DDR2"

endchoice

choice
    prompt "CPU AND RAM CONFIGURATION"

config UBOOT_CONFIG_AR10_CPU_125M_RAM_125M
    bool "125M/125M"
    select UBOOT_CONFIG_AR10_SYS_CLOCK_500M

config UBOOT_CONFIG_AR10_CPU_250M_RAM_125M
    bool "250M/125M" 
    select UBOOT_CONFIG_AR10_SYS_CLOCK_500M

config UBOOT_CONFIG_AR10_CPU_250M_RAM_250M
    bool "250M/250M"
    select UBOOT_CONFIG_AR10_SYS_CLOCK_500M
   
config UBOOT_CONFIG_AR10_CPU_500M_RAM_250M
    bool "500M/250M"
    select UBOOT_CONFIG_AR10_SYS_CLOCK_500M

config UBOOT_CONFIG_AR10_CPU_150M_RAM_150M
    bool "150M/150M"
    select UBOOT_CONFIG_AR10_SYS_CLOCK_600M

config UBOOT_CONFIG_AR10_CPU_300M_RAM_150M
    bool "300M/150M"
	select UBOOT_CONFIG_AR10_SYS_CLOCK_600M

config UBOOT_CONFIG_AR10_CPU_300M_RAM_300M
    bool "300M/300M"
	select UBOOT_CONFIG_AR10_SYS_CLOCK_600M
	
config UBOOT_CONFIG_AR10_CPU_600M_RAM_300M
    bool "600M/300M"
	select UBOOT_CONFIG_AR10_SYS_CLOCK_600M

endchoice

config UBOOT_CONFIG_AR10_SYS_CLOCK_500M
    bool

config UBOOT_CONFIG_AR10_SYS_CLOCK_600M
    bool
	
endmenu

	
menu "SWITCH OPTIONS"

config UBOOT_CONFIG_AR10_SW_PORT_0
    bool "USE PORT 0"

choice
   prompt "INTERFACE"
   depends on UBOOT_CONFIG_AR10_SW_PORT_0
   default UBOOT_CONFIG_AR10_SW_PORT0_RGMII_MAC

config UBOOT_CONFIG_AR10_SW_PORT0_MII_PHY
   bool "MII PHY"

config UBOOT_CONFIG_AR10_SW_PORT0_MII_MAC
   bool "MII MAC"

config UBOOT_CONFIG_AR10_SW_PORT0_RMII_PHY
   bool "RMII PHY"

config UBOOT_CONFIG_AR10_SW_PORT0_RMII_MAC
   bool "RMII MAC"

config UBOOT_CONFIG_AR10_SW_PORT0_RGMII_MAC
   bool "RGMII MAC"

endchoice  

config UBOOT_CONFIG_AR10_SW_PORT0_MIIMODE
   int
   depends on UBOOT_CONFIG_AR10_SW_PORT_0
   default 0 if UBOOT_CONFIG_AR10_SW_PORT0_MII_PHY
   default 1 if UBOOT_CONFIG_AR10_SW_PORT0_MII_MAC
   default 2 if UBOOT_CONFIG_AR10_SW_PORT0_RMII_PHY
   default 3 if UBOOT_CONFIG_AR10_SW_PORT0_RMII_MAC
   default 4 if UBOOT_CONFIG_AR10_SW_PORT0_RGMII_MAC

   
choice
   prompt "xMII CLOCK RATE"
   depends on UBOOT_CONFIG_AR10_SW_PORT_0
   default UBOOT_CONFIG_AR10_SW_PORT0_MIIRATE_AUTO
	
config UBOOT_CONFIG_AR10_SW_PORT0_MIIRATE_M2P5
	 bool "2.5MHz"
	 depends on !UBOOT_CONFIG_AR10_SW_PORT0_RMII_MAC && !UBOOT_CONFIG_AR10_SW_PORT0_RMII_PHY
	
config UBOOT_CONFIG_AR10_SW_PORT0_MIIRATE_M25
    bool "25MHz"
    depends on !UBOOT_CONFIG_AR10_SW_PORT0_RMII_MAC && !UBOOT_CONFIG_AR10_SW_PORT0_RMII_PHY

config UBOOT_CONFIG_AR10_SW_PORT0_MIIRATE_M125
    bool "125MHz"
    depends on !UBOOT_CONFIG_AR10_SW_PORT0_RMII_MAC && !UBOOT_CONFIG_AR10_SW_PORT0_RMII_PHY

config UBOOT_CONFIG_AR10_SW_PORT0_MIIRATE_M50	
	  bool "50MHz"
	  
config UBOOT_CONFIG_AR10_SW_PORT0_MIIRATE_AUTO
    bool "AUTO"
    depends on !UBOOT_CONFIG_AR10_SW_PORT0_RMII_MAC && !UBOOT_CONFIG_AR10_SW_PORT0_RMII_PHY
		
endchoice

config UBOOT_CONFIG_AR10_SW_PORT0_MIIRATE
    int 
	depends on UBOOT_CONFIG_AR10_SW_PORT_0
	default 0 if UBOOT_CONFIG_AR10_SW_PORT0_MIIRATE_M2P5
	default 1 if UBOOT_CONFIG_AR10_SW_PORT0_MIIRATE_M25
	default 2 if UBOOT_CONFIG_AR10_SW_PORT0_MIIRATE_M125
	default 3 if UBOOT_CONFIG_AR10_SW_PORT0_MIIRATE_M50
	default 4 if UBOOT_CONFIG_AR10_SW_PORT0_MIIRATE_AUTO

choice 
    prompt "RMII REF CLOCK DIRECTIOM"
	  default UBOOT_CONFIG_AR10_SW_PORT0_RMII_CLK_IN
	  depends on UBOOT_CONFIG_AR10_SW_PORT0_RMII_PHY || UBOOT_CONFIG_AR10_SW_PORT0_RMII_MAC

config UBOOT_CONFIG_AR10_SW_PORT0_RMII_CLK_IN
    bool "IN"

config UBOOT_CONFIG_AR10_SW_PORT0_RMII_CLK_OUT
    bool "OUT"
	
endchoice


config UBOOT_CONFIG_AR10_SW_PORT_1
    bool "USE PORT 1"
    
choice
   prompt "INTERFACE"
   depends on UBOOT_CONFIG_AR10_SW_PORT_1
   default UBOOT_CONFIG_AR10_SW_PORT1_RGMII_MAC

config UBOOT_CONFIG_AR10_SW_PORT1_MII_PHY
   bool "MII PHY"

config UBOOT_CONFIG_AR10_SW_PORT1_MII_MAC
   bool "MII MAC"

config UBOOT_CONFIG_AR10_SW_PORT1_RMII_PHY
   bool "RMII PHY"

config UBOOT_CONFIG_AR10_SW_PORT1_RMII_MAC
   bool "RMII MAC"

config UBOOT_CONFIG_AR10_SW_PORT1_RGMII_MAC
   bool "RGMII MAC"
endchoice  

config UBOOT_CONFIG_AR10_SW_PORT1_MIIMODE
   int
   depends on UBOOT_CONFIG_AR10_SW_PORT_1
   default 0 if UBOOT_CONFIG_AR10_SW_PORT1_MII_PHY
   default 1 if UBOOT_CONFIG_AR10_SW_PORT1_MII_MAC
   default 2 if UBOOT_CONFIG_AR10_SW_PORT1_RMII_PHY
   default 3 if UBOOT_CONFIG_AR10_SW_PORT1_RMII_MAC
   default 4 if UBOOT_CONFIG_AR10_SW_PORT1_RGMII_MAC
								   
   
choice
   prompt "xMII CLOCK RATE"
   depends on UBOOT_CONFIG_AR10_SW_PORT_1
   default UBOOT_CONFIG_AR10_SW_PORT1_MIIRATE_AUTO
	
config UBOOT_CONFIG_AR10_SW_PORT1_MIIRATE_M2P5
	bool "2.5MHz"
	depends on !UBOOT_CONFIG_AR10_SW_PORT1_RMII_MAC && !UBOOT_CONFIG_AR10_SW_PORT1_RMII_PHY
	
config UBOOT_CONFIG_AR10_SW_PORT1_MIIRATE_M25
    bool "25MHz"
    depends on !UBOOT_CONFIG_AR10_SW_PORT1_RMII_MAC && !UBOOT_CONFIG_AR10_SW_PORT1_RMII_PHY

config UBOOT_CONFIG_AR10_SW_PORT1_MIIRATE_M125
    bool "125MHz"
    depends on !UBOOT_CONFIG_AR10_SW_PORT1_RMII_MAC && !UBOOT_CONFIG_AR10_SW_PORT1_RMII_PHY

config UBOOT_CONFIG_AR10_SW_PORT1_MIIRATE_M50	
	  bool "50MHz"

config UBOOT_CONFIG_AR10_SW_PORT1_MIIRATE_AUTO
    bool "AUTO"
		depends on !UBOOT_CONFIG_AR10_SW_PORT1_RMII_MAC && !UBOOT_CONFIG_AR10_SW_PORT1_RMII_PHY
		
endchoice

config UBOOT_CONFIG_AR10_SW_PORT1_MIIRATE
    int 
	depends on UBOOT_CONFIG_AR10_SW_PORT_1
	default 0 if UBOOT_CONFIG_AR10_SW_PORT1_MIIRATE_M2P5
	default 1 if UBOOT_CONFIG_AR10_SW_PORT1_MIIRATE_M25
	default 2 if UBOOT_CONFIG_AR10_SW_PORT1_MIIRATE_M125
	default 3 if UBOOT_CONFIG_AR10_SW_PORT1_MIIRATE_M50
	default 4 if UBOOT_CONFIG_AR10_SW_PORT1_MIIRATE_AUTO

choice 
    prompt "RMII REF CLOCK DIRECTIOM"
	  default UBOOT_CONFIG_AR10_SW_PORT1_RMII_CLK_IN
	  depends on UBOOT_CONFIG_AR10_SW_PORT1_RMII_MAC || UBOOT_CONFIG_AR10_SW_PORT1_RMII_PHY

config UBOOT_CONFIG_AR10_SW_PORT1_RMII_CLK_IN
    bool "IN"

config UBOOT_CONFIG_AR10_SW_PORT1_RMII_CLK_OUT
    bool "OUT"
	
endchoice

config UBOOT_CONFIG_AR10_SW_PORT_2
    bool "USE PORT 2"
    default y

choice
   prompt "INTERFACE FOR PORT 2 AND PORT4"
   depends on UBOOT_CONFIG_AR10_SW_PORT_2
   default UBOOT_CONFIG_AR10_SW_PORT2_GMII

config UBOOT_CONFIG_AR10_SW_PORT2_GMII
   bool "GMII"

config UBOOT_CONFIG_AR10_SW_PORT2_MII
   bool "MII"

endchoice  

config  UBOOT_CONFIG_AR10_SW_PORT2_MIIRATE
   int
   depends on UBOOT_CONFIG_AR10_SW_PORT_2
   default 4 
					 
config UBOOT_CONFIG_AR10_SW_PORT2_MIIMODE
    int
	depends on UBOOT_CONFIG_AR10_SW_PORT_2
	default 1 
								

config UBOOT_CONFIG_AR10_SW_PORT_3
    bool "USE PORT 3"
	default y
    depends on UBOOT_CONFIG_AR10_SW_PORT2_MII
    
choice
   prompt "INTERFACE"
   depends on UBOOT_CONFIG_AR10_SW_PORT_3
   default UBOOT_CONFIG_AR10_SW_PORT3_MII

config UBOOT_CONFIG_AR10_SW_PORT3_MII
   bool "MII"

endchoice    
    
config UBOOT_CONFIG_AR10_SW_PORT3_MIIRATE
   int
   depends on UBOOT_CONFIG_AR10_SW_PORT_3
   default 4 
					 
config UBOOT_CONFIG_AR10_SW_PORT3_MIIMODE
    int
	depends on UBOOT_CONFIG_AR10_SW_PORT_3
    default 1 if UBOOT_CONFIG_AR10_SW_PORT3_MII

config UBOOT_CONFIG_AR10_SW_PORT_4
    bool "USE PORT 4"
	default y
	depends on UBOOT_CONFIG_AR10_SW_PORT_2

config UBOOT_CONFIG_AR10_SW_PORT4_GMII
   bool  
   default y
   depends on UBOOT_CONFIG_AR10_SW_PORT2_GMII

config UBOOT_CONFIG_AR10_SW_PORT4_MII
   bool
   default y
   depends on UBOOT_CONFIG_AR10_SW_PORT2_MII


config UBOOT_CONFIG_AR10_SW_PORT4_MIIRATE
   int
   depends on UBOOT_CONFIG_AR10_SW_PORT_4
   default 4
					 
config UBOOT_CONFIG_AR10_SW_PORT4_MIIMODE
    int
	depends on UBOOT_CONFIG_AR10_SW_PORT_4
	default 1 
	

config UBOOT_CONFIG_AR10_SW_PORT_5a
    bool "USE PORT 5a"
	default y
    depends on !UBOOT_CONFIG_AR10_SW_PORT_5b

choice
   prompt "INTERFACE"
   depends on UBOOT_CONFIG_AR10_SW_PORT_5a
   default UBOOT_CONFIG_AR10_SW_PORT5a_RGMII

config UBOOT_CONFIG_AR10_SW_PORT5a_RGMII
   bool "RGMII"
endchoice

config UBOOT_CONFIG_AR10_SW_PORT5a_MIIMODE
   int
   depends on UBOOT_CONFIG_AR10_SW_PORT_5a
   default 4

config UBOOT_CONFIG_AR10_SW_PORT5a_MIIRATE
    int
	depends on UBOOT_CONFIG_AR10_SW_PORT_5a
	default 4 if UBOOT_CONFIG_AR10_SW_PORT5a_RGMII
			

config UBOOT_CONFIG_AR10_SW_PORT_5b
    bool "USE PORT 5b"
	default y
    depends on UBOOT_CONFIG_AR10_SW_PORT2_MII
    
choice
   prompt "INTERFACE"
   depends on UBOOT_CONFIG_AR10_SW_PORT_5b
   default UBOOT_CONFIG_AR10_SW_PORT5b_MII

config UBOOT_CONFIG_AR10_SW_PORT5b_MII
   bool "MII"

endchoice       

config UBOOT_CONFIG_AR10_SW_PORT5b_MIIMODE
   int
   depends on UBOOT_CONFIG_AR10_SW_PORT_5b
   default 1 

config UBOOT_CONFIG_AR10_SW_PORT5b_MIIRATE
    int
	depends on UBOOT_CONFIG_AR10_SW_PORT_5b
	default 4

config UBOOT_CONFIG_AR10_GPHY_FW_ADDR
    hex 
	default "0xb0010000" if ( UBOOT_CONFIG_BOOT_FROM_NOR )
	default "0xa0110000" if ( UBOOT_CONFIG_BOOT_FROM_SPI )
	default "0xa0110000" if ( UBOOT_CONFIG_BOOT_FROM_NAND )
	depends on UBOOT_CONFIG_AR10_SW_PORT_2 || UBOOT_CONFIG_AR10_SW_PORT_3 || UBOOT_CONFIG_AR10_SW_PORT_4 || UBOOT_CONFIG_AR10_SW_PORT_5b

config UBOOT_CONFIG_AR10_GPHY_DEBUG
    bool "DEBUG GPHY"
	default y
    depends on !UBOOT_CONFIG_NAND_FLASH
	
endmenu


config UBOOT_CONFIG_TUNE_DDR
    bool "DDR tuning support"
    default y

config UBOOT_CONFIG_DDR_TUNING_TEXT_BASE
    hex
    default "0xbe1a0000"
    depends on UBOOT_CONFIG_TUNE_DDR
```

## package/boot/uboot-lantiq-easybox904xdsl/config/board/danube/Kconfig
```kconfig
#
# For a description of the syntax of this configuration file,
# see Linux Documentation
#
#

config UBOOT_CONFIG_DRIVER_DANUBE
      bool
      default y

config UBOOT_CONFIG_BOARD_NAME
    string
	default "EASY50712"
	depends on UBOOT_CONFIG_IFX_IMAGE_EXTRA_CHECKS

config UBOOT_CONFIG_BOARD_VERSION
    string
    default "1.26"
    depends on UBOOT_CONFIG_IFX_IMAGE_EXTRA_CHECKS

config UBOOT_CONFIG_CHIP_NAME
    string
    default "DANUBE"
    depends on UBOOT_CONFIG_IFX_IMAGE_EXTRA_CHECKS

config UBOOT_CONFIG_CHIP_VERSION
    string
    default "1.2"
    depends on UBOOT_CONFIG_IFX_IMAGE_EXTRA_CHECKS

choice
    prompt 'RAM BRAND'
	    default UBOOT_CONFIG_DANUBE_ETRON_RAM

    config UBOOT_CONFIG_DANUBE_QIMONDA_RAM
	    bool "QIMONDA"

	config UBOOT_CONFIG_DANUBE_ETRON_RAM
	    bool "ETRON"

	config UBOOT_CONFIG_DANUBE_PROMOS_RAM
	    bool "PROMOS"

	config UBOOT_CONFIG_DANUBE_PSC_RAM	
	    bool "PSC"

    config UBOOT_CONFIG_DANUBE_SAMSUNG_RAM
	    bool "SAMSUNG"

endchoice
					


config UBOOT_CONFIG_TUNE_DDR
    bool "DDR tuning support"
	default y

config UBOOT_CONFIG_DDR_TUNING_TEXT_BASE
    hex 
        default "0x9e1a0000"
    depends on UBOOT_CONFIG_TUNE_DDR
```
