## package/base-files/Config.in
```kconfig
config PACKAGE_LIBGCC
	prompt "libgcc............................ GCC support library"
	tristate
	default m if DEVEL
	help
	  GCC support library
```

## package/bcm43xx-mac80211/src/bcm43xx/Kconfig
```kconfig
config BCM43XX_MAC80211
	tristate "Broadcom BCM43xx wireless support (mac80211 stack)"
	depends on MAC80211 && WLAN_80211 && EXPERIMENTAL
	select FW_LOADER
	select SSB
	select HW_RANDOM
	---help---
	  This is an experimental driver for the Broadcom 43xx wireless chip,
	  found in the Apple Airport Extreme and various other devices.

config BCM43XX_MAC80211_PCI
	bool "BCM43xx PCI device support"
	depends on BCM43XX_MAC80211 && PCI
	select SSB_PCIHOST
	select SSB_DRIVER_PCICORE
	default y
	---help---
	  Broadcom 43xx PCI device support.

	  Say Y, if you have a BCM43xx device connected through the PCI bus.
	  Please note that most PC-CARD devices are (to the kernel) PCI devices,
	  too and not PCMCIA.
	  It's safe to select Y here, even if you don't have a BCM43xx PCI device.

config BCM43XX_MAC80211_PCMCIA
	bool "BCM43xx PCMCIA device support"
	depends on BCM43XX_MAC80211 && PCMCIA
	select SSB_PCMCIAHOST
	---help---
	  Broadcom 43xx PCMCIA device support.

	  Support for 16bit PCMCIA devices.
	  Please note that most PC-CARD devices are _NOT_ 16bit PCMCIA
	  devices, but 32bit CardBUS devices. CardBUS devices are supported
	  by "BCM43xx PCI device support".

	  With this config option you can drive bcm43xx cards in
	  CompactFlash formfactor in a PCMCIA adaptor.
	  CF bcm43xx cards can sometimes be found in handheld PCs.

	  It's safe to select Y here, even if you don't have a BCM43xx PCMCIA device.

	  If unsure, say N.

config BCM43XX_MAC80211_DEBUG
	bool "Broadcom BCM43xx debugging (RECOMMENDED)"
	depends on BCM43XX_MAC80211
	select SSB_DEBUG if !SSB_SILENT
	default y
	---help---
	  Broadcom 43xx debugging messages.
	  Say Y, because the driver is still very experimental and
	  this will help you get it running.

config BCM43XX_MAC80211_DMA
	bool
	depends on BCM43XX_MAC80211
config BCM43XX_MAC80211_PIO
	bool
	depends on BCM43XX_MAC80211

choice
	prompt "BCM43xx data transfer mode"
	depends on BCM43XX_MAC80211
	default BCM43XX_MAC80211_DMA_AND_PIO_MODE

config BCM43XX_MAC80211_DMA_AND_PIO_MODE
	bool "DMA + PIO"
	select BCM43XX_MAC80211_DMA
	select BCM43XX_MAC80211_PIO
	---help---
	  Include both, Direct Memory Access (DMA) and Programmed I/O (PIO)
	  data transfer modes.
	  The actually used mode is selectable through the module
	  parameter "pio". If the module parameter is pio=0, DMA is used.
	  Otherwise PIO is used. DMA is default.

	  If unsure, choose this option.

config BCM43XX_MAC80211_DMA_MODE
	bool "DMA (Direct Memory Access) only"
	select BCM43XX_MAC80211_DMA
	---help---
	  Only include Direct Memory Access (DMA).
	  This reduces the size of the driver module, by omitting the PIO code.

config BCM43XX_MAC80211_PIO_MODE
	bool "PIO (Programmed I/O) only"
	select BCM43XX_MAC80211_PIO
	---help---
	  Only include Programmed I/O (PIO).
	  This reduces the size of the driver module, by omitting the DMA code.
	  Please note that PIO transfers are slow (compared to DMA).

	  Also note that not all devices of the 43xx series support PIO.
	  The 4306 (Apple Airport Extreme and others) supports PIO, while
	  the 4318 is known to _not_ support PIO.

	  Only use PIO, if DMA does not work for you.

endchoice
```

## package/bind/Config.in
```kconfig
menu "bind.............................. A DNS server implementation"

config BR2_COMPILE_BIND
	tristate
	default n
	depends BR2_PACKAGE_BIND_CLIENT || BR2_PACKAGE_BIND_SERVER || BR2_PACKAGE_BIND_TOOLS || BR2_PACKAGE_BIND_RNDC || BR2_PACKAGE_BIND_CHECK || BR2_PACKAGE_BIND_DNSSEC || BR2_PACKAGE_BIND_HOST || BR2_PACKAGE_BIND_DIG

config BR2_PACKAGE_BIND_TOOLS
	prompt "bind-tools........................ Bind administration tools"
	tristate
	default m if CONFIG_DEVEL
	select BR2_COMPILE_BIND
	select BR2_PACKAGE_LIBOPENSSL
	help
	  dig, host,  nsupdate, dnssec-keygen, dnssec-signzone, named-checkconf, named-checkzone, rndc, rndc-confgen
	  
	  http://www.isc.org/sw/bind/
	  
	  Depends: openssl

config BR2_PACKAGE_BIND_RNDC
	prompt "bind-rndc......................... Bind administration tools (rndc & rndc-confgen only)"
	tristate
	default m if CONFIG_DEVEL
	select BR2_COMPILE_BIND
	select BR2_PACKAGE_LIBOPENSSL
	help
	  rndc, rndc-confgen
	  
	  http://www.isc.org/sw/bind/
	  
	  Depends: openssl

config BR2_PACKAGE_BIND_CHECK
	prompt "bind-check........................ Bind administration tools (named-checkconf & named-checkzone only)"
	tristate
	default m if CONFIG_DEVEL
	select BR2_COMPILE_BIND
	select BR2_PACKAGE_LIBOPENSSL
	help
	  named-checkconf, named-checkzone
	  
	  http://www.isc.org/sw/bind/
	  
	  Depends: openssl

config BR2_PACKAGE_BIND_DNSSEC
	prompt "bind-dnssec....................... Bind administration tools (dnssec-keygen & dnssec-signzone only)"
	tristate
	default m if CONFIG_DEVEL
	select BR2_COMPILE_BIND
	select BR2_PACKAGE_LIBOPENSSL
	help
	  dnssec-keygen, dnssec-signzone
	  
	  http://www.isc.org/sw/bind/
	  
	  Depends: openssl

config BR2_PACKAGE_BIND_HOST
	prompt "bind-host......................... A simple DNS client"
	tristate
	default m if CONFIG_DEVEL
	select BR2_COMPILE_BIND
	select BR2_PACKAGE_LIBOPENSSL
	help
	  host
	  
	  http://www.isc.org/sw/bind/
	  
	  Depends: openssl

config BR2_PACKAGE_BIND_DIG
	prompt "bind-dig.......................... A DNS client"
	tristate
	default m if CONFIG_DEVEL
	select BR2_COMPILE_BIND
	select BR2_PACKAGE_LIBOPENSSL
	help
	  dig
	  
	  http://www.isc.org/sw/bind/
	  
	  Depends: openssl


config BR2_PACKAGE_BIND_CLIENT
	prompt "bind-client....................... A dynamic DNS client"
	tristate
	default m if CONFIG_DEVEL
	select BR2_COMPILE_BIND
	select BR2_PACKAGE_LIBOPENSSL
	help
	  A DNS dynamic client (nsupdate)
	  
	  http://www.isc.org/sw/bind/
	  
	  Depends: openssl

config BR2_PACKAGE_BIND_SERVER
	prompt "bind-server....................... A DNS server"
	tristate
	default m if CONFIG_DEVEL
	select BR2_COMPILE_BIND
	select BR2_PACKAGE_LIBOPENSSL
	help
	  A DNS server (named)
	  
	  http://www.isc.org/sw/bind/
	  
	  Depends: libopenssl

endmenu
```

## package/bitchx/Config.in
```kconfig
config BR2_PACKAGE_BITCHX
	prompt "BitchX............................ popular IRC client"
	tristate
	default m if CONFIG_DEVEL
	select BR2_PACKAGE_LIBNCURSES
	help
	  A popular IRC client
	  
	  http://www.bitchx.org/
	  
```

## package/bitlbee/Config.in
```kconfig
config BR2_PACKAGE_BITLBEE
	prompt "bitlbee........................... IRC gateway to IM chat networks"
	tristate
	default m if CONFIG_DEVEL
	select BR2_PACKAGE_LIBOPENSSL
	select BR2_PACKAGE_GLIB1
	select BR2_PACKAGE_LIBICONV
	help

	  BitlBee is an IRC daemon that can talk to instant messaging
	  networks and acts as a gateway. Users can connect to the
	  server with any normal IRC client and see their 'buddy list'
	  in #bitlbee.
	  
	  http://www.bitlbee.org/
```

## package/block-extroot/Config.in
```kconfig
#
# Copyright (C) 2010 Vertical Communications
#
# This is free software, licensed under the GNU General Public License v2.
# See /LICENSE for more information.
#

config EXTROOT_SETTLETIME
	int
	prompt "Settle time for root block device (s)" if PACKAGE_block-extroot
	default 20
	help
		This is the amount of time, in seconds, to wait for the block device
		the root filesystem is on to become available, after the kernel that
		modules for the rootfs and device are loaded.
		
```

## package/bluez-libs/Config.in
```kconfig
config BR2_PACKAGE_BLUEZ_LIBS
	prompt "bluez-libs........................ Bluetooth library"
	tristate
	default m if CONFIG_DEVEL
	help
	  Bluez libs. 
	  
	  http://bluez.org
```

## package/boot/kexec-tools/Config.in
```kconfig
menu "Configuration"
	depends on PACKAGE_kexec-tools

config KEXEC_TOOLS_TARGET_NAME
	string
	prompt "Target name for kexec kernel"
	default EXTRA_TARGET_ARCH_NAME	if powerpc64
	default ARCH
	help
	  Defines the target type of the kernels that kexec deals
	  with. This should be the target specification of
	  the kernel you're booting.

config KEXEC_TOOLS_kdump
	bool
	prompt "kdump support"
	default n
	help
	  Include the kdump utility.

endmenu
```

## package/boot/uboot-envtools/Config.in
```kconfig
config UBOOT_ENVTOOLS_UBI
	bool "Support environment in UBI volume"
	depends on PACKAGE_uboot-envtools
	default n
	help
		Add support for reading and writing U-Boot environment
		stored in UBI volume(s).

		Increases binary size by about 8 kB
```

## package/boot/uboot-lantiq-easybox904xdsl/config/Kconfig
```kconfig
config LANTIQ_UBOOT_danube
	bool
	default y
	depends on ( TARGET_ltqcpe_platform_danube || TARGET_ifxcpe_platform_danube )

config LANTIQ_UBOOT_amazon_se
    bool
	default y
	depends on ( TARGET_ltqcpe_platform_amazon_se || TARGET_ifxcpe_platform_amazon_se )
			
config LANTIQ_UBOOT_ar9
    bool
    default y
    depends on ( TARGET_ltqcpe_platform_ar9 || TARGET_ifxcpe_platform_ar9 )

config LANTIQ_UBOOT_vr9
    bool
	default y
	depends on ( TARGET_ltqcpe_platform_vr9 || TARGET_ifxcpe_platform_vr9 || TARGET_lantiq_xrx200_DEVICE_lantiq_vgv952cjw33-e-ir )
			
config LANTIQ_UBOOT_ar10
    bool
	default y
	depends on ( TARGET_ltqcpe_platform_ar10 || TARGET_ifxcpe_platform_ar10 )


source scripts_platform/Kconfig
```

## package/boot/uboot-lantiq-easybox904xdsl/config/board/amazon_s/Kconfig
```kconfig
#
# For a description of the syntax of this configuration file,
# see Linux Documentation
#
#

config UBOOT_CONFIG_DRIVER_AMAZON_S
      bool
      default y

choice
    prompt 'SUB PLATFORM SELECTION'
    default UBOOT_CONFIG_AR9

config UBOOT_CONFIG_AR9
    bool "AR9"

config UBOOT_CONFIG_GR9
    bool "GR9"

endchoice


config UBOOT_CONFIG_BOARD_NAME
    string 
	default "EASY50812"
	depends on UBOOT_CONFIG_IFX_IMAGE_EXTRA_CHECKS 

config UBOOT_CONFIG_BOARD_VERSION
    string 
	default "1.23"
	depends on UBOOT_CONFIG_IFX_IMAGE_EXTRA_CHECKS

config UBOOT_CONFIG_CHIP_NAME
    string 
	default "ARX188"
	depends on UBOOT_CONFIG_IFX_IMAGE_EXTRA_CHECKS

config UBOOT_CONFIG_CHIP_VERSION
    string 
	default "1.2"
	depends on UBOOT_CONFIG_IFX_IMAGE_EXTRA_CHECKS

config UBOOT_CONFIG_TUNE_DDR
    bool "DDR tuning support"

config UBOOT_CONFIG_DDR_TUNING_TEXT_BASE
    hex 
	default "0x9e1a0000"
    depends on UBOOT_CONFIG_TUNE_DDR		


choice 
    prompt 'PLL SETTING'
    default UBOOT_CONFIG_USE_PLL0

config UBOOT_CONFIG_USE_PLL0
    bool "PLL0"

config UBOOT_CONFIG_USE_PLL1
    bool "PLL1"

endchoice	

choice 
    prompt 'RAM BRAND'
	default UBOOT_CONFIG_QIMONDA

config UBOOT_CONFIG_QIMONDA_RAM
    bool "QIMONDA"

config UBOOT_CONFIG_ETRON_RAM
    bool "ETRON"

config UBOOT_CONFIG_HYNIX_RAM
    bool "HYNIX"

config UBOOT_CONFIG_NANYA_RAM
    bool "NANYA"
    depends on UBOOT_CONFIG_CPU_333M_RAM_166M
  
endchoice

choice 
    prompt 'CPU/RAM SPEED SETTING'
    default UBOOT_CONFIG_CPU_333M_RAM_166M

config UBOOT_CONFIG_CPU_111M_RAM_111M
    bool "111M/111M"
	depends on UBOOT_CONFIG_USE_PLL0

config UBOOT_CONFIG_CPU_333M_RAM_111M
    bool "333M/111M"
	depends on UBOOT_CONFIG_USE_PLL0

config UBOOT_CONFIG_CPU_166M_RAM_166M
    bool "166M/166M"
	depends on UBOOT_CONFIG_USE_PLL0

config UBOOT_CONFIG_CPU_333M_RAM_166M
    bool "333M/166M"

config UBOOT_CONFIG_CPU_500M_RAM_166M
    bool "500M/166M"
	depends on UBOOT_CONFIG_USE_PLL0
	
config UBOOT_CONFIG_CPU_500M_RAM_250M
    bool "500M/250M"
	depends on UBOOT_CONFIG_USE_PLL0

config UBOOT_CONFIG_CPU_393M_RAM_196M
    bool "393M/196M"
	depends on UBOOT_CONFIG_USE_PLL1

config UBOOT_CONFIG_CPU_442M_RAM_221M	
    bool "442M/221M"
	depends on UBOOT_CONFIG_USE_PLL1

config UBOOT_CONFIG_CPU_442M_RAM_147M
    bool "442M/147M"
	depends on UBOOT_CONFIG_USE_PLL1

endchoice	

config UBOOT_CONFIG_CLASS_II_DDR_PAD
    bool "CLASS II DDR PAD"

config UBOOT_CONFIG_USE_25MHz_CLOCK
    bool "USE 25MHz Crystal Clock"

config UBOOT_CONFIG_EBU_ADDR_SWAP
        bool "EBU ADDRESS SWAP"
        depends on UBOOT_CONFIG_NOR_FLASH

					
```

## package/boot/uboot-lantiq-easybox904xdsl/config/board/amazon_se/Kconfig
```kconfig
#
# For a description of the syntax of this configuration file,
# see Linux Documentation
#
#

config UBOOT_CONFIG_DRIVER_AMAZON_SE
      bool
	  default y

config UBOOT_CONFIG_BOARD_NAME
    string
	default "EASY50601"
	depends on UBOOT_CONFIG_IFX_IMAGE_EXTRA_CHECKS

config UBOOT_CONFIG_BOARD_VERSION
    string
    default "1.0"
    depends on UBOOT_CONFIG_IFX_IMAGE_EXTRA_CHECKS

config UBOOT_CONFIG_CHIP_NAME
    string
    default "AMAZON_SE"
    depends on UBOOT_CONFIG_IFX_IMAGE_EXTRA_CHECKS

config UBOOT_CONFIG_CHIP_VERSION
    string
    default "1.2"
    depends on UBOOT_CONFIG_IFX_IMAGE_EXTRA_CHECKS
												

choice 
        prompt 'CPU CLOCK'
	    default UBOOT_CONFIG_ASE_CPU_266M
	  
config UBOOT_CONFIG_ASE_CPU_133M
		bool "133M"

config UBOOT_CONFIG_ASE_CPU_266M
		bool "266M"
		
endchoice

choice
        prompt 'ETHERNET TYPE'
	    default UBOOT_CONFIG_ETHERNET_TYPE_EPHY

config UBOOT_CONFIG_ETHERNET_TYPE_EPHY
       bool "EPHY"

config UBOOT_CONFIG_ETHERNET_TYPE_RMII
       bool "RMII"
		
endchoice

choice
       prompt "CLOCK SOURCE"
	   default UBOOT_CONFIG_EPHY_INTERNAL_CLOCK
	   depends on UBOOT_CONFIG_ETHERNET_TYPE_EPHY

config UBOOT_CONFIG_EPHY_INTERNAL_CLOCK
       bool "INTERNAL"

config UBOOT_CONFIG_EPHY_EXTERNAL_CLOCK
       bool "EXTERNAL"

endchoice
								   

config UBOOT_CONFIG_EPHY_WITH_TANTOS_SWITCH
       bool "EPHY WITH TANTOS SWITCH"
       depends on UBOOT_CONFIG_ETHERNET_TYPE_EPHY

config UBOOT_CONFIG_OLD_ASE_BOOTROM_VERSION
       bool "BOOTROM VERSION<=1.1.0"
	   default n
	   depends on UBOOT_CONFIG_BOOT_FROM_SPI

	
```
