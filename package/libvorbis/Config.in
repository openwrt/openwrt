## package/libvorbis/Config.in
```kconfig
config BR2_PACKAGE_LIBVORBIS
	tristate "libvorbis - The Vorbis General Audio Compression Codec library"
	default n
	select BR2_PACKAGE_LIBOGG
	help
	  The Vorbis General Audio Compression Codec library.
	  
	  http://www.vorbis.com/
	  
```

## package/libvorbisidec/Config.in
```kconfig
config BR2_PACKAGE_LIBVORBISIDEC
	prompt "libvorbisidec..................... A fixed-point implementation (Tremor) of libogg/libvorbis"
	tristate
	default m if CONFIG_DEVEL
	help
	  libvorbisidec is "tremor", a fixed-point implementation of libvorbis.
	  It also has libogg built-in. It is suitable as a replacement for 
	  libvorbis and libogg in tremor-aware applications.
	  Tremor is a decoder only.
	  
	  http://http://wiki.xiph.org/index.php/Tremor
```

## package/libxslt/Config.in
```kconfig
config BR2_PACKAGE_LIBXSLT
	tristate "libxslt - Gnome XSLT library"
	default m if CONFIG_DEVEL
	select BR2_PACKAGE_LIBXML2
	help
	  A library for XML transformation using XSLT.
	  
	  http://xmlsoft.org/XSLT/
	  
```

## package/lighttpd/Config.in
```kconfig
menu "lighttpd.......................... Flexible and lightweight web server"

config BR2_PACKAGE_LIGHTTPD
	prompt "lighttpd.......................... Flexible and lightweight web server"
	tristate 
	default m if CONFIG_DEVEL
	select BR2_PACKAGE_LIBOPENSSL
	select BR2_PACKAGE_LIBPCRE
	help
	  A flexible and lightweight web server.
	  
	  http://www.lighttpd.net/
	  
	  Depends: libopenssl, libpcre

config BR2_PACKAGE_LIGHTTPD_MOD_ACCESSLOG
	prompt   "lighttpd-mod-accesslog.......... Access logging module"
	tristate 
	default m if CONFIG_DEVEL
	depends BR2_PACKAGE_LIGHTTPD

config BR2_PACKAGE_LIGHTTPD_MOD_ALIAS
	prompt   "lighttpd-mod-alias.............. Directory alias module"
	tristate 
	default m if CONFIG_DEVEL
	depends BR2_PACKAGE_LIGHTTPD

config BR2_PACKAGE_LIGHTTPD_MOD_AUTH
	prompt   "lighttpd-mod-auth............... Authentication module"
	tristate 
	default m if CONFIG_DEVEL
	depends BR2_PACKAGE_LIGHTTPD

config BR2_PACKAGE_LIGHTTPD_MOD_CGI
	prompt   "lighttpd-mod-cgi................ CGI module"
	tristate 
	default m if CONFIG_DEVEL
	depends BR2_PACKAGE_LIGHTTPD

config BR2_PACKAGE_LIGHTTPD_MOD_EVASIVE
	prompt   "lighttpd-mod-evasive............ Evasive module"
	tristate 
	default m if CONFIG_DEVEL
	depends BR2_PACKAGE_LIGHTTPD

config BR2_PACKAGE_LIGHTTPD_MOD_EXPIRE
	prompt   "lighttpd-mod-expire............. Expire module"
	tristate 
	default m if CONFIG_DEVEL
	depends BR2_PACKAGE_LIGHTTPD

config BR2_PACKAGE_LIGHTTPD_MOD_FASTCGI
	prompt   "lighttpd-mod-fastcgi............ FastCGI module"
	tristate 
	default m if CONFIG_DEVEL
	depends BR2_PACKAGE_LIGHTTPD

config BR2_PACKAGE_LIGHTTPD_MOD_PROXY
	prompt   "lighttpd-mod-proxy.............. Proxy module"
	tristate 
	default m if CONFIG_DEVEL
	depends BR2_PACKAGE_LIGHTTPD

config BR2_PACKAGE_LIGHTTPD_MOD_REDIRECT
	prompt   "lighttpd-mod-redirect........... URL redirection module"
	tristate 
	default m if CONFIG_DEVEL
	depends BR2_PACKAGE_LIGHTTPD

config BR2_PACKAGE_LIGHTTPD_MOD_REWRITE
	prompt   "lighttpd-mod-rewrite............ URL rewriting module"
	tristate 
	default m if CONFIG_DEVEL
	depends BR2_PACKAGE_LIGHTTPD

config BR2_PACKAGE_LIGHTTPD_MOD_SETENV
	prompt   "lighttpd-mod-setenv............. Environment variable setting module"
	tristate 
	default m if CONFIG_DEVEL
	depends BR2_PACKAGE_LIGHTTPD

config BR2_PACKAGE_LIGHTTPD_MOD_SIMPLE_VHOST
	prompt   "lighttpd-mod-simple-vhost....... Simple virtual hosting module"
	tristate 
	default m if CONFIG_DEVEL
	depends BR2_PACKAGE_LIGHTTPD

config BR2_PACKAGE_LIGHTTPD_MOD_SSI
	prompt   "lighttpd-mod-ssi................ SSI module"
	tristate 
	default m if CONFIG_DEVEL
	depends BR2_PACKAGE_LIGHTTPD

config BR2_PACKAGE_LIGHTTPD_MOD_STATUS
	prompt   "lighttpd-mod-status............. Server status display module"
	tristate 
	default m if CONFIG_DEVEL
	depends BR2_PACKAGE_LIGHTTPD

config BR2_PACKAGE_LIGHTTPD_MOD_USERTRACK
	prompt   "lighttpd-mod-usertrack.......... User tracking module"
	tristate 
	default m if CONFIG_DEVEL
	depends BR2_PACKAGE_LIGHTTPD

endmenu
```

## package/linux-atm/Config.in
```kconfig
config BR2_PACKAGE_LINUX_ATM
	prompt "linux-atm......................... ATM Library/Utilities for Linux"
	tristate
	default y if BR2_LINUX_2_4_AR7
	default n
	help
	  ATM Library for linux
	  
	  http://ftp.debian.org/debian/pool/main/l/linux-atm/

config BR2_PACKAGE_BR2684CTL
	prompt   "br2684ctl....................... RFC2684 bridging utility"
	tristate
	default y if BR2_LINUX_2_4_AR7
	default n
	depends BR2_PACKAGE_LINUX_ATM
	help
	  Utility for setting up ATM RFC2684 bridging mode
	  Useful for PPPoE
	  
	  http://ftp.debian.org/debian/pool/main/l/linux-atm/
```

## package/linux/Config.in
```kconfig
config BR2_PACKAGE_LINUX
	bool "linux"
	default y
	help
	  The Linux kernel.

	  http://www.kernel.org/
```

## package/lqdsl/Config.in
```kconfig
choice
	prompt "Firmware"
	default LANTIQ_ANNEX_B
	depends on PACKAGE_kmod-lqdsl
	help
	  This option controls which firmware is loaded

config LANTIQ_ANNEX_A
	bool "Annex-A"
	help
	  Annex-A

config LANTIQ_ANNEX_B
	bool "Annex-B"
	help
	  Annex-B

endchoice

config LANTIQ_DSL_DEBUG
	bool "lqdsl debugging"
	depends on PACKAGE_kmod-lqdsl
	help
	  Say Y, if you need lantiq-dsl to display debug messages.
```

## package/lrzsz/Config.in
```kconfig
config BR2_PACKAGE_LRZSZ	
	prompt "lrsz.............................. X,Y and Z-modem protocols"
	tristate
	default m if CONFIG_DEVEL
	help
		Transfer files in your login sessions.
		Very leightweight ans straight forward.
		You just need a terminal client that can do 
		either X, Y or Z-modem file transfers.

		http://www.ohse.de/uwe/software/lrzsz.html
```

## package/ltq-dsl-app/Config.in
```kconfig
menu "Configuration"
	depends on PACKAGE_ltq-dsl-app

config LTQ_DSL_ENABLE_CLI
	bool "Enable CLI support"
	depends on PACKAGE_ltq-dsl-app
	default n

config LTQ_DSL_ENABLE_DSL_EVENT_POLLING
	bool "Include Event Polling support"
	depends on PACKAGE_ltq-dsl-app
	default n

endmenu
```

## package/ltq-tapidemo/Config.in
```kconfig
choice
	prompt "board selection"
	depends on PACKAGE_ltq-tapidemo
	default VOICE_CPE_TAPIDEMO_BOARD_EASY50712_V3	if TARGET_lantiq_xway
	default VOICE_CPE_TAPIDEMO_BOARD_EASY508xx	if TARGET_lantiq_ar9
	default VOICE_CPE_TAPIDEMO_BOARD_EASY80910	if TARGET_lantiq_vr9
	help
		Select the target platform.

	config VOICE_CPE_TAPIDEMO_BOARD_EASY50712
		bool "Danube reference board"

	config VOICE_CPE_TAPIDEMO_BOARD_EASY50712_V3
		bool "Danube reference board V3"

	config VOICE_CPE_TAPIDEMO_BOARD_EASY508xx
		bool "AR9/GR9 reference board"

	config VOICE_CPE_TAPIDEMO_BOARD_EASY80910
		bool "VR9 reference board"
endchoice

config VOICE_CPE_TAPIDEMO_QOS
	bool "enable QOS support"
	depends on PACKAGE_ltq-tapidemo
	select PACKAGE_kmod-ltq-kpi2udp
	default y
	help
		Option to enable the KPI2UDP RTP packet acceleration path
		(highly recommended for VoIP).

config  VOICE_CPE_TAPIDEMO_FAX_T.38_FW
	bool "enable T.38 fax relay"
	depends on (TARGET_lantiq_ar9 || TARGET_lantiq_vr9) && PACKAGE_ltq-tapidemo
	default n
	help
		enable T.38 fax relay demo.

config VOICE_CPE_TAPIDEMO_FW_FILE
	string "override default firmware file"
	depends on PACKAGE_ltq-tapidemo
	default "falcon_voip_fw.bin" if TARGET_lantiq_falcon

config VOICE_CPE_TAPIDEMO_BBD_FILE
	string "override default coefficient file"
	depends on PACKAGE_ltq-tapidemo
	default "falcon_bbd.bin" if TARGET_lantiq_falcon
```

## package/ltq-vmmc/Config.in
```kconfig
choice
	prompt "device selection"
	depends on PACKAGE_kmod-ltq-vmmc
	default VOICE_CPE_VMMC_WITH_DEVICE_DANUBE
	help
		Select the target device.

	config VOICE_CPE_VMMC_WITH_DEVICE_DANUBE
		bool "Danube, Twinpass, Vinax"

	config VOICE_CPE_VMMC_WITH_DEVICE_AR9
		bool "AR9 family"

	config VOICE_CPE_VMMC_WITH_DEVICE_VR9
		bool "VR9 family"

endchoice

config VOICE_CPE_VMMC_PMC
	depends on (VOICE_CPE_VMMC_WITH_DEVICE_AR9 || VOICE_CPE_VMMC_WITH_DEVICE_VR9)
	bool "Power Management Control support"
	default n
	help
		Option to enable Power Management Control on AR9, VR9. Not supported for Danube.

config VOICE_CPE_VMMC_DISABLE_DECT_NIBBLE_SWAP
	bool "Disable DECT nibble swap"
	depends on PACKAGE_kmod-ltq-vmmc
	default n
	help
		Option to disable DECT nibble swap for COSIC modem (for backward compatibility only).

config VOICE_CPE_VMMC_EVENT_LOGGER
	depends on BROKEN
	bool "Event logger support"
	depends on PACKAGE_kmod-ltq-vmmc
	default n
	help
		Option to enable details traces between drv_vmmc and the voice FW
		- for debugging only
		- requires package ifx-evtlog

config VOICE_CPE_VMMC_MPS_HISTORY_SIZE
	int "MPS history buffer in words (0<=size<=512)"
	depends on PACKAGE_kmod-ltq-vmmc
	default "128"
	help
		MPS history buffer (default=128 words, maximum=512 words, 0=disable)
		To opimize the memory footprint in RAM, you might want to set the
		buffer size to 0.
```

## package/mac80211/Config.in
```kconfig
# mac80211 configuration

config PACKAGE_MAC80211_DEBUGFS
	bool "Export mac80211 internals in DebugFS"
	depends on PACKAGE_kmod-mac80211
	---help---
	  Select this to see extensive information about
	  the internal state of mac80211 in debugfs.

	  Say N unless you know you need this.
```

## package/macchanger/Config.in
```kconfig
config BR2_PACKAGE_MACCHANGER
        tristate "macchanger........................ utility for viewing/manipulating the MAC address"
	default m if CONFIG_DEVEL
	help
		This is a GNU/Linux utility for viewing/manipulating the MAC address
		of network interfaces.
		
		http://www.alobbs.com/macchanger
```

## package/madwifi/Config.in
```kconfig
menu "Configuration"
	depends on PACKAGE_kmod-madwifi

config MADWIFI_DEBUG
	bool "Enable compilation of debugging features"
	depends on DEVEL
	default n

config MADWIFI_COMPRESSION
	bool "Enable Atheros Super A/G Compression"
	depends !TARGET_ar71xx
	default n
	help
	  Enables Atheros Super A/G Hardware Compression Engine.

config MADWIFI_SINGLE_MODULE
	bool "Combine driver and net80211 into a single module"
	default y
	help
	  This option combines all driver and stack related code (except for HAL)
	  into a single module, thus saving space and removing unnecessary kernel
	  exports

choice
	prompt "Rate control algorithm selection"
	default MADWIFI_RCA_MINSTREL
	help
	  This option controls how MadWifi chooses its bitrate.

config MADWIFI_RCA_MINSTREL
	bool "Use the Minstrel rate control algorithm"
	help
	  This code is takes a wandering minstrel approach. Wander around the
	  different rates, singing wherever you can. And then, look at the
	  performance, and make a choice. Note that the wandering minstrel will
	  always wander in directions where he/she feels he/she will get paid
	  the best for his/her work.

config MADWIFI_RCA_SAMPLERATE
	bool "Use the SampleRate rate control algorithm"
	help
	  SampleRate decides on the transmission bit-rate based on the past
	  history of performance; it keeps a record of the number of successive
	  failures, the number of successful transmits and the total transmission
	  time along with the destination for that bit-rate. Stale samples are
	  removed based on a EWMA windowing mechanism. If in the sampling
	  process, no successful acknowledgment is received or the number of
	  packets sent is multiple of 10 on a specific link, it transmits the
	  packet with the highest rate which has not failed 4 successive times.
	  Other than that it transmits packets at the rate which has the lowest
	  average transmission time.

endchoice

endmenu
```

## package/maradns/Config.in
```kconfig
config BR2_PACKAGE_MARADNS
	tristate "maradns - Small and secure DNS Server"
	default m if CONFIG_DEVEL
	help
	  A small and secure DNS server
	  
	  http://www.maradns.org/
	  
```

## package/matrixssl/Config.in
```kconfig
config BR2_COMPILE_MATRIXSSL
	tristate
	depends BR2_PACKAGE_LIBMATRIXSSL

config BR2_PACKAGE_LIBMATRIXSSL
	prompt "libmatrixssl...................... Embedded SSL implementation"
	tristate
	default m if CONFIG_DEVEL
	select BR2_COMPILE_MATRIXSSL
	select BR2_PACKAGE_LIBPTHREAD
	help
	  An embedded SSL implementation
	  
	  http://www.matrixssl.org/
	  
	  Depends: libpthread
```

## package/miau/Config.in
```kconfig
config BR2_PACKAGE_MIAU
	prompt "miau.............................. Another IRC-bouncer/proxy"
	tristate
	default m if CONFIG_DEVEL
	help
	  In short, miau is an IRC-bouncer/proxy. 
	  Being more verbose, miau is small but quite featured 
	  IRC-bouncer - a service bit like HTTP-proxy, but
	  for IRC-networks.
	  
	  http://sourceforge.net/projects/miau/
	  
```

## package/microcom/Config.in
```kconfig
config BR2_PACKAGE_MICROCOM
	prompt "microcom.......................... Serial terminal"
	tristate
	default m if CONFIG_DEVEL
	help
	  microcom is a minicom-like serial terminal emulator with scripting 
	  support.
	  
	  http://microcomlinux.homestead.com/
```

## package/microperl/Config.in
```kconfig
config BR2_PACKAGE_MICROPERL
	prompt "microperl......................... A really minimal perl"
	tristate
	default m if CONFIG_DEVEL
	help
	  Perl without operating-specific functions such as readdir.
```

## package/monit/Config.in
```kconfig
config BR2_PACKAGE_MONIT
	tristate "monit - System services monitoring utility"
	select BR2_PACKAGE_LIBPTHREAD
	default m if CONFIG_DEVEL
	help
	  utility for monitoring services on a Unix system
	  
	  http://www.tildeslash.com/monit/
	  
	
```

## package/mpd/Config.in
```kconfig
config BR2_PACKAGE_MPD
	tristate "MPD - Music Player Daemon (flac support)"
	default m if CONFIG_DEVEL
	help
		MPD is a music player supporting flac, mp3 and ogg.
		It is typically controlled over a network using one of it's many
		clients including mpc(console), gmpc(gnome), phpmp(php) etc.

config BR2_PACKAGE_MPD_MP3
	bool "MP3 Support - Enable mp3 support (experimental)"
	depends BR2_PACKAGE_MPD
	help
		Enable builtin mp3 support (mad). Not well tested, may crash your mpd!

config BR2_PACKAGE_MPD_OGG
	bool "OGG Support - Enable ogg support (experimental)"
	depends BR2_PACKAGE_MPD
	help
		Enable builtin ogg support (tremor).
```

## package/mt-daapd/Config.in
```kconfig
config BR2_PACKAGE_MT_DAAPD
	prompt "mt-daapd.......................... A multi-threaded DAAP (Digital Audio Access Protocol) daemon"
	tristate 
	default m if CONFIG_DEVEL
	select BR2_PACKAGE_LIBGDBM
	select BR2_PACKAGE_LIBHOWL
	select BR2_PACKAGE_LIBID3TAG
	help
	  mt-daapd is a program which acts as an iTunes (DAAP) server for Linux and 
	  other POSIX unixes. It may eventually support Win32 as well.
	  
	  Some random features that it supports:
	  
	    * Supports the Roku SoundBridge (query/browse/index support) 
	    * Supports periodic rescans of the database 
	    * Can advertise shoutcast streams 
	    * Supports password-protected shares 
	    * Is web-configurable and managable 
	    * Support dynamic playlists, like iTunes "Smart playlists" 
	    * Probably other things I've forgotten 
	  
	  All is not perfect, however. Currently, there are several drawbacks to it:
	  
	    * database is indexed by inode, so all music must be on one filesystem 
	    * browse by artist is slow on Roku, times out (with large databases ~10K songs) 
	    * Probably other things I've forgotten 
	  
	  http://www.mt-daapd.org/
	  
	  Depends: libgdbm, libhowl, libid3tag, libpthread
```

## package/mtd/Config.in
```kconfig
config BR2_PACKAGE_MTD
	prompt "mtd............................... Update utility for trx firmware images"
	tristate
	default y
	help
	  Update utility for trx firmware images.

config BR2_PACKAGE_MTD_STATIC
	prompt "mtd-static........................ Update utility for trx firmware images (statically linked)"
	tristate
	default n
	help
	  Update utility for trx firmware images (statically linked). To update
	  from other firmware or older OpenWrt releases.
```
