## package/mutt/Config.in
```kconfig
config BR2_PACKAGE_MUTT
	prompt "mutt.............................. console mail client"
	tristate
	default m if CONFIG_DEVEL
	select BR2_PACKAGE_LIBNCURSES
	select BR2_PACKAGE_LIBOPENSSL
	help
	  Mail client for the text console
	  
	  http://www.mutt.org
```

## package/mysql/Config.in
```kconfig
config BR2_COMPILE_MYSQL
	bool
	default n
	depends BR2_PACKAGE_LIBMYSQLCLIENT

config BR2_PACKAGE_LIBMYSQLCLIENT
	prompt "libmysqlclient.................... MySQL client library"
	tristate
	default m if CONFIG_DEVEL
	select BR2_COMPILE_MYSQL
	help
	  MySQL client library.
	  
	  http://dev.mysql.com/
```
