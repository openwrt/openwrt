## package/utils/ufp/Config.in
```kconfig
menu "Configuration"
	depends on PACKAGE_ufp

config UFP_INCLUDE_IEEE
	bool "Include all oui entries from standards.ieee.org"
	default n
endmenu
```

## package/vnc-reflector/Config.in
```kconfig
config BR2_PACKAGE_VNC_REFLECTOR
	prompt "vnc-reflector..................... VNC proxy for multiple clients"
	tristate
	default m if CONFIG_DEVEL
	select BR2_PACKAGE_LIBJPEG
	select BR2_PACKAGE_ZLIB
	help
	  VNC Reflector is a specialized VNC server which acts as
	  a proxy sitting between real VNC server (a host) and a 
	  number of VNC clients. It was designed to work efficiently
	  with large number of clients.

	  http://sourceforge.net/projects/vnc-reflector
```

## package/vocore2/openwrt.1806/mt7628/config.in
```kconfig
if PACKAGE_kmod-mt7628

config MT7628_RT_FIRST_CARD
	int
	default 7628

config MT7628_MT_WIFI
	bool
	select MT7628_WIFI_BASIC_FUNC
	default y

config MT7628_MT_WIFI_PATH
		string
		depends on MT7628_MT_WIFI
		default "rlt_wifi"

menu "WiFi Generic Feature Options"

config MT7628_FIRST_IF_EEPROM_FLASH
	bool
	default y

config MT7628_RT_FIRST_CARD_EEPROM
		string
		default "flash"


config MT7628_SECOND_IF_EEPROM_FLASH
	bool
	default y

config MT7628_RT_SECOND_CARD_EEPROM
		string
		default "flash"
		
config MT7628_MULTI_INF_SUPPORT
		bool
		default n

config MT7628_WIFI_BASIC_FUNC
	bool "Basic Functions"
	select WIRELESS_EXT
	select WEXT_SPY
	select WEXT_PRIV
        
config MT7628_WSC_INCLUDED
	bool "WSC (WiFi Simple Config)"
	default y

config MT7628_WSC_V2_SUPPORT
	bool "WSC V2(WiFi Simple Config Version 2.0)"
	default y

config MT7628_DOT11N_DRAFT3
	bool "802.11n Draft3"
	default y
    
config MT7628_DOT11W_PMF_SUPPORT
	bool "PMF"
	default y

config MT7628_LLTD_SUPPORT
	bool "LLTD (Link Layer Topology Discovery Protocol)"
	default n

config MT7628_QOS_DLS_SUPPORT
	bool "802.11e DLS ((Direct-Link Setup) Support"
	default n

config MT7628_WAPI_SUPPORT
	bool "WAPI Support"
	default n

#config MT7628_CARRIER_DETECTION_SUPPORT
#	bool "Carrier Detect"
#	default n

config MT7628_IGMP_SNOOP_SUPPORT
	bool "IGMP snooping"
	default n

config MT7628_BLOCK_NET_IF
	bool "NETIF Block"
	default n
	help
	Support Net interface block while Tx-Sw queue full

config MT7628_RATE_ADAPTION
	bool "New Rate Adaptation support"
	default y

config MT7628_NEW_RATE_ADAPT_SUPPORT
	bool "Intelligent Rate Adaption"
	default y

config MT7628_AGS_SUPPORT
	bool "Adaptive Group Switching"
	default n
    
config MT7628_IDS_SUPPORT
	bool "IDS (Intrusion Detection System) Support"
	default n

config MT7628_WIFI_WORK_QUEUE
	bool "Work Queue"
	default n

config MT7628_WIFI_SKB_RECYCLE
	bool "SKB Recycle(Linux)"
	default n

#config MT7628_RTMP_FLASH_SUPPORT
#	bool "Flash Support"
#	default y

config MT7628_LED_CONTROL_SUPPORT
	bool "LED Support"
	default n

config MT7628_ATE_SUPPORT
	bool "ATE/QA Support"
	default n

config MT7628_MEMORY_OPTIMIZATION
	bool "Memory Optimization"
	default n

config MT7628_UAPSD
	bool "UAPSD support"
	default y

#
# Section for chip architectures
#
config MT7628_MT_MAC
	bool
	default y

#
# Section for interfaces
#
config MT7628_RTMP_PCI_SUPPORT
	bool

config MT7628_RTMP_USB_SUPPORT
	bool

config MT7628_RTMP_RBUS_SUPPORT
	bool

endmenu

menu "WiFi Operation Modes"
config MT7628_WIFI_MODE_AP
		bool
		default y

config MT7628_MT_AP_SUPPORT
	bool #"Ralink RT2860 802.11n AP support"
#	depends on NET_RADIO 
	select WIRELESS_EXT
	select WEXT_SPY
	select WEXT_PRIV
	default y

config MT7628_WDS_SUPPORT
	bool "WDS"
	depends on MT7628_MT_AP_SUPPORT

config MT7628_MBSS_SUPPORT
	bool "MBSSID"
	depends on MT7628_MT_AP_SUPPORT
	default y

config MT7628_NEW_MBSSID_MODE
	bool "New MBSSID MODE"
	depends on MT7628_MT_AP_SUPPORT && MT7628_WMBSS_SUPPORT
	depends on RALINK_RT3883 || RALINK_RT3352 || RALINK_RT5350 || RALINK_RT6352 || RALINK_MT7620
	default y

config MT7628_ENHANCE_NEW_MBSSID_MODE
	bool "Enhanced MBSSID mode"
	depends on MT7628_NEW_MBSSID_MODE
	default y

config MT7628_APCLI_SUPPORT
	bool "AP-Client Support"
	depends on MT7628_MT_AP_SUPPORT

config MT7628_MAC_REPEATER_SUPPORT
	bool "MAC Repeater Support"
	depends on MT7628_MT_AP_SUPPORT
	depends on MT7628_APCLI_SUPPORT
	depends on RALINK_RT6352 || RALINK_MT7620 || RALINK_MT7603E || MT7628_MT_AP_SUPPORT
	default n

config MT7628_SNIFFER_SUPPORT
        bool "SNIFFER"
        depends on MT7628_MT_AP_SUPPORT
        default n

#config MT7628_DOT11R_FT_SUPPORT
#	bool "802.11r Fast BSS Transition"
#	depends on MT7628_MT_AP_SUPPORT

#config MT7628_DOT11K_RRM_SUPPORT
#	bool "802.11k Radio Resource Management"
#	depends on MT7628_MT_AP_SUPPORT

config MT7628_CON_WPS_SUPPORT
        bool "Concurrent WPS Support"
        depends on MT7628_MT_AP_SUPPORT
        depends on MT7628_APCLI_SUPPORT
        depends on MT7628_WSC_INCLUDED
        depends on MT7628_WSC_V2_SUPPORT
        default n

config MT7628_LLTD_SUPPORT
	bool "LLTD (Link Layer Topology Discovery Protocol)"
	depends on MT7628_MT_AP_SUPPORT

#config MT7628_COC_SUPPORT
#	bool "CoC Support"
#	depends on MT7628_MT_AP_SUPPORT
#	default n

#config MT7628_ RT2860V2_SNMP
#	bool "Net-SNMP Support"
#	depends on MT7628_MT_AP_SUPPORT

#config MT7628_MCAST_RATE_SPECIFIC
#	bool "User specific tx rate of mcast pkt"
#	depends on MT7628_MT_AP_SUPPORT

#config MT7628_EXT_BUILD_CHANNEL_LIST
#	bool "Extension Channel List"
#	depends on MT7628_MT_AP_SUPPORT

#config MT7628_AUTO_CH_SELECT_ENHANCE
#	bool "Auto Channel Selection Enhancement"
#	depends on MT7628_MT_AP_SUPPORT

config MT7628_AIREPLAY_SUPPORT
	bool "Airplay Support"
	depends on MT7628_MT_AP_SUPPORT
	default n
endmenu	

endif
```

## package/vpnc/Config.in
```kconfig
config BR2_PACKAGE_VPNC
	tristate "vpnc............................. VPN client for Cisco 3000"
	default m if CONFIG_DEVEL
	depends on BR2_PACKAGE_KMOD_TUN
	depends on BR2_PACKAGE_LIBGPG_ERROR
	depends on BR2_PACKAGE_LIBGCRYPT
	help
		Client for cisco3000 VPN Concentrator.
```

## package/vsftpd/Config.in
```kconfig
config BR2_PACKAGE_VSFTPD
	tristate "vsftpd - a fast and secure FTP server"
	default m if CONFIG_DEVEL
	help
	  A fast and secure FTP server
	  
	  http://vsftpd.beasts.org/
	  
```

## package/vtun/Config.in
```kconfig
config BR2_PACKAGE_VTUN
	tristate "vtun"
	default m if CONFIG_DEVEL
	select BR2_PACKAGE_ZLIB
	select BR2_PACKAGE_LZO
	select BR2_PACKAGE_OPENSSL
	help
	  A VPN tunneling daemon
	  
	  http://vtun.sourceforge.net
```

## package/wificonf/Config.in
```kconfig
config BR2_PACKAGE_WIFICONF
	prompt "wificonf.......................... replacement utility for wlconf"
	tristate
	default y
	depends BR2_PACKAGE_NVRAM
	help
	  Replacement utility for wlconf
```

## package/wifidog/Config.in
```kconfig
config BR2_PACKAGE_WIFIDOG
	prompt "wifidog........................... A wireless captive portal solution"
	tristate
	default m if CONFIG_DEVEL
	select BR2_PACKAGE_IPTABLES
	select BR2_PACKAGE_IPTABLES_EXTRA
	help
	  The Wifidog project is a complete and embeddable captive
	  portal solution for wireless community groups or individuals
	  who wish to open a free Hotspot while still preventing abuse
	  of their Internet connection.
	  
	  http://www.wifidog.org/
```

## package/wireless-tools/Config.in
```kconfig
config BR2_PACKAGE_WIRELESS_TOOLS
	tristate "wireless-tools"
	default y
	help
	  Tools for configuring Wireless Adapters implementing the "Wireless Extension"
```

## package/wiviz/Config.in
```kconfig
config BR2_PACKAGE_WIVIZ
	prompt "wiviz............................. Wireless Network Visualization"
	tristate
	default m if CONFIG_DEVEL
	help
	  Wireless Network Visualization
	  
	  http://students.washington.edu/natetrue/wiviz/
```

## package/wol/Config.in
```kconfig
config BR2_PACKAGE_WOL
	tristate "wol - Wake On LAN client"
	default m if CONFIG_DEVEL
	help
	  wol implements Wake On LAN functionality in a small program. 
	  It wakes up hardware that is Magic Packet compliant.
	  
	  http://ahh.sourceforge.net/wol/
	  
```

## package/wpa_supplicant/Config.in
```kconfig
# wpa_supplicant config
config WPA_SUPPLICANT_NO_TIMESTAMP_CHECK
	bool "Disable timestamp check"
	depends PACKAGE_wpa-supplicant
	default n
	help
	  This disables the timestamp check for certificates in wpa_supplicant
	  Useful for devices without RTC that cannot reliably get the real date/time
choice
        prompt "Choose TLS provider"
        default WPA_SUPPLICANT_INTERNAL
	depends PACKAGE_wpa-supplicant

config WPA_SUPPLICANT_INTERNAL
	bool "internal"

config WPA_SUPPLICANT_OPENSSL
	bool "openssl"
	select PACKAGE_libopenssl

endchoice
```

## package/wrt-radauth/Config.in
```kconfig
config BR2_PACKAGE_WRT_RADAUTH
	prompt "wrt-radauth....................... A Radius MAC authenticator for Broadcom based access points"
	tristate
	default m if CONFIG_DEVEL
	depends BR2_PACKAGE_NVRAM
	help
	  This software watches the stations associating to a broadcom based
	  AccessPoint (e.g. Linksys WRT54G) and sends an authentication request
	  to the radius-server specified in nvram.
	  
	  http://www.zerfleddert.de/wrt54g/
```

## package/xinetd/Config.in
```kconfig
config BR2_PACKAGE_XINETD
	tristate "xinetd - a powerful and secure superserver"
	default m if CONFIG_DEVEL
	help
	  A powerful and secure superserver
	  
	  http://www.xinetd.org/
	  
```

## package/zlib/Config.in
```kconfig
config BR2_PACKAGE_ZLIB
	prompt "zlib.............................. Library implementing the deflate compression method"
	tristate
	default m if CONFIG_DEVEL
	help
	  A library implementing the 'deflate' compression method
	  
	  http://www.zlib.net/
```

## target/Config.in
```kconfig
source "tmp/.config-target.in"

# Kernel/Hardware features

config HAS_SPE_FPU
	depends powerpc
	select HAS_FPU
	bool

config HAS_FPU
	bool

config AUDIO_SUPPORT
	bool

config GPIO_SUPPORT
	bool

config PCI_SUPPORT
	select AUDIO_SUPPORT
	bool

config PCIE_SUPPORT
	bool

config PCMCIA_SUPPORT
	bool

config USB_SUPPORT
	select AUDIO_SUPPORT
	bool

config USB_GADGET_SUPPORT
	bool

config RTC_SUPPORT
	bool

config BIG_ENDIAN
	bool

config USES_INITRAMFS
	bool

config USES_SQUASHFS
	bool

config USES_JFFS2
	bool

config USES_EXT4
	bool

config USES_TARGZ
	bool

config USES_CPIOGZ
	bool

config USES_UBIFS
	bool

config PROFILE_KCONFIG
	bool

config NOMMU
	bool

# Architecture selection

config arm
	bool

config armeb
	select BIG_ENDIAN
	bool

config avr32
	select BIG_ENDIAN
	bool

config cris
	bool

config i386
	bool

config i686
	bool 

config m68k
	bool

config mips
	select BIG_ENDIAN
	bool

config mipsel
	bool

config mips64
	select BIG_ENDIAN
	bool

config mips64el
	bool

config powerpc
	select BIG_ENDIAN
	bool

config powerpc64
	select BIG_ENDIAN
	bool

config sh3
	bool

config sh3eb
	select BIG_ENDIAN
	bool

config sh4
	bool

config sh4eb
	select BIG_ENDIAN
	bool

config sparc
	select BIG_ENDIAN
	bool

config ubicom32
	select BIG_ENDIAN
	bool

config x86_64
	bool

config ARCH
	string
	default "arm"       if arm
	default "armeb"     if armeb
	default "avr32"     if avr32
	default "cris"      if cris
	default "i386"      if i386
	default "i686"      if i686
	default "m68k"      if m68k
	default "mips"      if mips
	default "mipsel"    if mipsel
	default "mips64"    if mips64
	default "mips64el"  if mips64el
	default "powerpc"   if powerpc
	default "sh3"       if sh3
	default "sh3eb"     if sh3eb
	default "sh4"       if sh4
	default "sh4eb"     if sh4eb
	default "sparc"     if sparc
	default "ubicom32"  if ubicom32
	default "x86_64"    if x86_64
```

## target/device/Config.in
```kconfig
choice
	prompt "Device Support"
	default BR2_TARGET_ALL

config BR2_TARGET_ALL
	bool "Support for all devices"

config BR2_TARGET_LINKSYS_WRT54G
    bool "Linksys WRT54G Support"

config BR2_TARGET_LINKSYS_WRT54GS
    bool "Linksys WRT54GS Support"

config BR2_TARGET_ASUS_WL500G
	bool "Asus WL-500g Support"

endchoice
```

## target/image/x86/Config.in
```kconfig
config X86_GRUB_IMAGES
	bool "Build GRUB images (Linux x86 or x86_64 host only)"
	depends LINUX_2_6_X86
	depends TARGET_ROOTFS_EXT2FS || TARGET_ROOTFS_JFFS2
	default y

config X86_GRUB_BAUDRATE
	int "Serial port baud rate"
	depends X86_GRUB_IMAGES
	default 38400

config X86_GRUB_KERNELPART
	int "Kernel partition size (in MB)"
	depends X86_GRUB_IMAGES
	default 4

config X86_GRUB_FSPART
	int "Filesystem partition size (in MB)"
	depends X86_GRUB_IMAGES
	default 16
```

## target/jffs2/Config.in
```kconfig
config BR2_TARGET_ROOTFS_JFFS2
	bool "jffs2"
	help
	  Build a jffs2 root filesystem
```
