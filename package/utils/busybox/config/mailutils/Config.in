## target/linux/Config.in
```kconfig
menu "Kernel Configuration / Device Support"

comment "Kernel modules"

menu "Block devices support"

config PACKAGE_KMOD_LOOP
	prompt "kmod-loop......................... Loop mount support"
	tristate
	default m
	help
	  Kernel module for loop mount support

config PACKAGE_KMOD_NBD
	prompt "kmod-nbd.......................... Network Block Device"
	tristate
	default m
	help
	  Kernel module for network block device

endmenu

menu "Filesystems support"

config PACKAGE_KMOD_FS_CIFS
	prompt "kmod-fs-cifs...................... CIFS support"
	tristate
	default m
	help
	  Kernel modules for CIFS support

config PACKAGE_KMOD_FS_EXT2
	prompt "kmod-fs-ext2...................... EXT2 filesystem support"
	tristate
	default m
	help
	  Kernel modules for EXT2 filesystem support

config PACKAGE_KMOD_FS_EXT3
	prompt "kmod-fs-ext3...................... EXT3 filesystem support"
	tristate
	default m
	help
	  Kernel modules for EXT3 filesystem support

config PACKAGE_KMOD_FS_HFSPLUS
	prompt "kmod-fs-hfsplus................... HFS+ filesystem support"
	tristate
	default m
	help
	  Kernel modules for HFS+ filesystem support

config PACKAGE_KMOD_FS_NFS
	prompt "kmod-fs-nfs....................... NFS support"
	tristate
	default m
	help
	  Kernel modules for NFS support
	  Includes lockd, nfs and sunrpc

config PACKAGE_KMOD_FS_VFAT
	prompt "kmod-fs-vfat...................... VFAT filesystem support"
	tristate
	default m
	help
	  Kernel modules for VFAT filesystem support
	  useful for usb mass storage devices

config PACKAGE_KMOD_FS_XFS
	prompt "kmod-fs-xfs....................... XFS filesystem support"
	tristate
	default m
	help
	  Kernel modules for XFS filesystem support

endmenu

menu "Multimedia devices support"

config PACKAGE_KMOD_PWC
	prompt "kmod-pwc.......................... Kernel driver for USB Philips Cameras"
	tristate
	depends PACKAGE_kmod-usb-core
	default m

config PACKAGE_KMOD_VIDEODEV
	prompt "kmod-videodev..................... Video (For Linux) kernel support"
	tristate
	default m

endmenu

menu "Native Language support"

config PACKAGE_KMOD_NLS_BASE
	prompt "kmod-nls-base..................... Native Language support"
	tristate
	default m
	help
	  Kernel native language support

config PACKAGE_KMOD_NLS_CP437
	prompt   "kmod-nls-cp437.................. Codepage 437 (United States, Canada)"
	tristate
	default m
	depends PACKAGE_KMOD_NLS_BASE
	help
	  Kernel native language support

config PACKAGE_KMOD_NLS_CP850
	prompt   "kmod-nls-cp850.................. Codepage 850 (Europe)"
	tristate
	default m
	depends PACKAGE_KMOD_NLS_BASE
	help
	  Kernel native language support

config PACKAGE_KMOD_NLS_ISO8859_1
	prompt   "kmod-nls-iso8859-1.............. NLS ISO 8859-1 (Latin 1; Western European Languages)"
	tristate
	default m
	depends PACKAGE_KMOD_NLS_BASE
	help
	  Kernel native language support

config PACKAGE_KMOD_NLS_ISO8859_15
	prompt   "kmod-nls-iso8859-15............. NLS ISO 8859-15 (Latin 15; Western European Languages with Euro)"
	tristate
	default m
	depends PACKAGE_KMOD_NLS_BASE
	help
	  Kernel native language support

config PACKAGE_KMOD_NLS_UTF8
	prompt   "kmod-nls-utf8................... NLS UTF8"
	tristate
	default m
	depends PACKAGE_KMOD_NLS_BASE
	help
	  Kernel native language support

endmenu

menu "Network devices support"
	depends LINUX_2_4_X86 || LINUX_2_6_X86


config PACKAGE_KMOD_NET_AIRO
	prompt "kmod-net-airo..................... Cisco/Aironet 34X/35X/4500/4800 ISA and PCI cards kernel support"
	tristate
	depends LINUX_2_4_X86 || LINUX_2_6_X86
	default m
	help
	  This is the standard Linux driver to support Cisco/Aironet ISA and 
	  PCI 802.11 wireless cards.
	  It supports the new 802.11b cards from Cisco (Cisco 34X, Cisco 35X 
	  - with or without encryption) as well as card before the Cisco 
	  acquisition (Aironet 4500, Aironet 4800, Aironet 4800B).
	  
	  This driver support both the standard Linux Wireless Extensions 
	  and Cisco proprietary API, so both the Linux Wireless Tools and the 
	  Cisco Linux utilities can be used to configure the card.


config PACKAGE_KMOD_NET_HERMES
	prompt "kmod-net-hermes................... Hermes chipset 802.11b support (Orinoco/Prism2/Symbol) kernel support"
	tristate
	depends LINUX_2_4_X86 || LINUX_2_6_X86
	default m
	help
	  A driver for 802.11b wireless cards based based on the "Hermes" or 
	  Intersil HFA384x (Prism 2) MAC controller.  This includes the vast 
	  majority of the PCMCIA 802.11b cards (which are nearly all rebadges) 
	  - except for the Cisco/Aironet cards.  Cards supported include the 
	  Apple Airport (not a PCMCIA card), WavelanIEEE/Orinoco, 
	  Cabletron/EnteraSys Roamabout, ELSA AirLancer, MELCO Buffalo, Avaya, 
	  IBM High Rate Wireless, Farralon Syyline, Samsung MagicLAN, Netgear 
	  MA401, LinkSys WPC-11, D-Link DWL-650, 3Com AirConnect, Intel 
	  PRO/Wireless, and Symbol Spectrum24 High Rate amongst others.

config PACKAGE_KMOD_NET_HERMES_PCI
	prompt   "kmod-net-hermes-pci............. Intersil Prism 2.5 PCI 802.11b adaptor support"
	tristate
	default m
	depends PACKAGE_KMOD_NET_HERMES
	help
	  Enable support for PCI and mini-PCI 802.11b wireless NICs based on 
	  the Prism 2.5 chipset.  These are true PCI cards, not the 802.11b 
	  PCMCIA cards bundled with PCI<->PCMCIA adaptors which are also 
	  common.  Some of the built-in wireless adaptors in laptops are of 
	  this variety.

config PACKAGE_KMOD_NET_HERMES_PLX
	prompt   "kmod-net-hermes-plx............. Hermes in PLX9052 based PCI adaptor (Netgear MA301, etc.) kernel support"
	tristate
	default m
	depends PACKAGE_KMOD_NET_HERMES
	help
	  Enable support for PCMCIA cards supported by the "Hermes" (aka 
	  orinoco_cs) driver when used in PLX9052 based PCI adaptors.  These 
	  adaptors are not a full PCMCIA controller but act as a more limited 
	  PCI <-> PCMCIA bridge.  Several vendors sell such adaptors so that 
	  802.11b PCMCIA cards can be used in desktop machines.  The Netgear 
	  MA301 is such an adaptor.



config PACKAGE_KMOD_NET_PRISM54
	prompt "kmod-net-prism54.................. Intersil Prism GT/Duette/Indigo PCI/PCMCIA cards kernel support"
	tristate
	depends LINUX_2_4_X86 || LINUX_2_6_X86 || LINUX_2_4_BRCM || LINUX_2_6_BRCM
	default m
	help
	  Enable PCI and Cardbus support for the following chipset based cards: 
	  
	   * ISL3880 - Prism GT       802.11 b/g
	   * ISL3877 - Prism Indigo   802.11 a
	   * ISL3890 - Prism Duette   802.11 a/b/g
	  
	  For a complete list of supported cards visit <http://prism54.org>.
	  Here is the latest confirmed list of supported cards: 
	  
	   * 3com OfficeConnect 11g Cardbus Card aka 3CRWE154G72
	   * Allnet ALL0271 PCI Card
	   * Compex WL54G Cardbus Card
	   * Corega CG-WLCB54GT Cardbus Card
	   * D-Link Air Plus Xtreme G A1 Cardbus Card aka DWL-g650
	   * I-O Data WN-G54/CB Cardbus Card
	   * Kobishi XG-300 aka Z-Com Cardbus Card
	   * Netgear WG511 Cardbus Card
	   * Ovislink WL-5400PCI PCI Card
	   * Peabird WLG-PCI PCI Card
	   * Sitecom WL-100i Cardbus Card
	   * Sitecom WL-110i PCI Card
	   * SMC2802W - EZ Connect g 2.4GHz 54 Mbps Wireless PCI Card
	   * SMC2835W - EZ Connect g 2.4GHz 54 Mbps Wireless Cardbus Card
	   * Z-Com XG-900 PCI Card
	   * Zyxel G-100 Cardbus Card
	  
	  If you enable this, you require a firmware file as well.
	  You will need to copy this to /usr/lib/hotplug/firmware/isl3890.
	  You can get this non-GPL'd firmware file from the Prism54 project page: 
	  <http://prism54.org>.
	  
	  Note: You need a motherboard with DMA support to use any of these cards.

endmenu

menu "PCMCIA/CardBus support"
	depends PCMCIA_SUPPORT

config PACKAGE_KMOD_PCMCIA_CORE
	prompt "kmod-pcmcia-core.................. PCMCIA/CardBus support"
	tristate
	default m

config PACKAGE_KMOD_PCMCIA_SERIAL
	prompt   "kmod-pcmcia-serial.............. PCMCIA/CardBus serial device support"
	tristate
	default m
	depends PACKAGE_KMOD_PCMCIA_CORE

endmenu


menu "Misc. devices support"

config PACKAGE_KMOD_AX25
	prompt "kmod-ax25......................... AX25 support"
	tristate
	default m
	help
	  Kernel modules for AX25 protocol family
	  
	  This package contains both the AX25 layer 2 support (ax25) and AX25 KISS driver (mkiss)

config PACKAGE_KMOD_BLUETOOTH
	prompt "kmod-bluetooth.................... Bluetooth drivers and network stack"
	tristate
	depends PCI_SUPPORT || USB_SUPPORT
	default m
	help
	  Bluetooth drivers and network stack

config PACKAGE_KMOD_LP
	prompt "kmod-lp........................... Parallel port and lp support"
	tristate
	default m
	help
	  Kernel modules for line printer and parallel port support

config PACKAGE_KMOD_SOFTDOG
	prompt "kmod-softdog...................... Software watchdog"
	tristate
	default m
	help
	  Kernel modules for software watchdog driver

endmenu

endmenu
```

## target/linux/adm5120-2.6/files/arch/mips/adm5120/Kconfig
```kconfig
if MIPS_ADM5120

menu "ADM5120 Implementation Options"

config PCI_ADM5120
	bool "Enable PCI support"
	select PCI
	default y

endmenu

endif
```

## target/linux/adm5120/files/arch/mips/adm5120/Kconfig
```kconfig
if MIPS_ADM5120

menu "ADM5120 Implementation Options"

config ADM5120_CPU_OVERRIDES
	bool "Enable CPU feature overrides"
	default y

config PCI_ADM5120
	bool "Enable PCI support"
	select PCI
	default y

endmenu

config ARM_AMBA
	bool
	default y

endif
```
