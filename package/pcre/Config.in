## package/ppp/Config.in
```kconfig
menu "ppp............................... PPP (Point-to-Point Protocol) daemon"

config BR2_PACKAGE_PPP
	prompt "ppp............................... PPP (Point-to-Point Protocol) daemon"
	tristate
	default n if BR2_LINUX_2_6_ARUBA
	default y
	select BR2_PACKAGE_KMOD_PPP

config BR2_PACKAGE_PPP_WITH_FILTER
	prompt "Enable filter support"
	bool
	default y

config BR2_PACKAGE_PPP_MOD_PPPOA
	prompt   "ppp-mod-pppoa................... PPPoA (PPP over ATM) plugin"
	tristate
	default y if BR2_LINUX_2_4_AR7
	depends on BR2_PACKAGE_PPP
	select BR2_PACKAGE_KMOD_PPPOATM

config BR2_PACKAGE_PPP_MOD_PPPOE
	prompt   "ppp-mod-pppoe................... PPPoE (PPP over Ethernet) plugin"
	tristate
	default y
	depends on BR2_PACKAGE_PPP
	select BR2_PACKAGE_KMOD_PPPOE

config BR2_PACKAGE_PPP_MOD_RADIUS
	prompt   "ppp-mod-radius.................. RADIUS (Remote Authentication Dial-In User Service) plugin"
	tristate
	default m if CONFIG_DEVEL
	depends on BR2_PACKAGE_PPP

config BR2_PACKAGE_CHAT
	prompt   "chat............................ Utility to establish conversation with other PPP servers (via a modem)"
	tristate
	default m if CONFIG_DEVEL
	depends on BR2_PACKAGE_PPP

config BR2_PACKAGE_PPPDUMP
	prompt   "pppdump......................... Utility to read PPP record file"
	tristate
	default m if CONFIG_DEVEL
	depends on BR2_PACKAGE_PPP

config BR2_PACKAGE_PPPSTATS
	prompt   "pppstats........................ Utility to report PPP statistics"
	tristate
	default m if CONFIG_DEVEL
	depends on BR2_PACKAGE_PPP

endmenu
```

## package/pptp/Config.in
```kconfig
config PACKAGE_PPTP
	prompt "pptp.............................. PPTP (Point-to-Point Tunneling Protocol) client"
	tristate
	default m if DEVEL
	select PACKAGE_KMOD_GRE
	select PACKAGE_PPP
	help
	  A Point-to-Point Tunneling Protocol Client 
	  
	  http://pptpclient.sourceforge.net/
```

## package/ptunnel/Config.in
```kconfig
config BR2_PACKAGE_PTUNNEL
	prompt "ptunnel........................... Tunnel TCP connections over ICMP packets"
	tristate 
	default m if CONFIG_DEVEL
	select BR2_PACKAGE_LIBPCAP
	select BR2_PACKAGE_LIBPTHREAD
	help
	  ptunnel is an application that allows you to reliably tunnel TCP connections to
	  a remote host using ICMP echo request and reply packets, commonly known as ping
	  requests and replies. It acts as a proxy and can handle sockets and secured
	  identification.

	  http://www.cs.uit.no/~daniels/PingTunnel/
```

## package/pwm-gpio-custom/src/Kconfig
```kconfig
config PWM_MASTER_GPIO_CUSTOM
	tristate "Custom GPIO-based PWM driver"
	depends on GENERIC_GPIO
	select PWM_GENERIC_GPIO
```

## package/quagga/Config.in
```kconfig
menu "quagga - the Quagga Software Routing Suite"

config BR2_PACKAGE_QUAGGA
	prompt "quagga - the Quagga Software Routing Suite"
	tristate
	default m if CONFIG_DEVEL
	help
	  A routing software package that provides TCP/IP based routing services
	  with routing protocols support such as RIPv1, RIPv2, RIPng, OSPFv2, 
	  OSPFv3, BGP-4, and BGP-4+
	  
	  http://www.quagga.net/

config BR2_PACKAGE_QUAGGA_BGPD
	depends BR2_PACKAGE_QUAGGA
	prompt "...-bgpd - BGPv4, BGPv4+, BGPv4- routing engine"
	tristate
	default m if CONFIG_DEVEL
	help
	  A BGPv4, BGPv4+, BGPv4- routing engine for use with Quagga routing
	  software.

config BR2_PACKAGE_QUAGGA_OSPFD
	depends BR2_PACKAGE_QUAGGA
	prompt "...-ospfd - OSPFv2 routing engine"
	tristate
	default m if CONFIG_DEVEL
	help
	  An OSPFv2 (IPv4) routing engine for use with Quagga routing software.

config BR2_PACKAGE_QUAGGA_OSPF6D
	depends BR2_PACKAGE_QUAGGA
	prompt "...-ospf6d - OSPFv3 routing engine"
	tristate
	default m if CONFIG_DEVEL
	help
	  An OSPFv3 (IPv6) routing engine for use with Quagga routing software.

config BR2_PACKAGE_QUAGGA_RIPD
	depends BR2_PACKAGE_QUAGGA
	prompt "...-ripd - RIP routing engine"
	tristate
	default m if CONFIG_DEVEL
	help
	  A RIP (IPv4) routing engine for use with Quagga routing software.

config BR2_PACKAGE_QUAGGA_RIPNGD
	depends BR2_PACKAGE_QUAGGA
	prompt "...-ripngd - RIPNG routing engine"
	tristate
	default m if CONFIG_DEVEL
	help
	  A RIPNG (IPv6) routing engine for use with Quagga routing software.

config BR2_PACKAGE_QUAGGA_VTYSH
	depends BR2_PACKAGE_QUAGGA
	select BR2_PACKAGE_LIBREADLINE
	select BR2_PACKAGE_LIBNCURSES
	prompt "...-vtysh - integrated shell for Quagga routing software"
	tristate
	default m if CONFIG_DEVEL
	help
	  vtysh lets you interact with all the Quagga routing daemons
	  at once in an integrated shell.

endmenu
```

## package/radvd/Config.in
```kconfig
config BR2_PACKAGE_RADVD
	tristate "radvd - IPv6 Routing Advertisement Daemon"
	default m if CONFIG_DEVEL
	select BR2_PACKAGE_KMOD_IPV6
	help
	  Routing Advertisement Daemon for IPv6
	  
	  http://v6web.litech.org/radvd/
	  
```

## package/readline/Config.in
```kconfig
config BR2_COMPILE_READLINE
	tristate
	default n
	depends BR2_PACKAGE_LIBREADLINE

config BR2_PACKAGE_LIBREADLINE
	prompt "libreadline....................... Command lines edition library"
	tristate
	default m if CONFIG_DEVEL
	select BR2_COMPILE_READLINE
	help
	  The Readline library provides a set of functions for use by applications 
	  that allow users to edit command lines as they are typed in. Both Emacs 
	  and vi editing modes are available. The Readline library includes 
	  additional functions to maintain a list of previously-entered command 
	  lines, to recall and perhaps reedit those lines, and perform csh-like 
	  history expansion on previous commands.
	  
	  http://cnswww.cns.cwru.edu/php/chet/readline/rltop.html
```

## package/reaim/Config.in
```kconfig
config BR2_PACKAGE_REAIM
	prompt "reaim............................. A transparent AIM / MSN proxy"
	tristate
	default m if CONFIG_DEVEL
	help
	  ReAIM is a proxy for file transfers with MSN/AIM.
	  
	  http://reaim.sourceforge.net/
```

## package/robocfg/Config.in
```kconfig
config BR2_PACKAGE_ROBOCFG
	prompt "robocfg........................... BCM5325E/536x switch configuration utility"
	tristate
	default y if BR2_LINUX_2_6_BRCM
	default m if CONFIG_DEVEL
	help
	  Broadcom BCM5325E/536x switch configuration utility
```

## package/rp-pppoe/Config.in
```kconfig
menu "pppoe - Roaring Penguin PPPoE (PPP over Ethernet) implementation"

config BR2_COMPILE_RP_PPPOE
	bool
	default n
	depends BR2_PACKAGE_PPPOE_CLIENT || BR2_PACKAGE_PPPOE_RELAY || BR2_PACKAGE_PPPOE_SERVER || BR2_PACKAGE_PPPOE_SNIFF

config BR2_PACKAGE_PPPOE_CLIENT
	tristate
	prompt "pppoe-client - PPPoE (PPP over Ethernet) client"
	default m if DEVELOPER
	select BR2_COMPILE_RP_PPPOE
	select BR2_PACKAGE_PPP
	help
	  PPPoE (PPP over Ethernet) client
	  
	  http://roaringpenguin.com/penguin/open_source_rp-pppoe.php
	  

config BR2_PACKAGE_PPPOE_RELAY
	tristate
	prompt "pppoe-relay - PPPoE (PPP over Ethernet) relay"
	default m if DEVELOPER
	select BR2_COMPILE_RP_PPPOE
	help
	  PPPoE (PPP over Ethernet) relay
	  
	  http://roaringpenguin.com/penguin/open_source_rp-pppoe.php
	  

config BR2_PACKAGE_PPPOE_SERVER
	tristate
	prompt "pppoe-server - PPPoE (PPP over Ethernet) server"
	default m if DEVELOPER
	select BR2_COMPILE_RP_PPPOE
	select BR2_PACKAGE_PPP
	help
	  PPPoE (PPP over Ethernet) server
	  
	  http://roaringpenguin.com/penguin/open_source_rp-pppoe.php
	  

config BR2_PACKAGE_PPPOE_SNIFF
	tristate
	prompt "pppoe-sniff - PPPoE (PPP over Ethernet) frame sniffer"
	default m if BR2_COMPILE_RP_PPPOE
	select BR2_PACKAGE_RP_PPPOE
	help
	  PPPoE (PPP over Ethernet) frame sniffer
	  
	  http://roaringpenguin.com/penguin/open_source_rp-pppoe.php
	  

endmenu
```

## package/rrdcollect/Config.in
```kconfig
config BR2_PACKAGE_RRDCOLLECT
	prompt "rrdcollect........................ Round-Robin Database (RRD) collecting daemon"
	tristate
	default m if CONFIG_DEVEL
	depends BR2_PACKAGE_LIBRRD || BR2_PACKAGE_LIBRRD1
	help
	  RRDcollect is a daemon which polls ceratin files in /proc/
	  directory, gathering data and storing it inside RRDtool's
	  database files.  Being written in C should be both fast
	  and resources-friendly.  Supports both scanf(3)-style
	  pattern matches and perl compatible regular expressions.
	  
	  http://rrdcollect.sourceforge.net/
	  
	  This package contains only the deamon program.

config BR2_PACKAGE_RRDCOLLECT_EXAMPLE
	prompt   "rrdcollect-example.............. Example setup for RRD collecting daemon above"
	tristate
	default m if CONFIG_DEVEL
	depends BR2_PACKAGE_RRDCOLLECT
	help
	  RRDcollect is a daemon which polls ceratin files in /proc/
	  directory, gathering data and storing it inside RRDtool's
	  database files.  Being written in C should be both fast
	  and resources-friendly.  Supports both scanf(3)-style
	  pattern matches and perl compatible regular expressions.
	  
	  http://rrdcollect.sourceforge.net/
	  
	  This packages contains programs and configuration files to 
	  start graphing a basic set of ressources on your router.
```

## package/rrdtool/Config.in
```kconfig
config BR2_COMPILE_RRDTOOL
	prompt "rrdtool........................... Round Robin Database (RRD) tools (v1.2.x)"
	bool
	default n

config BR2_PACKAGE_LIBRRD
	prompt   "librrd.......................... Round Robin Database (RRD) management library (v1.2.x)"
	tristate
	default n
	depends BR2_COMPILE_RRDTOOL
	select BR2_PACKAGE_LIBART
	select BR2_PACKAGE_LIBFREETYPE
	select BR2_PACKAGE_LIBPNG
	select BR2_PACKAGE_ZLIB
	help
	  RRD is the Acronym for Round Robin Database. RRD is a system to store and
	  display time-series data (i.e. network bandwidth, machine-room temperature,
	  server load average). It stores the data in a very compact way that will
	  not expand over time, and it presents useful graphs by processing the data
	  to enforce a certain data density. It can be used either via simple wrapper
	  scripts (from shell or Perl) or via frontends that poll network devices and
	  put friendly user interface on it.
	  
	  http://people.ee.ethz.ch/~oetiker/webtools/rrdtool/
	  
	  This package contains command line tools used to manage RRDs.

config BR2_PACKAGE_RRDCGI
	prompt   "rrdcgi.......................... Round Robin Database (RRD) CGI graphing tool (v1.2.x)"
	tristate
	default n
	depends BR2_COMPILE_RRDTOOL
	select BR2_PACKAGE_LIBRRD
	select BR2_PACKAGE_CGILIB
	help
	  RRD is the Acronym for Round Robin Database. RRD is a system to store and
	  display time-series data (i.e. network bandwidth, machine-room temperature,
	  server load average). It stores the data in a very compact way that will
	  not expand over time, and it presents useful graphs by processing the data
	  to enforce a certain data density. It can be used either via simple wrapper
	  scripts (from shell or Perl) or via frontends that poll network devices and
	  put friendly user interface on it.
	  
	  http://people.ee.ethz.ch/~oetiker/webtools/rrdtool/
	  
	  This package contains the rrdcgi tool used to create web pages containing 
	  RRD graphs based on templates.

config BR2_PACKAGE_RRDTOOL
	prompt   "rrdtool......................... Round Robin Database (RRD) management tools (v1.2.x)"
	tristate
	default n
	depends BR2_COMPILE_RRDTOOL
	select BR2_PACKAGE_LIBRRD
	help
	  RRD is the Acronym for Round Robin Database. RRD is a system to store and
	  display time-series data (i.e. network bandwidth, machine-room temperature,
	  server load average). It stores the data in a very compact way that will
	  not expand over time, and it presents useful graphs by processing the data
	  to enforce a certain data density. It can be used either via simple wrapper
	  scripts (from shell or Perl) or via frontends that poll network devices and
	  put friendly user interface on it.
	  
	  http://people.ee.ethz.ch/~oetiker/webtools/rrdtool/
	  
	  This package contains command line tools used to manage RRDs.
```

## package/rsync/Config.in
```kconfig
config BR2_PACKAGE_RSYNC
	tristate "rsync - file transfer utility"
	select BR2_PACKAGE_LIBPOPT
	default m if CONFIG_DEVEL
	help

	utility that provides fast incremental file transfer

	http://rsync.samba.org
```
