## package/pcre/Config.in
```kconfig
config BR2_COMPILE_PCRE
	tristate
	default n
	depends BR2_PACKAGE_LIBPCRE

config BR2_PACKAGE_LIBPCRE
	prompt "libpcre........................... A Perl Compatible Regular Expression library"
	tristate
	default m if CONFIG_DEVEL
	select BR2_COMPILE_PCRE
	help
	  A Perl Compatible Regular Expression library
	  
	  http://www.pcre.org/
```

## package/peercast/Config.in
```kconfig
config BR2_PACKAGE_PEERCAST
	prompt "peercast.......................... P2P audio and video streaming server"
	tristate
	default m if CONFIG_DEVEL
	select BR2_PACKAGE_LIBPTHREAD
	select BR2_PACKAGE_UCLIBCXX
	help
	  PeerCast is a fresh new P2P streaming server. It can stream music
	  and video from a broad variety of formats. Many audio players can 
	  listen to peercast streams, as it's been built to remain compatible 
	  with Nullsoft Shoutcast.
	  
	  http://www.peercast.org/
```

## package/peerguardian/Config.in
```kconfig
config BR2_PACKAGE_PEERGUARDIAN
	prompt "peerguardian...................... PeerGuardian for Linux"
	tristate
	select BR2_PACKAGE_LIBPTHREAD
	default m if CONFIG_DEVEL
	help
		PeerGuardian helps protect your privacy by blocking many ranges
		of aggressive IPs while you use P2P.

		http://phoenixlabs.org/
```

## package/php4/Config.in
```kconfig
menu "php4.............................. PHP4 Hypertext preprocessor"

config BR2_COMPILE_PHP4
	tristate
	default y
	depends BR2_PACKAGE_PHP4_CLI || BR2_PACKAGE_PHP4_CGI || BR2_PACKAGE_PHP4_FASTCGI
	 
comment "Server API ---"

config BR2_PACKAGE_PHP4_CLI
	prompt "php4-cli.......................... PHP4 CLI (Command Line Interface)"
	tristate 
	default m if CONFIG_DEVEL
	select BR2_COMPILE_PHP4
	select BR2_PACKAGE_LIBOPENSSL
	select BR2_PACKAGE_ZLIB
	help
	 PHP is a widely-used general-purpose scripting language that is especially 
	 suited for Web development and can be embedded into HTML.
	 
	 http://www.php.net/

config BR2_PACKAGE_PHP4_CGI
	prompt "php4-cgi.......................... PHP4 built for CGI"
	tristate 
	default m if CONFIG_DEVEL
	select BR2_COMPILE_PHP4
	select BR2_PACKAGE_LIBOPENSSL
	select BR2_PACKAGE_ZLIB
	help
	 PHP is a widely-used general-purpose scripting language that is especially 
	 suited for Web development and can be embedded into HTML.
	 
	 http://www.php.net/

config BR2_PACKAGE_PHP4_FASTCGI
	prompt "php4-fastcgi...................... PHP4 built for FastCGI"
	tristate 
	default m if CONFIG_DEVEL
	select BR2_COMPILE_PHP4
	select BR2_PACKAGE_LIBOPENSSL
	select BR2_PACKAGE_ZLIB
	help
	 PHP is a widely-used general-purpose scripting language that is especially 
	 suited for Web development and can be embedded into HTML.
	 
	 http://www.php.net/

comment "Extensions ---"

config BR2_PACKAGE_PHP4_MOD_CURL
	prompt "php4-mod-curl..................... cURL module"
	tristate 
	default m if CONFIG_DEVEL
	depends BR2_COMPILE_PHP4
	select BR2_PACKAGE_LIBCURL

config BR2_PACKAGE_PHP4_MOD_FTP
	prompt "php4-mod-ftp...................... FTP module"
	tristate 
	default m if CONFIG_DEVEL
	depends BR2_COMPILE_PHP4

config BR2_PACKAGE_PHP4_MOD_GD
	prompt "php4-mod-gd....................... GD graphics library module"
	tristate 
	default m if CONFIG_DEVEL
	depends BR2_COMPILE_PHP4
	select BR2_PACKAGE_LIBGD
	select BR2_PACKAGE_LIBPNG

config BR2_PACKAGE_PHP4_MOD_GMP
	prompt "php4-mod-gmp...................... GMP module"
	tristate 
	default m if CONFIG_DEVEL
	depends BR2_COMPILE_PHP4
	select BR2_PACKAGE_LIBGMP

config BR2_PACKAGE_PHP4_MOD_LDAP
	prompt "php4-mod-ldap..................... LDAP module"
	tristate 
	default m if CONFIG_DEVEL
	depends BR2_COMPILE_PHP4
	select BR2_PACKAGE_LIBOPENLDAP

config BR2_PACKAGE_PHP4_MOD_MYSQL
	prompt "php4-mod-mysql.................... MySQL module"
	tristate 
	default m if CONFIG_DEVEL
	depends BR2_COMPILE_PHP4
	select BR2_PACKAGE_LIBMYSQLCLIENT

config BR2_PACKAGE_PHP4_MOD_OPENSSL
	prompt "php4-mod-openssl.................. OpenSSL module"
	tristate 
	default m if CONFIG_DEVEL
	depends BR2_COMPILE_PHP4
	select BR2_PACKAGE_LIBOPENSSL

config BR2_PACKAGE_PHP4_MOD_PCRE
	prompt "php4-mod-pcre..................... PCRE module"
	tristate 
	default m if CONFIG_DEVEL
	depends BR2_COMPILE_PHP4
	select BR2_PACKAGE_LIBPCRE

config BR2_PACKAGE_PHP4_MOD_PGSQL
	prompt "php4-mod-pgsql.................... PostgreSQL module"
	tristate 
	default m if CONFIG_DEVEL
	depends BR2_COMPILE_PHP4
	select BR2_PACKAGE_LIBPQ

config BR2_PACKAGE_PHP4_MOD_SESSION
	prompt "php4-mod-session.................. Sessions module"
	tristate 
	default m if CONFIG_DEVEL
	depends BR2_COMPILE_PHP4

config BR2_PACKAGE_PHP4_MOD_SQLITE
	prompt "php4-mod-sqlite................... SQLite module"
	tristate 
	default m if CONFIG_DEVEL
	depends BR2_COMPILE_PHP4
	select BR2_PACKAGE_LIBSQLITE2

config BR2_PACKAGE_PHP4_MOD_SOCKETS
	prompt "php4-mod-sockets.................. Sockets module"
	tristate 
	default m if CONFIG_DEVEL
	depends BR2_COMPILE_PHP4

config BR2_PACKAGE_PHP4_MOD_XML
	prompt "php4-mod-xml...................... XML module"
	tristate 
	default m if CONFIG_DEVEL
	depends BR2_COMPILE_PHP4
	select BR2_PACKAGE_LIBEXPAT

endmenu
```

## package/picocom/Config.in
```kconfig
config BR2_PACKAGE_PICOCOM
	tristate "picocom - minimal dumb-terminal emulation program"
#	default m if CONFIG_DEVEL
	default n
	help
	  As its name suggests, picocom is a minimal dumb-terminal emulation 
	  program. It is, in principle, very much like minicom, only it's pico 
	  instead of mini! It was designed to serve as a simple, manual, modem 
	  configuration, testing, and debugging tool. It has also served (quite 
	  well) as a low-tech "terminal-window" to allow operator intervention 
	  in PPP connection scripts. It could also prove useful in many other 
	  similar tasks.
	  
	  http://efault.net/npat/hacks/picocom/
	  
```

## package/pjsip/Config.in
```kconfig
config PJSIP_SPEEX
	bool "Speex support"
	depends on PACKAGE_pjsip
	default n
	help
		Enable speex codec.

config PJSIP_OSS
	bool "OSS support"
	depends on PACKAGE_pjsip
	default n
	help
		Enable OSS.

config PJSIP_SOUND
	bool "Sound support"
	depends on PACKAGE_pjsip
	default n
	help
		Enable sound.

config PJSIP_LTQ_TAPI
	bool "Lantiq TAPI sound device support"
	depends on PACKAGE_pjsip && TARGET_lantiq_xway
	default n
	help
		Enable Lantiq Tapi.
```

## package/platform/lantiq/ltq-hcd/src/Kconfig
```kconfig
config USB_HOST_IFX
	tristate "Infineon USB Host Controller Driver"
	depends on USB
	default n
	help
	Infineon USB Host Controller

choice
	prompt "Infineon USB Host Controller Driver Operation mode"
	depends on USB_HOST_IFX && ( AMAZON_S || AR9 || VR9 || AR10 ||  MIPS_AMAZON_S || MIPS_AR9 || MIPS_VR9 || MIPS_AR10 )
	help
	   The IFX USB core can be configured as dual-host and single host.
	   The unused core can be set as Device-mode.

config USB_HOST_IFX_B
	boolean "USB host mode on core 1 and 2"
	help
	Both cores run as host

config USB_HOST_IFX_1
	boolean "USB host mode on core 1 only"
	help
	Core #1 runs as host

config USB_HOST_IFX_2
	boolean "USB host mode on core 2 only"
	help
	Core #2 runs as host

endchoice

config USB_HOST_IFX_FORCE_USB11
	boolean "Forced USB1.1"
	depends on USB_HOST_IFX
	default n
	help
	force to be USB 1.1

config USB_HOST_IFX_WITH_HS_ELECT_TST
	boolean "With HS_Electrical Test"
	depends on USB_HOST_IFX
	default n
	help
	With USBIF HSET routines

config USB_HOST_IFX_WITH_ISO
	boolean "With ISO transfer"
	depends on USB_HOST_IFX
	default n
	help
	With USBIF ISO transfer

config USB_HOST_IFX_COC
	boolean "CoC in USB Host"
	depends on USB_HOST_IFX
	default n
	help
	With CoC on Host

choice
	prompt "IFX unaligned buffer policy"
	depends on USB_HOST_IFX
	help
	   IFX unaligned buffer policy

config USB_HOST_IFX_UNALIGNED_ADJ
	boolean "Adjust"
	help
	USB_HOST_IFX_UNALIGNED_ADJ

config USB_HOST_IFX_UNALIGNED_CHK
	boolean "Check-only"
	help
	USB_HOST_IFX_UNALIGNED_CHK

config USB_HOST_IFX_UNALIGNED_NONE
	boolean "No process"
	help
	USB_HOST_IFX_UNALIGNED_NONE

endchoice


config USB_HOST_IFX_XHCI
        tristate "xHCI HCD (USB 3.0) support (EXPERIMENTAL)"
        depends on USB && PCI && ( VR9 || MIPS_VR9 || AR10 || MIPS_AR10 )
        ---help---
          The eXtensible Host Controller Interface (xHCI) is standard for USB 3.0
          "SuperSpeed" host controller hardware.

          To compile this driver as a module, choose M here: the
          module will be called xhci-hcd.

config USB_HOST_IFX_XHCI_DEBUGGING
        bool "Debugging for the xHCI host controller"
        depends on USB_HOST_IFX_XHCI
        ---help---
          Say 'Y' to turn on debugging for the xHCI host controller driver.
          This will spew debugging output, even in interrupt context.
          This should only be used for debugging xHCI driver bugs.

          If unsure, say N.
```

## package/pmacct/Config.in
```kconfig
menu "pmacct............................ IPv4/IPv6 accounting and aggregation tools"

config BR2_COMPILE_PMACCT
	tristate
	default n
	depends BR2_COMPILE_PMACCT_BASIC || BR2_COMPILE_PMACCT_MYSQL || BR2_COMPILE_PMACCT_PGSQL || BR2_COMPILE_PMACCT_SQLITE || BR2_COMPILE_PMACCT_CUSTOM

config BR2_COMPILE_PMACCT_BASIC
	tristate
	default n
	depends BR2_PACKAGE_NFACCTD_BASIC || BR2_PACKAGE_PMACCTD_BASIC
	select BR2_COMPILE_PMACCT

config BR2_COMPILE_PMACCT_MYSQL
	tristate
	default n
	depends BR2_PACKAGE_NFACCTD_MYSQL || BR2_PACKAGE_PMACCTD_MYSQL
	select BR2_COMPILE_PMACCT

config BR2_COMPILE_PMACCT_PGSQL
	tristate
	default n
	depends BR2_PACKAGE_NFACCTD_PGSQL || BR2_PACKAGE_PMACCTD_PGSQL
	select BR2_COMPILE_PMACCT

config BR2_COMPILE_PMACCT_SQLITE
	tristate
	default n
	depends BR2_PACKAGE_NFACCTD_SQLITE || BR2_PACKAGE_PMACCTD_SQLITE
	select BR2_COMPILE_PMACCT

config BR2_COMPILE_PMACCT_CUSTOM
	tristate
	default n
	depends BR2_PACKAGE_NFACCTD_CUSTOM || BR2_PACKAGE_PMACCTD_CUSTOM
	select BR2_COMPILE_PMACCT

choice
	prompt   "nfacctd......................... NetFlow accounting daemon"
	tristate
	default m if CONFIG_DEVEL
	optional
	help
	  
	  An IPv4/IPv6 Netflow accounting and aggregation daemon
	  
	  http://www.ba.cnr.it/~paolo/pmacct/
	  
	  Depends:
	    - libmysqlclient (for MySQL database logging support)
	    - libpq (for PostgreSQL database logging support)
	    - libsqlite (for SQLite database logging support)


	config BR2_PACKAGE_NFACCTD_BASIC
		prompt     "nfacctd.......................   built without database support"
		tristate
		select BR2_COMPILE_PMACCT_BASIC
		select BR2_PACKAGE_LIBPCAP
	
	config BR2_PACKAGE_NFACCTD_MYSQL
		prompt     "nfacctd-mysql.................   built with MySQL database support"
		tristate
		select BR2_COMPILE_PMACCT_MYSQL
		select BR2_PACKAGE_LIBPCAP
		select BR2_PACKAGE_LIBMYSQLCLIENT
	
	config BR2_PACKAGE_NFACCTD_PGSQL
		prompt     "nfacctd-pgsql.................   built with PostgreSQL database support"
		tristate
		select BR2_COMPILE_PMACCT_PGSQL
		select BR2_PACKAGE_LIBPCAP
		select BR2_PACKAGE_LIBPQ

	config BR2_PACKAGE_NFACCTD_SQLITE
		prompt     "nfacctd-sqlite................   built with SQLite database support"
		tristate
		select BR2_COMPILE_PMACCT_SQLITE
		select BR2_PACKAGE_LIBPCAP
		select BR2_PACKAGE_LIBSQLITE

	config BR2_PACKAGE_NFACCTD_CUSTOM
		prompt     "nfacctd-custom................   customized to your needs"
		tristate
		select BR2_COMPILE_PMACCT_CUSTOM
		select BR2_PACKAGE_LIBPCAP

	config BR2_COMPILE_NFACCTD_ENABLE_DEBUG
		prompt "debug (enable debugging options, useful for bugreports)"
		bool
		default n
		depends BR2_PACKAGE_NFACCTD_CUSTOM

	config BR2_COMPILE_NFACCTD_ENABLE_IPV6
		prompt "IPv6 support"
		bool
		default n
		depends BR2_PACKAGE_NFACCTD_CUSTOM

	config BR2_COMPILE_NFACCTD_WITH_MYSQL
		prompt "MySQL database support"
		bool
		default n
		depends BR2_PACKAGE_NFACCTD_CUSTOM
		select BR2_PACKAGE_LIBMYSQLCLIENT

	config BR2_COMPILE_NFACCTD_WITH_PGSQL
		prompt "PostgreSQL database support"
		bool
		default n
		depends BR2_PACKAGE_NFACCTD_CUSTOM
		select BR2_PACKAGE_LIBPQ

	config BR2_COMPILE_NFACCTD_WITH_SQLITE
		prompt "SQLite database support"
		bool
		default n
		depends BR2_PACKAGE_NFACCTD_CUSTOM
		select BR2_PACKAGE_LIBSQLITE

endchoice

choice
	prompt   "pmacctd......................... IP accounting daemon (libpcap based)"
	tristate
	default m if CONFIG_DEVEL
	optional
	help
	  
	  An IPv4/IPv6 libpcap-based accounting and aggregation daemon
	  
	  http://www.ba.cnr.it/~paolo/pmacct/
	  
	  Depends:
	    - libpcap
	    - libmysqlclient (for MySQL database logging support)
	    - libpq (for PostgreSQL database logging support)
	    - libsqlite (for SQLite database logging support)

	
	config BR2_PACKAGE_PMACCTD_BASIC
		prompt     "pmacctd.......................   built without database support"
		tristate
		select BR2_COMPILE_PMACCT_BASIC
		select BR2_PACKAGE_LIBPCAP

	config BR2_PACKAGE_PMACCTD_MYSQL
		prompt     "pmacctd-mysql.................   built with MySQL database support"
		tristate
		select BR2_COMPILE_PMACCT_MYSQL
		select BR2_PACKAGE_LIBPCAP
		select BR2_PACKAGE_LIBMYSQLCLIENT
	
	config BR2_PACKAGE_PMACCTD_PGSQL
		prompt     "pmacctd-pgsql.................   built with PostgreSQL database support"
		tristate
		select BR2_COMPILE_PMACCT_PGSQL
		select BR2_PACKAGE_LIBPCAP
		select BR2_PACKAGE_LIBPQ

	config BR2_PACKAGE_PMACCTD_SQLITE
		prompt     "pmacctd-sqlite................   built with SQLite database support"
		tristate
		select BR2_COMPILE_PMACCT_SQLITE
		select BR2_PACKAGE_LIBPCAP
		select BR2_PACKAGE_LIBSQLITE

	config BR2_PACKAGE_PMACCTD_CUSTOM
		prompt     "pmacctd-custom................   customized to your needs"
		tristate
		select BR2_COMPILE_PMACCT_CUSTOM
		select BR2_PACKAGE_LIBPCAP
	
	config BR2_COMPILE_PMACCTD_ENABLE_DEBUG
		prompt "debug (enable debugging options, useful for bugreports)"
		bool
		default n
		depends BR2_PACKAGE_PMACCTD_CUSTOM

	config BR2_COMPILE_PMACCTD_ENABLE_IPV6
		prompt "IPv6 support"
		bool
		default n
		depends BR2_PACKAGE_PMACCTD_CUSTOM

	config BR2_COMPILE_PMACCTD_WITH_MYSQL
		prompt "MySQL database support"
		bool
		default n
		depends BR2_PACKAGE_PMACCTD_CUSTOM
		select BR2_PACKAGE_LIBMYSQLCLIENT

	config BR2_COMPILE_PMACCTD_WITH_PGSQL
		prompt "PostgreSQL database support"
		bool
		default n
		depends BR2_PACKAGE_PMACCTD_CUSTOM
		select BR2_PACKAGE_LIBPQ

	config BR2_COMPILE_PMACCTD_WITH_SQLITE
		prompt "SQLite database support"
		bool
		default n
		depends BR2_PACKAGE_PMACCTD_CUSTOM
		select BR2_PACKAGE_LIBSQLITE

endchoice

config BR2_PACKAGE_PMACCT_CLIENT
	prompt   "pmacct-client................... Command-line client to gather data from the IMT plugin"
	tristate
	default n
	select BR2_COMPILE_PMACCT

endmenu
```

## package/popt/Config.in
```kconfig
config BR2_COMPILE_POPT
	tristate
	depends BR2_PACKAGE_LIBPOPT

config BR2_PACKAGE_LIBPOPT
	prompt "libpopt........................... Command line option parsing library"
	tristate
	default m if CONFIG_DEVEL
	select BR2_COMPILE_POPT
	help
	  A command line option parsing library
	  
	  ftp://ftp.rpm.org/pub/rpm/dist/rpm-4.1.x/
```

## package/portmap/Config.in
```kconfig
config BR2_PACKAGE_PORTMAP
	prompt "portmap........................... RPC Portmapper"
	tristate
	default m if CONFIG_DEVEL
	help
	  The RPC Portmapper (used by the NFS Server)
```

## package/portsentry/Config.in
```kconfig
config BR2_PACKAGE_PORTSENTRY
	prompt "portsentry........................ Portscan protection utility"
	tristate
	default m if CONFIG_DEVEL
	help
	  Software for protection against port scans
	  
	  http://sourceforge.net/projects/sentrytools
```

## package/postgresql/Config.in
```kconfig
config BR2_PACKAGE_LIBPQ
	tristate "libpq (PostgreSQL client library)"
	default m if CONFIG_DEVEL
	help
	  PostgreSQL client library.
	  
	  http://www.postgresql.org/
	  
```
