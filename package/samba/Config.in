## package/samba/Config.in
```kconfig
#menu "samba............................. A NetBIOS/SMB implementation"

config BR2_COMPILE_SAMBA
	tristate
	default n
	depends BR2_PACKAGE_SAMBA || BR2_PACKAGE_SAMBA_CLIENT || BR2_PACKAGE_SMBFS

config BR2_PACKAGE_SAMBA
	prompt "samba............................. NetBIOS/SMB file and print server"
	tristate
	default m if CONFIG_DEVEL
	select BR2_COMPILE_SAMBA
	select BR2_PACKAGE_LIBGCC
	help
	 The Samba software suite is a collection of programs that implements the 
	 SMB protocol for unix systems, allowing you to serve files and printers to 
	 Windows, NT, OS/2 and DOS clients. This protocol is sometimes also referred 
	 to as the LanManager or Netbios protocol.
	 
	 http://www.samba.org/
	 
	 This package contains the SMB file and print server daemons.

config BR2_PACKAGE_SAMBA_CLIENT
	prompt "samba-client...................... NetBIOS/SMB simple client"
	tristate
	default m if CONFIG_DEVEL
	select BR2_COMPILE_SAMBA
	select BR2_PACKAGE_LIBGCC
	help
	 The Samba software suite is a collection of programs that implements the 
	 SMB protocol for unix systems, allowing you to serve files and printers to 
	 Windows, NT, OS/2 and DOS clients. This protocol is sometimes also referred 
	 to as the LanManager or Netbios protocol.
	 
	 http://www.samba.org/
	 
	 This package contains a simple command-line SMB client.

#endmenu
```

## package/sane-backends/Config.in
```kconfig
config BR2_PACKAGE_SANE_BACKENDS
	prompt "sane-backends..................... Scanner Access Now Easy (backends)"
	tristate
	default m if CONFIG_DEVEL
	help
	  SANE (Scanner Access Now Easy) is a universal scanner interface.
	  
	  http://www.sane-project.org
```

## package/scanlogd/Config.in
```kconfig
config BR2_PACKAGE_SCANLOGD
	prompt "scanlogd.......................... a port scan detection tool"
	tristate
	select BR2_PACKAGE_LIBPCAP
	select BR2_PACKAGE_LIBNET
	select BR2_PACKAGE_LIBNIDS
	default m if CONFIG_DEVEL
	help
	  Scanlogd is a TCP port scan detection tool, originally designed 
	  to illustrate various attacks an IDS developer has to deal with.  
	  Thus, unlike some of the other port scan detection tools out there, 
	  scanlogd is designed to be totally safe to use.

	  http://www.openwall.com/scanlogd
```

## package/scdp/Config.in
```kconfig
config BR2_PACKAGE_SCDP
	prompt "scdp.............................. An utility to send CDP (Cisco Discovery Protocol) packets"
	tristate
	default m if CONFIG_DEVEL
	select BR2_PACKAGE_LIBNET
	help
	  This program sends CDP (Cisco Discovery Protocol) packets out on 
	  selected interfaces and tells the connected switch (cisco only) 
	  where the host is connected.
	  
	  http://sourceforge.net/projects/scdp
```

## package/sed/Config.in
```kconfig
config BR2_PACKAGE_SED
	bool "sed"
	default n
	help
	  Super-useful stream editor.

	  http://sed.sourceforge.net/

	  Most people will answer Y.
```

## package/ser/Config.in
```kconfig
config BR2_PACKAGE_SER
	tristate "SIP Express Router"
	default m
	help
	 SIP Express Router (ser) is a high-performance,
	 configurable, free SIP server.
```

## package/ser2net/Config.in
```kconfig
config BR2_PACKAGE_SER2NET
        prompt "ser2net........................... Serial port TCP/IP redirector"
        tristate
	default m if CONFIG_DEVEL
        help
	  This is ser2net, a program for allowing network connections to serial
	  ports. See the man page for information about using the program. Note 
          that ser2net supports RFC 2217 (remote control of serial port parameters),
          but you must have a complient client. 
```

## package/setserial/Config.in
```kconfig
config BR2_PACKAGE_SETSERIAL
	prompt "setserial......................... Serial port configuration utility"
	tristate
	default m if CONFIG_DEVEL
	help
	  setserial  is a program designed to set and/or report the
	  configuration information associated with a serial port.  This
	  information  includes what I/O port and IRQ a particular
	  serial port is using, and whether or not the break key should
	  be interpreted as the Secure  Attention  Key, and so on.
	  
	  http://setserial.sourceforge.net/
```

## package/siproxd/Config.in
```kconfig
config BR2_PACKAGE_SIPROXD
	prompt "siproxd........................... SIP (Session Initiation Protocol) proxy"
	tristate
	default m if CONFIG_DEVEL
	select BR2_PACKAGE_LIBOSIP2
	help
	  A SIP (Session Initiation Protocol) proxy
	  
	  http://siproxd.sourceforge.net/
	  
	  Depends: libosip2
```

## package/speex/Config.in
```kconfig
config BR2_PACKAGE_SPEEX
	tristate "speex"
	default m if CONFIG_DEVEL
	help
	  An open source patent-free speech compression codec
```

## package/spi-ks8995/src/Kconfig
```kconfig
config SPI_KS8995
	tristate "Micrel/Kendin KS8995 Ethernet switch"
	depends on SPI
```

## package/srelay/Config.in
```kconfig
config BR2_PACKAGE_SRELAY
	prompt "srelay............................ A socks 4/5 proxy server"
	tristate
	default m if CONFIG_DEVEL
	help
	  A socks 4/5 protocol proxy server
	  
	  http://www.c-wind.com/srelay/
```

## package/ssmtp/Config.in
```kconfig
config BR2_PACKAGE_SSMTP
	prompt "ssmtp............................. A minimal and secure mail sender"
	tristate
	default m if CONFIG_DEVEL
	help
	  A secure, effective and simple way of getting mail off a system to your 
	  mail hub. It contains no suid-binaries or other dangerous things - no 
	  mail spool to poke around in, and no daemons running in the background. 
	  Mail is simply forwarded to the configured mailhost. Extremely easy 
	  configuration.
	  
	  http://packages.debian.org/stable/mail/ssmtp
```

## package/tcpdump/Config.in
```kconfig
config BR2_PACKAGE_TCPDUMP
	prompt "tcpdump........................... Network monitoring and data acquisition tool"
	tristate
	default m if CONFIG_DEVEL
	select BR2_PACKAGE_LIBPCAP
	help
	  A tool for network monitoring and data acquisition.
	  
	  http://www.tcpdump.org/
```

## package/tinc/Config.in
```kconfig
config BR2_PACKAGE_TINC
	prompt "tinc.............................. VPN tunneling daemon"
	tristate
	default m if CONFIG_DEVEL
	select BR2_PACKAGE_KMOD_TUN
	select BR2_PACKAGE_LIBLZO
	select BR2_PACKAGE_LIBOPENSSL
	select BR2_PACKAGE_ZLIB
	help
	  A VPN tunneling daemon
	  
	  http://www.tinc-vpn.org/
```

## package/tmsnc/Config.in
```kconfig
config BR2_PACKAGE_TMSNC
	tristate "text-based MSN client"
	default m if CONFIG_DEVEL
		TMSNC is a textbased (console) MSN client written in C.

		http://tmsnc.sourceforge.net
```

## package/uboot-ifxmips/Config.in
```kconfig
menu "Configuration"
	depends on PACKAGE_uboot-ifxmips

config IFXMIPS_UBOOT_A800
	bool "add ARV452 Switch bringup hack"
	help
	  Say Y, if you have a arv452 board (wav-281, A800, ..)

endmenu
```

## package/uboot-lantiq/Config.in
```kconfig
menu "Configuration"
	depends on PACKAGE_uboot-lantiq

config UBOOT_TARGET
	string "target"
	default "easy50712_DDR166M"
	help
	  The configuration reflects the settings for a dedicated board hardware.
	  Select for Danube evaluation board easy50712_DDR166M .
	  Select for AR9 evaluation board easy50812_DDR166M .

config UBOOT_RAMBOOT
	bool "Enable RAM boot image"
	help
	  Using the UART boot mode of the ROM code this image could be loaded to the RAM.
	  While executing the image in the RAM the functionality of the uboot image can be 
	  tested first without touching the original flash.
	  Note: Be carefull, by saving the environment the flash will be modified.
	  The OWRT flash layout differs from the layout provided by Lantiq / Infineon.

config UBOOT_RAMBOOT_DDR_CONFIG
	string "DDR configuration file"
	default "easy50712_DDR166M.conf"
	depends on UBOOT_RAMBOOT
	help
	  The DDR configuration file should reflect the DDR memory device configuration .
	  It will be used to create a RAM boot image
	  Select for Danube evalution board easy50712_DDR166M.conf .
	  Select for AR9 evalution board easy50812.conf .


config UBOOT_A800
	bool "add ARV452 Switch bringup hack"
	help
	  Say Y, if you have a arv452 board (wav-281, A800, ..)

endmenu
```

## package/uclibc++/Config.in
```kconfig
config BR2_PACKAGE_UCLIBCXX
	tristate "uClibc++"
	default m if CONFIG_DEVEL
	help
	  A standard C++ library for embedded systems
```

## package/udev/Config.in
```kconfig
# udev package config

menu "Configuration"
	depends on PACKAGE_udev

config UDEV_DISABLE_LOGGING
	bool "Disable udev logging to syslog"
	default n
	help
	 Disable logging of udev messages to the syslog.  If
	 unsure, choose the default N.

config UDEV_ENABLE_DEBUG
	bool "Enable debug build of the udev package"
	default n
	help
	 Compile in udev debug messages.  If unsure, choose
	 the default N.

config UDEV_EXTRA_ata_id
	bool "Install udev ata_id callout"
	default y
	help
	 ata_id - udev callout to read product/serial number
	 from ATA drives

config UDEV_EXTRA_cdrom_id
	bool "Install udev cdrom_id callout"
	default y
	help
	 cdrom_id - udev callout to determine the capabilities
	 of optical drives and media

config UDEV_EXTRA_collect
	bool "Install udev collect"
	default n
	help
	 Adds ID to the list governed by <checkpoint>

config UDEV_EXTRA_edd_id
	bool "Install udev edd_id callout"
	default n
	help
	 edd_id - udev callout to identify BIOS disk drives
	 via EDD

config UDEV_EXTRA_firmware
	bool "Install firmware support"
	default n
	help
	 udev firmware loader
	 via EDD

config UDEV_EXTRA_floppy
	bool "Install create_floppy_devices callout"
	default n
	help
	 create_floppy_devices - udev callout to create all
	 possible floppy device based on the CMOS type

config UDEV_EXTRA_fstab_import
	bool "Install fstab import"
	default y
	help
	 find matching entry in fstab and export it

config UDEV_EXTRA_path_id
	bool "Install udev path_id callout"
	default y
	help
	 path_id - udev callout to create a device path based
	 unique name for a device to implement the Linux
	 Persistent Device Naming scheme

config UDEV_EXTRA_rule_generator
	bool "Install udev rule_generator"
	default y
	help

config UDEV_EXTRA_scsi_id
	bool "Install udev scsi_id callout"
	default y
	help
	 scsi_id - retrieve and generate a unique SCSI identifier

config UDEV_EXTRA_usb_id
	bool "Install udev usb_id callout"
	default y
	help
	  usb_id - can find the unique id of USB devices

endmenu
```

## package/udp-broadcast-relay/Config.in
```kconfig
config BR2_PACKAGE_UDP_BROADCAST_RELAY
	prompt "udp-broadcast-relay............... listens for packets on a specified UDP broadcast port."
	tristate
	default m if CONFIG_DEVEL
	help
		This program listens for packets on a specified UDP broadcast port. When a packet is received, it sends that packet to all specified interfaces but the one it came from as though it originated from the original sender.

		The primary purpose of this is to allow games on machines on separated local networks (Ethernet, WLAN) that use udp broadcasts to find each other to do so.

		It also works on ppp links, so you can log in from windows boxes (e.g. using pptp) and play LAN-based games together. Currently, you have to care about upcoming or downgoing interfaces yourself.
	  
	  	http://www.joachim-breitner.de/udp-broadcast-relay/
```

## package/updatedd/Config.in
```kconfig
config BR2_PACKAGE_UPDATEDD
        tristate "updatedd - a tool to update dynamic dns services"
        default m if CONFIG_DEVEL
        help
		Updatedd is a small tool that will update one of many dynamic
		dns services on boot. Please look at the /etc/init.d/S50ddns
		script for more info.


config BR2_PACKAGE_UPDATEDD_CHANGEIP
	bool "changeip.com"
	depends on BR2_PACKAGE_UPDATEDD
	default y if CONFIG_DEVEL
config BR2_PACKAGE_UPDATEDD_DYNDNS
	bool "dyndns.org"
	depends on BR2_PACKAGE_UPDATEDD
	default y if CONFIG_DEVEL
config BR2_PACKAGE_UPDATEDD_EURODYNDNS
	bool "eurodyndns.org"
	depends on BR2_PACKAGE_UPDATEDD
	default y if CONFIG_DEVEL
config BR2_PACKAGE_UPDATEDD_HN
	bool "hn.org"
	depends on BR2_PACKAGE_UPDATEDD
	default y if CONFIG_DEVEL
config BR2_PACKAGE_UPDATEDD_NOIP
	bool "no-ip.com"
	depends on BR2_PACKAGE_UPDATEDD
	default y if CONFIG_DEVEL
config BR2_PACKAGE_UPDATEDD_ODS
	bool "ods.org"
	depends on BR2_PACKAGE_UPDATEDD
	default y if CONFIG_DEVEL
config BR2_PACKAGE_UPDATEDD_OVH
	bool "ovh.com"
	depends on BR2_PACKAGE_UPDATEDD
	default y if CONFIG_DEVEL
config BR2_PACKAGE_UPDATEDD_REGFISH
	bool "regfish.com"
	depends on BR2_PACKAGE_UPDATEDD
	default y if CONFIG_DEVEL
config BR2_PACKAGE_UPDATEDD_TZO
	bool "tzo.com"
	depends on BR2_PACKAGE_UPDATEDD
	default y if CONFIG_DEVEL
```

## package/util-linux/Config.in
```kconfig
menu "util-linux"

config BR2_COMPILE_UTIL_LINUX
	tristate
	default n
	depends BR2_PACKAGE_FDISK || BR2_PACKAGE_SWAP_UTILS

config BR2_PACKAGE_FDISK
	prompt "fdisk............................. Partition table manipulation utility"
	tristate
	default m if CONFIG_DEVEL
	select BR2_COMPILE_UTIL_LINUX
	help
	  A partition table manipulation utility
	  
	  http://www.kernel.org/pub/linux/utils/util-linux/

config BR2_PACKAGE_LOSETUP
	prompt "losetup........................... Loop devices setup and control utility"
	tristate
	default m if CONFIG_DEVEL
	select BR2_COMPILE_UTIL_LINUX
	select BR2_PACKAGE_KMOD_LOOP
	help
	  A loop devices setup and control utility
	  
	  http://www.kernel.org/pub/linux/utils/util-linux/

config BR2_PACKAGE_SWAP_UTILS
	prompt "swap-utils........................ Swap space management utilities"
	tristate
	default m if CONFIG_DEVEL
	select BR2_COMPILE_UTIL_LINUX
	help
	  A collection of tools to manage swap space :
	    * mkswap
	    * swapon
	    * swapoff
	  
	  http://www.kernel.org/pub/linux/utils/util-linux/

endmenu
```

## package/utils/busybox/Config.in
```kconfig
if PACKAGE_busybox

config BUSYBOX_CUSTOM
	bool "Customize busybox options"
	default n

	source "package/utils/busybox/Config-defaults.in"

	if BUSYBOX_CUSTOM
	source "package/utils/busybox/config/Config.in"
	endif

config BUSYBOX_USE_LIBRPC
	bool
	default y if BUSYBOX_CUSTOM && BUSYBOX_CONFIG_FEATURE_HAVE_RPC
	default y if !BUSYBOX_CUSTOM && BUSYBOX_DEFAULT_FEATURE_HAVE_RPC

endif
```
