## package/lcd4linux/Config.in
```kconfig
config BR2_PACKAGE_LCD4LINUX
	tristate "lcd4linux - Program to access an external LCD"
	default m if CONFIG_DEVEL
	select BR2_PACKAGE_LIBNCURSES
	help
	  LCD4Linux
	  
	  https://ssl.bulix.org/projects/lcd4linux/wiki/Howto
	  
```

## package/libamsel/Config.in
```kconfig
config BR2_PACKAGE_LIBAMSEL
	prompt "libamsel.......................... The amwall library"
	tristate
	default m if CONFIG_DEVEL
	help
	  A library for amwall configuration files
	  
	  http://amselinux.de/
```

## package/libcli/Config.in
```kconfig
config BR2_PACKAGE_LIBCLI
	prompt "libcli............................ A Cisco-like command line interface"
	tristate
	default m if CONFIG_DEVEL
	help
		Provides a shared library for including a Cisco-like 
		command-line interface into other software. It's a telnet 
		interface which supports command-line editing, history, 
		authentication and callbacks for a user-definable function tree

		http://libcli.sourceforge.net/
```

## package/libdnet/Config.in
```kconfig
config BR2_PACKAGE_LIBDNET
	prompt "libdnet........................... Low-level network library"
	tristate
	default m if CONFIG_DEVEL
	help
	  simplified, portable interface to several low-level networking routines
	  
	  http://sourceforge.net/projects/libdnet/
```

## package/libelf/Config.in
```kconfig
config BR2_PACKAGE_LIBELF
	prompt "libelf............................ ELF object file access library"
	tristate
	default m if CONFIG_DEVEL
	help
	  This is the public release of libelf-0.8.5, a free ELF object
	  file access library.
	  
	  http://www.stud.uni-hannover.de/~michael/software/
```

## package/libevent/Config.in
```kconfig
config BR2_PACKAGE_LIBEVENT
	prompt "libevent.......................... Event notification library for event-driven network servers"
	tristate
	default m if CONFIG_DEVEL
	help
	  The libevent API provides a mechanism to execute a callback function 
	  when a specific event occurs on a file descriptor or after a timeout 
	  has been reached. Furthermore, libevent also support callbacks due 
	  to signals or regular timeouts.
	  
	  libevent is meant to replace the event loop found in event driven 
	  network servers. An application just needs to call event_dispatch() 
	  and then add or remove events dynamically without having to change 
	  the event loop.
	  
	  http://www.monkey.org/~provos/libevent/
```

## package/libffi-sable/Config.in
```kconfig
config BR2_PACKAGE_LIBFFI_SABLE
	tristate "libffi-sable - Foreign Function Interface library (for sablevm)"
#	default m if CONFIG_DEVEL
	default n
	help
	  The libffi library provides a portable, high level programming
	  interface to various calling conventions. This allows a programmer to
	  call any function specified by a call interface description at run
	  time.  
	  
	  http://sources.redhat.com/libffi/
	  
```

## package/libgcc/Config.in
```kconfig
config BR2_PACKAGE_LIBGCC
	tristate "libgcc (GCC support library)"
	default m
	help
	  Shared version of the support library, a library of 
	  internal subroutines that GCC uses to overcome 
	  shortcomings of particular machines, or special needs 
	  for some languages.
	  
```

## package/libgcrypt/Config.in
```kconfig
config BR2_PACKAGE_LIBGCRYPT
	prompt "libgcrypt......................... The GNU crypto library"
	tristate
	default m if CONFIG_DEVEL
	select BR2_PACKAGE_LIBGPG_ERROR
	help
	  This is a general purpose cryptographic library based on the code from 
	  GnuPG. It provides functions for all cryptograhic building blocks: 
	  symmetric ciphers (AES, DES, Blowfish, CAST5, Twofish, Arcfour), hash 
	  algorithms (MD4, MD5, RIPE-MD160, SHA-1, TIGER-192), MACs (HMAC for all 
	  hash algorithms), public key algorithms (RSA, ElGamal, DSA), large 
	  integer functions, random numbers and a lot of supporting functions.
	  
	  http://directory.fsf.org/security/libgcrypt.html
```

## package/libgd/Config.in
```kconfig
config BR2_PACKAGE_LIBGD
	prompt "libgd............................. The GD Graphics Library"
	tristate
	default m if CONFIG_DEVEL
	help
	  The GD Graphics Library
	  
	  http://www.boutell.com/gd/
```

## package/libgpg-error/Config.in
```kconfig
config BR2_PACKAGE_LIBGPG_ERROR
	prompt "libgpg-error...................... An helper library for common error codes and descriptions"
	tristate
	default m if CONFIG_DEVEL
	help
	  This is a library that defines common error values for all GnuPG
	  components.  Among these are GPG, GPGSM, GPGME, GPG-Agent, libgcrypt,
	  Libksba, DirMngr, Pinentry, SmartCard Daemon and possibly more in the
	  future.
	  
	  http://www.gnupg.org/related_software/libgpg-error/
```

## package/libiconv/Config.in
```kconfig
config BR2_PACKAGE_LIBICONV
	prompt "libiconv.......................... character set conversion library"
	tristate
	default m if CONFIG_DEVEL
	help

	  This package contains a _very_ stripped down version of GNU Libiconv,
	  all charsets have been removed, except ASCII, various unicode charsets
	  and iso8896-1.
	  
	  The original website:
	  http://www.gnu.org/software/libiconv/
```

## package/libid3tag/Config.in
```kconfig
config BR2_PACKAGE_LIBID3TAG
	prompt "libid3tag......................... An ID3 tag manipulation library"
	tristate
	default m if CONFIG_DEVEL
	select BR2_PACKAGE_ZLIB
	help
	  libid3tag is a library for reading and (eventually) writing ID3 tags, both
	  ID3v1 and the various versions of ID3v2.
	  
	  http://mad.sourceforge.net/
	  
	  Depends: zlib
```

## package/libmad/Config.in
```kconfig
config BR2_PACKAGE_LIBMAD
	prompt "libmad............................ An high-quality MPEG audio decoding library"
	tristate
	default m if CONFIG_DEVEL
	help
	  MAD is a high-quality MPEG audio decoder. It currently supports 
	  MPEG-1 and the MPEG-2 extension to lower sampling frequencies, 
	  as well as the de facto MPEG 2.5 format. All three audio layers -
	  Layer I, Layer II, and Layer III (i.e. MP3) - are fully implemented.
	  
	  http://www.underbit.com/products/mad/
```

## package/libnet/Config.in
```kconfig
config BR2_PACKAGE_LIBNET
	prompt "libnet............................ Low-level packet creation library"
	tristate
	default m if CONFIG_DEVEL
	select BR2_PACKAGE_LIBPCAP
	help
	  A low-level packet creation library.
	  
	  http://www.packetfactory.net/libnet/
	  
	  Depends: libpcap
```

## package/libogg/Config.in
```kconfig
config BR2_PACKAGE_LIBOGG
	tristate "libogg - The Ogg bitstream handling library"
	default n
	help
	  The Ogg bitstream handling library.
	  
	  http://www.vorbis.com/
	  
```

## package/libosip2/Config.in
```kconfig
config BR2_PACKAGE_LIBOSIP2
	tristate "libosip2 - GNU oSIP library"
	default m if CONFIG_DEVEL
	select BR2_PACKAGE_LIBPTHREAD
	help
	  GNU oSIP library, a Session Initiation Protocol (SIP) implementation
	  
	  http://www.gnu.org/software/osip/
	  
```

## package/libpcap/Config.in
```kconfig
config PCAP_HAS_USB
	bool "Include USB support"
	depends PACKAGE_libpcap
	depends PACKAGE_kmod-usb-core
	default n

config PCAP_HAS_BT
	bool "Include bluetooth support"
	depends PACKAGE_libpcap
	depends PACKAGE_kmod-bluetooth
	depends BROKEN
	default n
```

## package/libpng/Config.in
```kconfig
config BR2_PACKAGE_LIBPNG
	prompt "libpng............................ PNG (Portable Network Graphics) format files handling library"
	tristate
	default m if CONFIG_DEVEL
	select BR2_PACKAGE_ZLIB
	help
	  A library for reading/writing PNG files
	  
	  http://www.libpng.org/pub/png/libpng.html
```

## package/libpthread/Config.in
```kconfig
config BR2_PACKAGE_LIBPTHREAD
	tristate "libpthread - POSIX threads library"
	default m if CONFIG_DEVEL
	help
	  POSIX threads library
	  
```

## package/libs/libpcap/Config.in
```kconfig
menu "Configuration"
	depends on PACKAGE_libpcap

config PCAP_HAS_USB
	bool "Include USB support"
	depends on PACKAGE_kmod-usb-core
	default PACKAGE_kmod-usbmon

config PCAP_HAS_BT
	bool "Include bluetooth support"
	depends on PACKAGE_kmod-bluetooth
	depends on BROKEN
	default n

endmenu
```

## package/libs/openssl/Config.in
```kconfig
menu "Configuration"
	depends on PACKAGE_libopenssl

config OPENSSL_WITH_EC
	bool
	default y
	prompt "Enable elliptic curve support"

config OPENSSL_WITH_EC2M
        bool
        depends on OPENSSL_WITH_EC
        prompt "Enable ec2m support"

config OPENSSL_WITH_SSL3
	bool
	default n
	prompt "Enable sslv3 support"

config OPENSSL_ENGINE_CRYPTO
	bool
	prompt "Crypto acceleration support"

config OPENSSL_ENGINE_DIGEST
	bool
	depends on OPENSSL_ENGINE_CRYPTO
	prompt "Digests acceleration support"

endmenu
```

## package/libs/wolfssl/Config.in
```kconfig
if PACKAGE_libwolfssl

config WOLFSSL_HAS_AES_CCM
	bool "Include AES-CCM support"
	default y

config WOLFSSL_HAS_AES_GCM
	bool "Include AES-GCM support"
	default y

config WOLFSSL_HAS_CHACHA_POLY
	bool "Include ChaCha20-Poly1305 cipher suite support"
	default y

config WOLFSSL_HAS_DH
	bool "Include DH (Diffie-Hellman) support"
	default y

config WOLFSSL_HAS_ARC4
	bool "Include ARC4 support"
	default y

config WOLFSSL_HAS_TLSV10
	bool "Include TLS 1.0 support"
	default y

if !(WOLFSSL_HAS_AES_CCM||WOLFSSL_HAS_AES_GCM||WOLFSSL_HAS_CHACHA_POLY)
	comment "! TLS 1.3 support needs one of: AES-CCM, AES-GCM, ChaCha20-Poly1305"
endif

config WOLFSSL_HAS_TLSV13
	bool "Include TLS 1.3 support"
	depends on WOLFSSL_HAS_AES_CCM||WOLFSSL_HAS_AES_GCM||WOLFSSL_HAS_CHACHA_POLY
	default y

config WOLFSSL_HAS_SESSION_TICKET
	bool "Include session ticket support"
	default y

config WOLFSSL_HAS_DTLS
	bool "Include DTLS support"
	default n

config WOLFSSL_HAS_OCSP
	bool "Include OSCP stapling support"
	default y

config WOLFSSL_HAS_WPAS
	bool "Include wpa_supplicant support"
	select WOLFSSL_HAS_ARC4
	select WOLFSSL_HAS_OCSP
	select WOLFSSL_HAS_SESSION_TICKET
	default y

config WOLFSSL_HAS_ECC25519
	bool "Include ECC Curve 22519 support"
	default n

if WOLFSSL_HAS_AES_CCM
	comment "! Hardware Acceleration does not build with AES-CCM enabled"
endif
if !WOLFSSL_HAS_AES_CCM
	choice
		prompt "Hardware Acceleration"
		default WOLFSSL_HAS_NO_HW

		config WOLFSSL_HAS_NO_HW
			bool "None"

		config WOLFSSL_HAS_AFALG
			bool "AF_ALG"

		config WOLFSSL_HAS_DEVCRYPTO_AES
			bool "/dev/crypto - AES-only"

		config WOLFSSL_HAS_DEVCRYPTO_FULL
			bool "/dev/crypto - full"
	endchoice
endif

endif
```

## package/libtasn1/Config.in
```kconfig
config BR2_PACKAGE_LIBTASN1
	prompt "libtasn1.......................... An ASN.1 and DER structures manipulation library"
	tristate
#	default m if CONFIG_DEVEL
	default n
	help
	  This is a library for Abstract Syntax Notation One (ASN.1) and 
	  Distinguish Encoding Rules (DER) manipulation.
	  
	  ftp://ftp.gnutls.org/pub/gnutls/libtasn1/
```

## package/libusb/Config.in
```kconfig
config BR2_PACKAGE_LIBUSB
	prompt "libusb............................ A library for accessing Linux USB devices"
	tristate
	default m if CONFIG_DEVEL
	help
	  A library for accessing Linux USB devices
	  
	  http://libusb.sourceforge.net/
```
