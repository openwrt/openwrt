## openwrt/Config.in
```kconfig
#

mainmenu "OpenWrt Configuration"

config MODULES
	bool
	default y

config BR2_HAVE_DOT_CONFIG
	bool
	default y

config BR2_BIG_ENDIAN
	tristate

# Supported architectures

config BR2_i386
	tristate
	
config BR2_mips
	tristate
	select BR2_BIG_ENDIAN

config BR2_mipsel
	tristate

config BR2_armeb
	tristate
	select BR2_BIG_ENDIAN

# Unsupported architectures

if CONFIG_DEVEL
config BR2_mips64
	tristate
	select BR2_BIG_ENDIAN

config BR2_arm
	tristate

config BR2_cris
	tristate

config BR2_m68k
	tristate
	select BR2_BIG_ENDIAN

config BR2_powerpc
	tristate
	select BR2_BIG_ENDIAN

config BR2_sh3
	tristate

config BR2_sh3eb
	tristate
	select BR2_BIG_ENDIAN

config BR2_sh4
	tristate

config BR2_sh4eb
	tristate
	select BR2_BIG_ENDIAN

config BR2_sparc
	tristate
	select BR2_BIG_ENDIAN

endif

config BR2_ARCH
	string
	default "arm"     if BR2_arm
	default "armeb"   if BR2_armeb
	default "cris"    if BR2_cris
	default "i386"    if BR2_i386
	default "m68k"    if BR2_m68k
	default "mips"    if BR2_mips
	default "mipsel"  if BR2_mipsel || !CONFIG_DEVEL
	default "mips64"  if BR2_mips64
	default "powerpc" if BR2_powerpc
	default "sh3"     if BR2_sh3
	default "sh3eb"   if BR2_sh3eb
	default "sh4"     if BR2_sh4
	default "sh4eb"   if BR2_sh4eb
	default "sparc"   if BR2_sparc


config BR2_WGET
	string 
	default "wget --passive-ftp -nd"

config BR2_TAR_VERBOSITY
	bool 
	default n

config BR2_JLEVEL
	int
	default "1"

source "target/Config.in"
source "toolchain/Config.in"
source "package/Config.in"
source "target/linux/Config.in"
```

## openwrt/package/Config.in
```kconfig
#

menu "OpenWrt Package Selection"

comment "Package categories"

menu "Base system"
source "package/busybox/Config.in"
source "package/bridge/Config.in"
source "package/dnsmasq/Config.in"
source "package/ipkg/Config.in"
source "package/iptables/Config.in"
source "package/mtd/Config.in"
source "package/nvram/Config.in"
endmenu

menu "Applications"
source "package/autossh/Config.in"
source "package/bitchx/Config.in"
source "package/collectd/Config.in"
source "package/cbtt/Config.in"
source "package/ctorrent/Config.in"
source "package/deco/Config.in"
source "package/elinks/Config.in"
source "package/fetchmail/Config.in"
source "package/gpsd/Config.in"
source "package/gpg/Config.in"
source "package/haserl/Config.in"
source "package/irssi/Config.in"
source "package/jamvm/Config.in"
source "package/lcd4linux/Config.in"
source "package/less/Config.in"
source "package/lua/Config.in"
source "package/microperl/Config.in"
source "package/monit/Config.in"
source "package/motion/Config.in"
source "package/mgetty/Config.in"
source "package/mutt/Config.in"
source "package/nano/Config.in"
source "package/osiris/Config.in"
source "package/php4/Config.in"
source "package/php5/Config.in"
source "package/procmail/Config.in"
source "package/psybnc/Config.in"
menu "sablevm........................... A Java Virtual Machine (JVM) implementation"
source "package/sablevm/Config.in"
source "package/sablevm-classpath/Config.in"
source "package/libffi-sable/Config.in"
endmenu
source "package/sane-backends/Config.in"
source "package/screen/Config.in"
source "package/ser2net/Config.in"
source "package/syslog-ng/Config.in"
menu "rrdtool........................... Round-Robin Database (RRD) libraries and tools"
source "package/rrdtool/Config.in"
source "package/rrdtool1/Config.in"
source "package/rrdcollect/Config.in"
endmenu
source "package/vim/Config.in"
endmenu

menu "Networking"
source "package/aircrack/Config.in"
source "package/aircrack-ng/Config.in"
source "package/amwall/Config.in"
source "package/arpd/Config.in"
source "package/arptables/Config.in"
source "package/arpwatch/Config.in"
source "package/asterisk/Config.in"
source "package/atftp/Config.in"
source "package/avahi/Config.in"
source "package/bind/Config.in"
source "package/bitlbee/Config.in"
source "package/bwm/Config.in"
source "package/chillispot/Config.in"
source "package/cifsmount/Config.in"
source "package/click/Config.in"
source "package/cups/Config.in"
source "package/cutter/Config.in"
source "package/dhcp/Config.in"
source "package/dhcp-forwarder/Config.in"
source "package/dropbear/Config.in"
source "package/dsniff/Config.in"
source "package/ebtables/Config.in"
source "package/elhttp/Config.in"
source "package/ether-wake/Config.in"
source "package/ethtool/Config.in"
source "package/ez-ipupdate/Config.in"
source "package/fakeidentd/Config.in"
source "package/fping/Config.in"
source "package/fprobe/Config.in"
source "package/fprobe-ulog/Config.in"
source "package/freeradius/Config.in"
source "package/frickin/Config.in"
source "package/howl/Config.in"
source "package/hostap-utils/Config.in"
source "package/hostapd/Config.in"
source "package/htpdate/Config.in"
source "package/httping/Config.in"
source "package/iftop/Config.in"
source "package/igmpproxy/Config.in"
source "package/ipcad/Config.in"
source "package/iproute2/Config.in"
source "package/iperf/Config.in"
source "package/ipsec-tools/Config.in"
source "package/ipset/Config.in"
source "package/iptables-snmp/Config.in"
source "package/iptraf/Config.in"
source "package/kismet/Config.in"
source "package/knock/Config.in"
source "package/l2tpd/Config.in"
source "package/l2tpns/Config.in"
source "package/lighttpd/Config.in"
source "package/linux-atm/Config.in"
source "package/macchanger/Config.in"
source "package/maradns/Config.in"
source "package/matrixtunnel/Config.in"
source "package/miau/Config.in"
source "package/mini_httpd/Config.in"
source "package/mini_sendmail/Config.in"
source "package/mtr/Config.in"
source "package/net-snmp/Config.in"
source "package/netperf/Config.in"
source "package/netstat-nat/Config.in"
source "package/nfs-server/Config.in"
source "package/nmap/Config.in"
source "package/nocatsplash/Config.in"
source "package/ntpclient/Config.in"
source "package/olsrd/Config.in"
source "package/openntpd/Config.in"
source "package/openser/Config.in"
source "package/openssh/Config.in"
source "package/openswan/Config.in"
source "package/openvpn/Config.in"
source "package/p910nd/Config.in"
source "package/parprouted/Config.in"
source "package/pipacs/Config.in"
source "package/pmacct/Config.in"
source "package/portmap/Config.in"
source "package/portsentry/Config.in"
source "package/ppp/Config.in"
source "package/pptp/Config.in"
source "package/pptpd/Config.in"
source "package/privoxy/Config.in"
source "package/ptunnel/Config.in"
source "package/quagga/Config.in"
source "package/raddump/Config.in"
source "package/rarpd/Config.in"
source "package/reaim/Config.in"
source "package/robocfg/Config.in"
source "package/rp-l2tp/Config.in"
source "package/rp-pppoe/Config.in"
source "package/rrs/Config.in"
source "package/rsync/Config.in"
source "package/samba/Config.in"
source "package/scanlogd/Config.in"
source "package/scdp/Config.in"
source "package/shat/Config.in"
source "package/sipp/Config.in"
source "package/siproxd/Config.in"
source "package/sipsak/Config.in"
source "package/slurm/Config.in"
source "package/snort/Config.in"
source "package/snort-wireless/Config.in"
source "package/socat/Config.in"
source "package/squid/Config.in"
source "package/ssltunnel/Config.in"
source "package/ssmtp/Config.in"
source "package/srelay/Config.in"
source "package/tmsnc/Config.in"
source "package/tcpdump/Config.in"
source "package/tinc/Config.in"
source "package/tinyproxy/Config.in"
source "package/tor/Config.in"
source "package/ttcp/Config.in"
source "package/udp-broadcast-relay/Config.in"
source "package/ulogd/Config.in"
source "package/updatedd/Config.in"
source "package/vgp/Config.in"
source "package/vncrepeater/Config.in"
source "package/vnc-reflector/Config.in"
source "package/vnstat/Config.in"
source "package/vpnc/Config.in"
source "package/vrrpd/Config.in"
source "package/vsftpd/Config.in"
source "package/vtun/Config.in"
source "package/wakelan/Config.in"
source "package/wccpd/Config.in"
source "package/weechat/Config.in"
source "package/wificonf/Config.in"
source "package/wifidog/Config.in"
source "package/wireless-tools/Config.in"
source "package/wiviz/Config.in"
source "package/wknock/Config.in"
source "package/wol/Config.in"
source "package/wondershaper/Config.in"
source "package/wpa_supplicant/Config.in"
source "package/wput/Config.in"
source "package/wrt-radauth/Config.in"
source "package/wx200d/Config.in"
source "package/xinetd/Config.in"
source "package/xsupplicant/Config.in"
endmenu

menu "IPv6"
source "package/6tunnel/Config.in"
source "package/aiccu/Config.in"
source "package/dhcp6/Config.in"
source "package/miredo/Config.in"
source "package/mrd6/Config.in"
source "package/ndisc/Config.in"
source "package/radvd/Config.in"
endmenu

menu "Libraries"
source "package/axtls/Config.in"
source "package/cgilib/Config.in"
source "package/glib/Config.in"
source "package/id3lib/Config.in"
source "package/libamsel/Config.in"
source "package/libao/Config.in"
source "package/libart/Config.in"
source "package/libcli/Config.in"
source "package/clinkc/Config.in"
source "package/curl/Config.in" # libcurl
source "package/libdaemon/Config.in"
source "package/libdb/Config.in"
source "package/libdnet/Config.in"
source "package/libelf/Config.in"
source "package/libevent/Config.in"
source "package/expat/Config.in" # libexpat
source "package/flac/Config.in"  # libflac
source "package/freetype/Config.in"  # libfreetype
source "package/base-files/Config.in" # libgcc
source "package/libgcrypt/Config.in"
source "package/libgd/Config.in"
source "package/libgdbm/Config.in"
source "package/gmp/Config.in"  # libgmp
source "package/gnutls/Config.in" ## libgnutls
source "package/libgpg-error/Config.in"
source "package/gsm/Config.in" # libgsm
source "package/libiconv/Config.in"
source "package/libid3tag/Config.in"
source "package/jpeg/Config.in"  # libjpeg
source "package/libtool/Config.in"  # libltdl
source "package/liblzo/Config.in"
source "package/libmad/Config.in"
source "package/libmcrypt/Config.in"
source "package/matrixssl/Config.in"  # libmatrixssl
source "package/mysql/Config.in"  # limysqlclient
source "package/ncurses/Config.in"  # libncurses
source "package/libnet/Config.in"
source "package/libnids/Config.in"
source "package/libogg/Config.in"
source "package/libol/Config.in"
source "package/opencdk/Config.in"  # libopencdk
source "package/openh323/Config.in" 
source "package/openldap/Config.in"  # libopenldap
source "package/openssl/Config.in"  # libopenssl
source "package/libosip2/Config.in"
source "package/libpcap/Config.in"
source "package/pcre/Config.in"  # libpcre
source "package/pwlib/Config.in" 
source "package/libpng/Config.in"
source "package/popt/Config.in"  # libpopt
source "package/postgresql/Config.in"  # libpq
source "package/libpthread/Config.in"
source "package/radiusclient-ng/Config.in" #libradiusclient-ng
source "package/readline/Config.in"  # libreadline
source "package/cyrus-sasl/Config.in"  # libsasl2
source "package/speex/Config.in" # libspeex
source "package/sqlite/Config.in" # libsqlite
source "package/sqlite2/Config.in" # libsqlite2
source "package/libtasn1/Config.in"
source "package/libupnp/Config.in"
source "package/libusb/Config.in"
source "package/libvorbis/Config.in"
source "package/libvorbisidec/Config.in"
source "package/libxml2/Config.in"
source "package/libxslt/Config.in"
source "package/uclibc++/Config.in"
source "package/ustl/Config.in"
source "package/zlib/Config.in"
endmenu

menu "Multimedia"
source "package/gmediaserver/Config.in"
source "package/icecast/Config.in"
source "package/madplay/Config.in"
source "package/mpd/Config.in"
source "package/mt-daapd/Config.in"
source "package/palantir/Config.in"
source "package/peercast/Config.in"
source "package/setpwc/Config.in"
endmenu

menu "Serial communications & terminal emulation"
source "package/heyu/Config.in"
source "package/lrzsz/Config.in"
source "package/microcom/Config.in"
source "package/picocom/Config.in"
source "package/serdisplib/Config.in"
source "package/setserial/Config.in"
endmenu

menu "Utilities"
source "package/bc/Config.in"
source "package/gcom/Config.in"
source "package/gdbserver/Config.in"
source "package/hdparm/Config.in"
source "package/pcmcia-cs/Config.in"  # pcmcia-utils
source "package/usbutils/Config.in"  # lsusb
source "package/pciutils/Config.in"
source "package/strace/Config.in"
source "package/udev/Config.in"
source "package/watchdog/Config.in"
endmenu

menu "FileSystems related"
source "package/dosfstools/Config.in"
source "package/e2fsprogs/Config.in"
source "package/fuse/Config.in"
source "package/shfs/Config.in"
source "package/util-linux/Config.in"
endmenu

menu "Bluetooth"
source "package/bluez-libs/Config.in"
source "package/bluez-utils/Config.in"
source "package/miax/Config.in"
endmenu

comment "Extra stuff"
source "package/sdk/Config.in"

config BR2_PACKAGE_IMAGEBUILDER
	bool "OpenWrt Image Builder"
	default y if CONFIG_DEVEL
	help
	  Build an OpenWrt Image Builder.
	  This package contains the necessary (precompiled) tools and all packages to generate
	  firmware images from package lists, without having to use the full buildroot.
	  Useful for building images with custom scripts or extra packages.

endmenu
```

## openwrt/package/aiccu/Config.in
```kconfig
config BR2_PACKAGE_AICCU
	select BR2_PACKAGE_KMOD_IPV6
	tristate "aiccu"
	default m if CONFIG_DEVEL
	help
	 SixXS Automatic IPv6 Connectivity Client Utility

	 For more information about SixXS check http://www.sixxs.net
```

## openwrt/package/aircrack-ng/Config.in
```kconfig
config BR2_PACKAGE_AIRCRACK_NG
	prompt "aircrack-ng....................... Next generation of aircrack with new features"
	tristate
	default n
	help
	  aircrack-ng is an 802.11 WEP and WPA-PSK keys cracking program 
	  that can recover this keys once enough encrypted packets have 
	  been captured. It implements the standard FMS attack along with 
	  some optimizations like KoreK attacks, thus making the attack 
	  much faster compared to other WEP cracking tools. In fact 
	  aircrack is a set of tools for auditing wireless networks.
	  
	  http://www.aircrack-ng.org/
```

## openwrt/package/amwall/Config.in
```kconfig
config BR2_PACKAGE_AMWALL
	prompt "amwall............................ PF to iptables"
	tristate
	default m if CONFIG_DEVEL
	select BR2_PACKAGE_LIBAMSEL
	help
	  PF for iptables
	  
	  http://amselinux.de/
```

## openwrt/package/arpd/Config.in
```kconfig
config BR2_PACKAGE_ARPD
	tristate "arpd - fake ARP replies"
	default m if CONFIG_DEVEL
	select BR2_PACKAGE_LIBPCAP
	select BR2_PACKAGE_LIBDNET
	select BR2_PACKAGE_LIBEVENT
	help
	  Generates ARP responses for (locally unused) IP addresses
	  
	  http://www.honeyd.org/tools.php
```

## openwrt/package/arptables/Config.in
```kconfig
config BR2_PACKAGE_ARPTABLES
	prompt "arptables......................... ARP firewall administration utility"
	tristate
	default m if CONFIG_DEVEL
	help
	  ARP Firewalling (arptables)
	  
	  http://ebtables.sourceforge.net/
```

## openwrt/package/arpwatch/Config.in
```kconfig
config BR2_PACKAGE_ARPWATCH
	prompt "arpwatch.......................... Ethernet station activity monitor"
	tristate
	default m if CONFIG_DEVEL
	help
	  Ethernet monitor program for keeping track of ethernet/ip address pairings
```
