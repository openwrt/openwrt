## Config.in
```kconfig
# Copyright (C) 2006-2012 OpenWrt.org
#
# This is free software, licensed under the GNU General Public License v2.
# See /LICENSE for more information.
#

mainmenu "OpenWrt Configuration"

config MODULES
	bool
	default y

config HAVE_DOT_CONFIG
	bool
	default y

source "target/Config.in"

menu "Target Images"

	menuconfig TARGET_ROOTFS_INITRAMFS
		bool "ramdisk"
		default y if USES_INITRAMFS
		help
		  Embed the rootfs into the kernel (initramfs)

		choice
			prompt "Compression"
			default TARGET_INITRAMFS_COMPRESSION_LZMA if TARGET_ar71xx
			default TARGET_INITRAMFS_COMPRESSION_LZMA if TARGET_ramips
			default TARGET_INITRAMFS_COMPRESSION_NONE
			depends on TARGET_ROOTFS_INITRAMFS
			help
			  Select ramdisk compression.

			config TARGET_INITRAMFS_COMPRESSION_NONE
				bool "none"

			config TARGET_INITRAMFS_COMPRESSION_GZIP
				bool "gzip"

			config TARGET_INITRAMFS_COMPRESSION_BZIP2
				bool "bzip2"

			config TARGET_INITRAMFS_COMPRESSION_LZMA
				bool "lzma"

			config TARGET_INITRAMFS_COMPRESSION_LZO
				bool "lzo"

			config TARGET_INITRAMFS_COMPRESSION_LZ4
				bool "lz4"

			config TARGET_INITRAMFS_COMPRESSION_XZ
				bool "xz"
		endchoice

		config EXTERNAL_CPIO
			string
			prompt "Use external cpio" if TARGET_ROOTFS_INITRAMFS
			default ""
			help
			  Kernel uses specified external cpio as INITRAMFS_SOURCE

	comment "Root filesystem archives"

	config TARGET_ROOTFS_CPIOGZ
		bool "cpio.gz"
		default y if USES_CPIOGZ
		help
		  Build a compressed cpio archive of the the root filesystem

	config TARGET_ROOTFS_TARGZ
		bool "tar.gz"
		default y if USES_TARGZ
		help
		  Build a compressed tar archive of the the root filesystem

	comment "Root filesystem images"

	config TARGET_ROOTFS_EXT4FS
		bool "ext4"
		default y if USES_EXT4
		help
		  Ext4 file system with some free space for uml images

	config TARGET_ROOTFS_ISO
		bool "iso"
		default n
		depends on TARGET_x86_generic
		help
		  Create some bootable ISO image

	config TARGET_ROOTFS_JFFS2
		bool "jffs2"
		default y if USES_JFFS2
		help
		  Build a jffs2 root filesystem

	config TARGET_ROOTFS_JFFS2_NAND
		bool "jffs2 for NAND"
		default y if USES_JFFS2_NAND
		depends on USES_JFFS2_NAND
		help
		  Build a jffs2 root filesystem for NAND flash

	config TARGET_ROOTFS_SQUASHFS
		bool "squashfs"
		default y if USES_SQUASHFS
		help
		  Build a squashfs-lzma root filesystem

	menuconfig TARGET_ROOTFS_UBIFS
		bool "ubifs"
		default y if USES_UBIFS
		depends on USES_UBIFS
		help
		  Build a ubifs root filesystem

		choice
			prompt "compression"
			default TARGET_UBIFS_COMPRESSION_NONE
			depends on TARGET_ROOTFS_UBIFS
			help
			  Select compression type

			config TARGET_UBIFS_COMPRESSION_NONE
				bool "none"

			config TARGET_UBIFS_COMPRESSION_LZO
				bool "lzo"

			config TARGET_UBIFS_COMPRESSION_ZLIB
				bool "zlib"
		endchoice

		config TARGET_UBIFS_FREE_SPACE_FIXUP
			bool "free space fixup" if TARGET_ROOTFS_UBIFS
			default y
			help
			  The file-system free space has to be fixed up on first mount

		config TARGET_UBIFS_JOURNAL_SIZE
			string
			prompt "journal size" if TARGET_ROOTFS_UBIFS
			default ""

	comment "Image Options"

	source "target/linux/*/image/Config.in"

	config TARGET_ROOTFS_PARTSIZE
		int "Root filesystem partition size (in MB)"
		depends on X86_GRUB_IMAGES || TARGET_ROOTFS_EXT4FS || TARGET_rb532
		default 48
		help
		  Allows you to change the root filesystem partition size

	config TARGET_ROOTFS_MAXINODE
		int "Maximum number of inodes in root filesystem"
		depends on TARGET_ROOTFS_EXT4FS
		default 6000
		help
		  Allows you to change the maximum number of inodes in the root filesystem

	config TARGET_ROOTFS_RESERVED_PCT
		int "Percentage of reserved blocks in root filesystem"
		depends on TARGET_ROOTFS_EXT4FS
		default 0
		help
		  Allows you to change the percentage of reserved blocks in the root filesystem

	menuconfig TARGET_ROOTFS_INCLUDE_KERNEL
		bool "Include kernel in root filesystem"
		depends on TARGET_ROOTFS_UBIFS || TARGET_ROOTFS_EXT4FS
		default n if USES_UBIFS
		help
		  Include the kernel image in the rootfs. Typically the image is placed
		  below /boot.

		config TARGET_ROOTFS_INCLUDE_UIMAGE
			bool "include uImage" if TARGET_ROOTFS_INCLUDE_KERNEL
			default y
			help
			  This option might not apply to all targets. Make sure
			  to check target/linux/<your_target>/image/Makefile to
			  see if this option will have any effect.

		config TARGET_ROOTFS_INCLUDE_ZIMAGE
			bool "include zImage" if TARGET_ROOTFS_INCLUDE_KERNEL
			default y
			help
			  This option might not apply to all targets. Make sure
			  to check target/linux/<your_target>/image/Makefile to
			  see if this option will have any effect.

		config TARGET_ROOTFS_INCLUDE_FIT
			bool "include FIT" if TARGET_ROOTFS_INCLUDE_KERNEL
			default y
			help
			  This option might not apply to all targets. Make sure
			  to check target/linux/<your_target>/image/Makefile to
			  see if this option will have any effect.

	config TARGET_ROOTFS_INCLUDE_DTB
		bool "Include DTB in root filesystem"
		depends on TARGET_ROOTFS_UBIFS || TARGET_ROOTFS_EXT4FS
		default n if USES_UBIFS
		help
		  Include the device tree blob file(s) in the rootfs. Typically the DTBs
		  are placed below /boot.

endmenu

menu "Global build settings"

	config ALL
		bool "Select all packages by default"
		default n

	comment "General build options"

	config DISPLAY_SUPPORT
		bool "Show packages that require graphics support (local or remote)"
		default n

	config BUILD_PATENTED
		default y
		bool "Compile with support for patented functionality"
		help
		  When this option is disabled, software which provides patented functionality will not be built.
		  In case software provides optional support for patented functionality,
		  this optional support will get disabled for this package.

	config BUILD_NLS
		default n
		bool "Compile with full language support"
		help
		  When this option is enabled, packages are built with the full versions of iconv and GNU gettext
		  instead of the default OpenWrt stubs. If uClibc is used, it is also built with locale support.

	config BUILD_STATIC_TOOLS
		default n
		bool "Attempt to link host utilities statically"
		help
		  Linking host utilities like sed or firmware-utils statically increases the portability of the
		  generated ImageBuilder and SDK tarballs, however it may fail on some Linux distributions.

	config SHADOW_PASSWORDS
		bool
		prompt "Enable shadow password support"
		default y
		help
		  Enable shadow password support.

	config CLEAN_IPKG
		bool
		prompt "Remove ipkg/opkg status data files in final images"
		default n
		help
		  This removes all ipkg/opkg status data files from the target directory before building the root fs

	config COLLECT_KERNEL_DEBUG
		bool
		prompt "Collect kernel debug information"
		select KERNEL_DEBUG_INFO
		default n
		help
		  This collects debugging symbols from the kernel and all compiled modules.
		  Useful for release builds, so that kernel issues can be debugged offline later.

	comment "Kernel build options"

	source "Config-kernel.in"

	comment "Package build options"

	config DEBUG
		bool
		prompt "Compile packages with debugging info"
		default n
		help
		  Adds -g3 to the CFLAGS

	config IPV6
		bool
		prompt "Enable IPv6 support in packages"
		default y
		help
		  Enable IPV6 support in packages (passes --enable-ipv6 to configure scripts).

	config PKG_BUILD_PARALLEL
		bool
		prompt "Compile certain packages parallelized"
		default y
		help
		  This adds a -jX option to certain packages that are known to
		  behave well for parallel build. By default the package make processes
		  use the main jobserver, in which case this option only takes effect
		  when you add -jX to the make command.

		  If you are unsure, select N.

	config PKG_BUILD_USE_JOBSERVER
		bool
		prompt "Use top-level make jobserver for packages"
		depends on PKG_BUILD_PARALLEL
		default y
		help
		  This passes the main make process jobserver fds to package builds,
		  enabling full parallelization across different packages

		  Note that disabling this may overcommit CPU resources depending on the
		  -j level of the main make process, the number of package
		  submake jobs selected below and the number of actual CPUs present.
		  Example: If the main make is passed a -j4 and the submake -j
		  is also set to 4, we may end up with 16 parallel make processes
		  in the worst case.


	config PKG_BUILD_JOBS
		int
		prompt "Number of package submake jobs (2-512)"
		range 2 512
		default 2
		depends on PKG_BUILD_PARALLEL && !PKG_BUILD_USE_JOBSERVER
		help
		  The number of jobs (-jX) to pass to packages submake.

	config PKG_DEFAULT_PARALLEL
		bool
		prompt "Parallelize the default package build rule (May break build)"
		depends on PKG_BUILD_PARALLEL
		depends on BROKEN
		default n
		help
		  Always set the default package build rules to parallel build.

		  WARNING: This may break build or kill your cat, as it builds
		  packages with multiple jobs that are probably not tested in
		  a parallel build environment.

		  Only say Y, if you don't mind fixing broken packages.
		  Before reporting build bugs, set this to N and re-run the build.

	comment "Stripping options"

	choice
		prompt "Binary stripping method"
		default USE_STRIP   if EXTERNAL_TOOLCHAIN
		default USE_STRIP   if USE_GLIBC || USE_EGLIBC || USE_MUSL
		default USE_SSTRIP
		help
		  Select the binary stripping method you wish to use.

		config NO_STRIP
			bool "none"
			help
			  This will install unstripped binaries (useful for native compiling/debugging)

		config USE_STRIP
			bool "strip"
			help
			  This will install binaries stripped using strip from binutils


		config USE_SSTRIP
			bool "sstrip"
			depends on !DEBUG
			depends on !USE_GLIBC
			depends on !USE_EGLIBC
			help
			  This will install binaries stripped using sstrip
	endchoice

	config STRIP_ARGS
		string
		prompt "Strip arguments"
		depends on USE_STRIP
		default "--strip-unneeded --remove-section=.comment --remove-section=.note" if DEBUG
		default "--strip-all"
		help
		  Specifies arguments passed to the strip command when stripping binaries

	config STRIP_KERNEL_EXPORTS
		bool "Strip unnecessary exports from the kernel image"
		help
		  Reduces kernel size by stripping unused kernel exports from the kernel image
		  Note that this might make the kernel incompatible with any kernel modules that
		  were not selected at the time the kernel image was created

	config USE_MKLIBS
		bool "Strip unnecessary functions from libraries"
		help
		  Reduces libraries to only those functions that are necessary for using all
		  selected packages (including those selected as <M>)
		  Note that this will make the system libraries incompatible with most of the packages
		  that are not selected during the build process

	choice
		prompt "Preferred standard C++ library"
		default USE_LIBSTDCXX if USE_EGLIBC
		default USE_UCLIBCXX
		help
		  Select the preferred standard C++ library for all packages that support this.

		config USE_UCLIBCXX
			bool "uClibc++"

		config USE_LIBSTDCXX
			bool "libstdc++"
	endchoice

endmenu

menuconfig DEVEL
	bool "Advanced configuration options (for developers)"
	default n

	config BROKEN
		bool "Show broken platforms / packages" if DEVEL
		default n

	config DOWNLOAD_FOLDER
		string "Download folder" if DEVEL
		default ""

	config LOCALMIRROR
		string "Local mirror for source packages" if DEVEL
		default ""

	config AUTOREBUILD
		bool "Automatic rebuild of packages" if DEVEL
		default y
		help
		  Automatically rebuild packages when their files change

	config BUILD_SUFFIX
		string "Build suffix to append to the BUILD_DIR variable" if DEVEL
		default ""
		help
		  Build suffix to append to the BUILD_DIR variable, i.e: build_dir_suffix

	config TARGET_ROOTFS_DIR
		string "Override the default TARGET_ROOTFS_DIR variable" if DEVEL
		default ""
		help
		  Override the default TARGET_ROOTFS_DIR variable content $(BUILD_DIR) with custom path.
		  Use this option to re-define the location of the target root file system directory.

	config CCACHE
		bool "Use ccache" if DEVEL
		default n
		help
		  Compiler cache; see http://ccache.samba.org/

	config EXTERNAL_KERNEL_TREE
		string "Use external kernel tree" if DEVEL
		default ""

	config KERNEL_GIT_CLONE_URI
		string "Enter git repository to clone" if DEVEL
		default ""
		help
		  Enter the full git repository path i.e.:
		  git://git.kernel.org/pub/scm/linux/kernel/git/torvalds/linux-2.6.git
		  This will create a git clone of the kernel in your build
		  directory.

	config KERNEL_GIT_LOCAL_REPOSITORY
		string "Enter path to local reference repository" if DEVEL
		default ""
		help
		  Enter a full pathname to a local reference git repository.
		  In this instance, the --refererence option of git clone will
		  be used thus creating a quick local clone of your repo.

	config BUILD_LOG
		bool "Enable log files during build process" if DEVEL
		help
		  If enabled log files will be written to the ./log directory

	config SRC_TREE_OVERRIDE
		bool "Enable package source tree override" if DEVEL
		help
		  If enabled, you can force a package to use a git tree as source
		  code instead of the normal tarball. Create a symlink 'git-src'
		  in the package directory, pointing to the .git tree that you want
		  to pull the source code from

	config EXTRA_OPTIMIZATION
		string "Additional compiler options" if DEVEL
		default "-fno-caller-saves"
		help
		  Extra Target-independent optimizations to use when building for the target.

menuconfig TARGET_OPTIONS
	bool "Target Options"  if DEVEL

	config TARGET_OPTIMIZATION
		string "Target Optimizations" if TARGET_OPTIONS
		default DEFAULT_TARGET_OPTIMIZATION
		help
		  Optimizations to use when building for the target host.

	config SOFT_FLOAT
		bool "Use software floating point by default" if TARGET_OPTIONS
		default y
		depends on (arm || armeb || powerpc || mipsel || mips || mips64el || mips64) && !HAS_FPU
		help
		  If your target CPU does not have a Floating Point Unit (FPU) or a
		  kernel FPU emulator, but you still wish to support floating point
		  functions, then everything will need to be compiled with soft floating
		  point support (-msoft-float).

		  Most people will answer N.

	config USE_MIPS16
		bool "Build packages with MIPS16 instructions" if TARGET_OPTIONS
		depends on HAS_MIPS16
		depends on !GCC_VERSION_4_6
		default y
		help
		  If your target CPU does support the MIPS16 instruction set
		  and you want to use it for packages, enable this option.
		  MIPS16 produces smaller binaries thus reducing pressure on
		  caches and TLB.

		  Most people will answer N.

source "toolchain/Config.in"

source "target/imagebuilder/Config.in"
source "target/sdk/Config.in"
source "target/toolchain/Config.in"

source "tmp/.config-package.in"
```
