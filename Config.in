## openwrt/package/asterisk/Config.in
```kconfig
menu "asterisk.......................... Complete open source PBX"

config BR2_PACKAGE_ASTERISK
	prompt "asterisk.......................... Complete open source PBX"
	tristate
	default m if CONFIG_DEVEL
	help
 	  Asterisk is a complete PBX in software. It provides all of the features
	  you would expect from a PBX and more. Asterisk does voice over IP in three
	  protocols, and can interoperate with almost all standards-based telephony 
	  equipment using relatively inexpensive hardware.
	  
	  http://www.asterisk.org/

config BR2_PACKAGE_ASTERISK_CHAN_BLUETOOTH
	prompt   "asterisk-chan-bluetooth......... Bluetooth HandsFreeProfile support for Asterisk"
	tristate
	default m if CONFIG_DEVEL
	depends BR2_PACKAGE_ASTERISK
	select BR2_PACKAGE_BLUEZ_LIBS
	help
	  The Bluetooth HandsFreeProfile support for Asterisk

config BR2_PACKAGE_ASTERISK_CHAN_H323
	prompt	"asterisk-chan-h323.............. H.323 support for Asterisk"
	tristate
	default m if CONFIG_DEVEL
	depends BR2_PACKAGE_ASTERISK
	select BR2_COMPILE_OPENH323
	select BR2_PACKAGE_LIBPTHREAD
	select BR2_PACKAGE_UCLIBCXX
	help
	  H.323 support for Asterisk

config BR2_PACKAGE_ASTERISK_CHAN_MGCP
	prompt   "asterisk-chan-mgcp.............. Media Gateway Control Protocol implementation"
	tristate
	default m if CONFIG_DEVEL
	depends BR2_PACKAGE_ASTERISK
	help
	  Media Gateway Control Protocol implementation for Asterisk

config BR2_PACKAGE_ASTERISK_CHAN_SKINNY
	prompt   "asterisk-chan-skinny............ Skinny Client Control Protocol implementation"
	tristate
	default m if CONFIG_DEVEL
	depends BR2_PACKAGE_ASTERISK
	help
	  Skinny Client Control Protocol implementation for Asterisk

config BR2_PACKAGE_ASTERISK_CODEC_ILBC
	prompt   "asterisk-codec-ilbc............. Internet Low Bitrate Codec (ILBC) Translator"
	tristate
	default m if CONFIG_DEVEL
	depends BR2_PACKAGE_ASTERISK
	help
	  The Internet Low Bitrate Codec (ILBC) Translator for Asterisk

config BR2_PACKAGE_ASTERISK_CODEC_LPC10
	prompt   "asterisk-codec-lpc10............ LPC10 (Linear Predictor Code) 2.4kbps Voice Coder"
	tristate
	default m if CONFIG_DEVEL
	depends BR2_PACKAGE_ASTERISK
	help
	  The LPC10 (Linear Predictor Code) 2.4kbps Voice Coder for Asterisk

config BR2_PACKAGE_ASTERISK_CODEC_SPEEX
	prompt   "asterisk-codec-speex............ Speex/PCM16 Codec Translator"
	tristate
	default m if CONFIG_DEVEL
	depends BR2_PACKAGE_ASTERISK
	select BR2_PACKAGE_LIBSPEEX
	help
	  The Speex speech compression codec for Asterisk

config BR2_PACKAGE_ASTERISK_PBX_DUNDI
	prompt   "asterisk-pbx-dundi.............. Distributed Universal Number Discovery (DUNDi) support"
	tristate
	default m if CONFIG_DEVEL
	depends BR2_PACKAGE_ASTERISK
	help
	  Distributed Universal Number Discovery (DUNDi) support for Asterisk

config BR2_PACKAGE_ASTERISK_RES_AGI
	prompt   "asterisk-res-agi................ Asterisk Gateway Interface module"
	tristate
	default m if CONFIG_DEVEL
	depends BR2_PACKAGE_ASTERISK
	help
	  Asterisk Gateway Interface module

config BR2_PACKAGE_ASTERISK_MYSQL
	prompt   "asterisk-mysql.................. MySQL modules"
	tristate
	default m if CONFIG_DEVEL
	depends BR2_PACKAGE_ASTERISK
	select BR2_PACKAGE_LIBMYSQLCLIENT
	help
	  MySQL modules for Asterisk

config BR2_PACKAGE_ASTERISK_PGSQL
	prompt   "asterisk-pgsql.................. PostgreSQL modules"
	tristate
	default m if CONFIG_DEVEL
	depends BR2_PACKAGE_ASTERISK
	select BR2_PACKAGE_LIBPQ
	help
	  PostgreSQL modules for Asterisk

config BR2_PACKAGE_ASTERISK_SQLITE
	prompt   "asterisk-sqlite................. SQLite modules"
	tristate
	default m if CONFIG_DEVEL
	depends BR2_PACKAGE_ASTERISK
	select BR2_PACKAGE_LIBSQLITE
	help
	  SQLite modules for Asterisk

config BR2_PACKAGE_ASTERISK_SOUNDS
	prompt   "asterisk-sounds................. Sound files"
	tristate
	default m if CONFIG_DEVEL
	depends BR2_PACKAGE_ASTERISK
	help
	  Sound files for Asterisk

config BR2_PACKAGE_ASTERISK_VOICEMAIL
	prompt   "asterisk-voicemail.............. Voicemail support"
	tristate
	default m if CONFIG_DEVEL
	depends BR2_PACKAGE_ASTERISK
	help
	  Voicemail related modules for Asterisk

config BR2_PACKAGE_ASTERISK_MINI
	prompt "asterisk-mini..................... Minimal open source PBX"
	tristate
	default m if CONFIG_DEVEL
	help
	  Asterisk is a complete PBX in software. It provides all of the features
	  you would expect from a PBX and more. Asterisk does voice over IP in three
	  protocols, and can interoperate with almost all standards-based telephony 
	  equipment using relatively inexpensive hardware.
	  
	  http://www.asterisk.org/
	  
	  This package contains only the following modules:
	    - chan_iax2
	    - chan_local
	    - chan_sip
	    - codec_gsm
	    - codec_ulaw
	    - format_gsm
	    - format_pcm
	    - format_wav
	    - format_wav_gsm
	    - pbx_config
	    - res_features
	    - res_musiconhold

endmenu
```

## openwrt/package/atftp/Config.in
```kconfig
#menu "atftp............................. TFTP implementation"

config BR2_COMPILE_ATFTP
	tristate
	default n
	depends BR2_PACKAGE_ATFTP || BR2_PACKAGE_ATFTPD
	select BR2_PACKAGE_LIBREADLINE
	
config BR2_PACKAGE_ATFTP
	prompt "atftp............................. TFTP client"
	tristate
	default m if CONFIG_DEVEL
	select BR2_COMPILE_ATFTP
	help
	  TFTP client

config BR2_PACKAGE_ATFTPD
	prompt "atftpd............................ TFTP server"
	tristate
	default m if CONFIG_DEVEL
	select BR2_COMPILE_ATFTP
	help
	  TFTP server 

#endmenu
```

## openwrt/package/axtls/Config.in
```kconfig
menu "axtls............................. Embedded client/server TLSv1 SSL library"

config BR2_COMPILE_AXTLS
	tristate
	default n
	depends BR2_PACKAGE_LIBAXTLS

config BR2_PACKAGE_LIBAXTLS
	prompt "libaxtls.......................... Embedded client/server TLSv1 SSL library"
	tristate
	default m if CONFIG_DEVEL
	select BR2_COMPILE_AXTLS
	help
	  Embedded client/server TLSv1 SSL library
	  
	  http://www.axtls.co.nr/
	  
config BR2_PACKAGE_AWHTTPD
	prompt   "awhttpd......................... Anti-Web webserver"
	tristate
	default m if CONFIG_DEVEL
	depends BR2_PACKAGE_LIBAXTLS
	help
	  Anti-Web is a light-weight, single-process, non-threaded webserver 
	  that emphasizes simplicity, efficiency, and security.
	  
	  http://www.axtls.co.nr/
	  
endmenu
```

## openwrt/package/bc/Config.in
```kconfig
config BR2_COMPILE_BC
	tristate
	depends BR2_PACKAGE_BC || BR2_PACKAGE_DC
	default n
	
config BR2_PACKAGE_BC
	prompt "bc................................ Arbitrary precision calculator language"
	tristate
	default m if CONFIG_DEVEL
	select BR2_COMPILE_BC
	help
      bc is a language that supports arbitrary precision numbers with
	  interactive execution of statements.
	  
config BR2_PACKAGE_DC
	prompt "dc................................ Arbitrary precision calculator"
	tristate
	default m if CONFIG_DEVEL
	select BR2_COMPILE_BC
	help
	  dc is a reverse-polish desk calculator which supports unlimited
	  precision arithmetic.
```

## openwrt/package/bind/Config.in
```kconfig
#menu "bind.............................. A DNS server implementation"

config BR2_COMPILE_BIND
	tristate
	default n
	depends BR2_PACKAGE_BIND_CLIENT || BR2_PACKAGE_BIND_SERVER
	
config BR2_PACKAGE_BIND_CLIENT
	prompt "bind-client....................... A dynamic DNS client"
	tristate
	default m if CONFIG_DEVEL
	select BR2_COMPILE_BIND
	select BR2_PACKAGE_LIBOPENSSL
	help
	  A DNS dynamic client (nsupdate)
	  
	  http://www.isc.org/sw/bind/
	  
	  Depends: openssl

config BR2_PACKAGE_BIND_SERVER
	prompt "bind-server....................... A DNS server"
	tristate
	default m if CONFIG_DEVEL
	select BR2_COMPILE_BIND
	select BR2_PACKAGE_LIBOPENSSL
	help
	  A DNS server (named)
	  
	  http://www.isc.org/sw/bind/
	  
	  Depends: openssl

#endmenu
```

## openwrt/package/bitchx/Config.in
```kconfig
config BR2_PACKAGE_BITCHX
	prompt "bitchx............................ popular IRC client"
	tristate
	default m if CONFIG_DEVEL
	select BR2_PACKAGE_LIBNCURSES
	help
	  A popular IRC client
	  
	  http://www.bitchx.org/
	  
```

## openwrt/package/bluez-libs/Config.in
```kconfig
config BR2_PACKAGE_BLUEZ_LIBS
	tristate "bluez-libs"
	default m if CONFIG_DEVEL
	help
	  Bluez libs. 
	  
	  http://bluez.org
	  
```

## openwrt/package/bluez-utils/Config.in
```kconfig
config BR2_PACKAGE_BLUEZ_UTILS
	prompt "bluez-utils....................... Bluetooth utilities"
	tristate
	default m if CONFIG_DEVEL
	select BR2_PACKAGE_GLIB1
	select BR2_PACKAGE_BLUEZ_LIBS
	help
	  Bluez utils. 
	  
	  http://bluez.org
	  
	  Depends: libpthread, bluez-libs
```

## openwrt/package/bridge/Config.in
```kconfig
config BR2_PACKAGE_BRIDGE
	prompt "bridge............................ Ethernet bridging configuration utility"
	tristate
	default y
	help
	  Manage ethernet bridging; a way to connect networks together to 
	  form a larger network.
	  
	  http://bridge.sourceforge.net/
```

## openwrt/package/busybox/Config.in
```kconfig
config BR2_PACKAGE_BUSYBOX
	bool "busybox - The Swiss Army Knife of embedded Linux"
	default y
	help
	  The Swiss Army Knife of embedded Linux.  It slices, it dices, it
	  makes Julian Fries.
	  
	  http://busybox.net/
	  
	  Most people will answer Y.

config BR2_PACKAGE_BUSYBOX_SNAPSHOT
	bool "Use the daily snapshot of busybox?"
	depends BR2_PACKAGE_BUSYBOX
	depends CONFIG_DEVEL
	default n
	help
	  Use the latest busybox CVS snapshot instead of release.

	  For fun, you should say Y.
	  
menu "Busybox Configuration"
	depends BR2_PACKAGE_BUSYBOX

source package/busybox/config/Config.in

endmenu
```
