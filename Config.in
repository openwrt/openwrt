## openwrt/package/busybox/config/editors/Config.in
```kconfig
#
# For a description of the syntax of this configuration file,
# see scripts/kbuild/config-language.txt.
#

menu "Editors"

config BUSYBOX_CONFIG_AWK
	bool "awk"
	default y
	help
	  Awk is used as a pattern scanning and processing language.  This is
	  the BusyBox implementation of that programming language.

config BUSYBOX_CONFIG_FEATURE_AWK_MATH
	bool "  Enable math functions (requires libm)"
	default y
	depends on BUSYBOX_CONFIG_AWK
	help
	  Enable math functions of the Awk programming language.
	  NOTE: This will require libm to be present for linking.

config BUSYBOX_CONFIG_PATCH
	bool "patch"
	default n
	help
	  Apply a unified diff formatted patch.

config BUSYBOX_CONFIG_SED
	bool "sed"
	default y
	help
	  sed is used to perform text transformations on a file
	  or input from a pipeline.

config BUSYBOX_CONFIG_VI
	bool "vi"
	default y
	help
	  'vi' is a text editor.  More specifically, it is the One True
	  text editor <grin>.  It does, however, have a rather steep
	  learning curve.  If you are not already comfortable with 'vi'
	  you may wish to use something else.

config BUSYBOX_CONFIG_FEATURE_VI_COLON
	bool "  Enable \":\" colon commands (no \"ex\" mode)"
	default y
	depends on BUSYBOX_CONFIG_VI
	help
	  Enable a limited set of colon commands for vi.  This does not
	  provide an "ex" mode.

config BUSYBOX_CONFIG_FEATURE_VI_YANKMARK
	bool "  Enable yank/put commands and mark cmds"
	default y
	depends on BUSYBOX_CONFIG_VI
	help
	  This will enable you to use yank and put, as well as mark in
	  busybox vi.

config BUSYBOX_CONFIG_FEATURE_VI_SEARCH
	bool "  Enable search and replace cmds"
	default y
	depends on BUSYBOX_CONFIG_VI
	help
	  Select this if you wish to be able to do search and replace in
	  busybox vi.

config BUSYBOX_CONFIG_FEATURE_VI_USE_SIGNALS
	bool "  Catch signals"
	default y
	depends on BUSYBOX_CONFIG_VI
	help
	  Selecting this option will make busybox vi signal aware.  This will
	  make busybox vi support SIGWINCH to deal with Window Changes, catch
	  Ctrl-Z and Ctrl-C and alarms.

config BUSYBOX_CONFIG_FEATURE_VI_DOT_CMD
	bool "  Remember previous cmd and \".\" cmd"
	default y
	depends on BUSYBOX_CONFIG_VI
	help
	  Make busybox vi remember the last command and be able to repeat it.

config BUSYBOX_CONFIG_FEATURE_VI_READONLY
	bool "  Enable -R option and \"view\" mode"
	default y
	depends on BUSYBOX_CONFIG_VI
	help
	  Enable the read-only command line option, which allows the user to
	  open a file in read-only mode.

config BUSYBOX_CONFIG_FEATURE_VI_SETOPTS
	bool "  Enable set-able options, ai ic showmatch"
	default y
	depends on BUSYBOX_CONFIG_VI
	help
	  Enable the editor to set some (ai, ic, showmatch) options.

config BUSYBOX_CONFIG_FEATURE_VI_SET
	bool "  Support for :set"
	default y
	depends on BUSYBOX_CONFIG_VI
	help
	  Support for ":set".

config BUSYBOX_CONFIG_FEATURE_VI_WIN_RESIZE
	bool "  Handle window resize"
	default y
	depends on BUSYBOX_CONFIG_VI
	help
	  Make busybox vi behave nicely with terminals that get resized.

config BUSYBOX_CONFIG_FEATURE_VI_OPTIMIZE_CURSOR
	bool "  Optimize cursor movement"
	default y
	depends on BUSYBOX_CONFIG_VI
	help
	  This will make the cursor movement faster, but requires more memory
	  and it makes the applet a tiny bit larger.

endmenu
```

## openwrt/package/busybox/config/findutils/Config.in
```kconfig
#
# For a description of the syntax of this configuration file,
# see scripts/kbuild/config-language.txt.
#

menu "Finding Utilities"

config BUSYBOX_CONFIG_FIND
	bool "find"
	default y
	help
	  find is used to search your system to find specified files.

config BUSYBOX_CONFIG_FEATURE_FIND_MTIME
	bool "  Enable modified time matching (-mtime) option"
	default n
	depends on BUSYBOX_CONFIG_FIND
	help
	  Allow searching based on the modification time of
	  files.

config BUSYBOX_CONFIG_FEATURE_FIND_PERM
	bool "  Enable permissions matching (-perm) option"
	default y
	depends on BUSYBOX_CONFIG_FIND
	help
	  Enable searching based on file permissions.

config BUSYBOX_CONFIG_FEATURE_FIND_TYPE
	bool "  Enable filetype matching (-type) option"
	default y
	depends on BUSYBOX_CONFIG_FIND
	help
	  Enable searching based on file type (file,
	  directory, socket, device, etc.).

config BUSYBOX_CONFIG_FEATURE_FIND_XDEV
	bool "  Enable stay in filesystem (-xdev) option"
	default y
	depends on BUSYBOX_CONFIG_FIND
	help
	  This option will allow find to restrict searches to a single
	  filesystem.

config BUSYBOX_CONFIG_FEATURE_FIND_NEWER
	bool "  Enable -newer option for comparing file mtimes"
	default n
	depends on BUSYBOX_CONFIG_FIND
	help
	  Support the 'find -newer' option for finding any files which have
	  a modified time that is more recent than the specified FILE.

config BUSYBOX_CONFIG_FEATURE_FIND_INUM
	bool "  Enable inode number matching (-inum) option"
	default n
	depends on BUSYBOX_CONFIG_FIND
	help
	  Support the 'find -inum' option for searching by inode number.

config BUSYBOX_CONFIG_GREP
	bool "grep"
	default y
	help
	  grep is used to search files for a specified pattern.

config BUSYBOX_CONFIG_FEATURE_GREP_EGREP_ALIAS
	bool "  Support extended regular expressions (egrep & grep -E)"
	default y
	depends on BUSYBOX_CONFIG_GREP
	help
	  Enabled support for extended regular expressions.  Extended
	  regular expressions allow for alternation (foo|bar), grouping,
	  and various repetition operators.

config BUSYBOX_CONFIG_FEATURE_GREP_FGREP_ALIAS
	bool "  Alias fgrep to grep -f"
	default y
	depends on BUSYBOX_CONFIG_GREP
	help
          fgrep sees the search pattern as a normal string rather than
	  regular expressions.
	  grep -f is always builtin, this just creates the fgrep alias.

config BUSYBOX_CONFIG_FEATURE_GREP_CONTEXT
	bool "  Enable before and after context flags (-A, -B and -C)"
	default y
	depends on BUSYBOX_CONFIG_GREP
	help
	  Print the specified number of leading (-B) and/or trailing (-A)
	  context surrounding our matching lines.
	  Print the specified number of context lines (-C).

config BUSYBOX_CONFIG_XARGS
	bool "xargs"
	default y
	help
	  xargs is used to execute a specified command on
	  every item from standard input.

config BUSYBOX_CONFIG_FEATURE_XARGS_SUPPORT_CONFIRMATION
	bool "  Enable prompt and confirmation option -p"
	default y
	depends on BUSYBOX_CONFIG_XARGS
	help
	  Support prompt the user about whether to run each command
	  line and read a line from the terminal.

config BUSYBOX_CONFIG_FEATURE_XARGS_SUPPORT_QUOTES
	bool "  Enable support single and double quotes and backslash"
	default y
	depends on BUSYBOX_CONFIG_XARGS
	help
	  Default xargs unsupport single and double quotes
	  and backslash for can use aruments with spaces.

config BUSYBOX_CONFIG_FEATURE_XARGS_SUPPORT_TERMOPT
	bool "  Enable support options -x"
	default y
	depends on BUSYBOX_CONFIG_XARGS
	help
	  Enable support exit if the size (see the -s or -n option)
	  is exceeded.

config BUSYBOX_CONFIG_FEATURE_XARGS_SUPPORT_ZERO_TERM
	bool "  Enable options -0"
	default y
	depends on BUSYBOX_CONFIG_XARGS
	help
	  Enable input filenames are terminated by a null character
	  instead of by whitespace, and the quotes and backslash
	  are not special.

endmenu
```

## openwrt/package/busybox/config/libbb/Config.in
```kconfig
#
# For a description of the syntax of this configuration file,
# see scripts/kbuild/config-language.txt.
#

menu "Busybox Library Tuning"

config BUSYBOX_CONFIG_MD5_SIZE_VS_SPEED
	int " MD5: Trade Bytes for Speed"
	default 2
	range 0 3
	help
	  Trade binary size versus speed for the md5sum algorithm.
	  Approximate values running uClibc and hashing
	  linux-2.4.4.tar.bz2 were:
	                    user times (sec)  text size (386)
	  0 (fastest)         1.1                6144
	  1                   1.4                5392
	  2                   3.0                5088
	  3 (smallest)        5.1                4912

endmenu
```
