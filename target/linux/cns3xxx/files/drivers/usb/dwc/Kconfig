## target/linux/generic/files/crypto/ocf/Kconfig
```kconfig
menu "OCF Configuration"

config OCF_OCF
	tristate "OCF (Open Cryptograhic Framework)"
	help
	  A linux port of the OpenBSD/FreeBSD crypto framework.

config OCF_RANDOMHARVEST
	bool "crypto random --- harvest entropy for /dev/random"
	depends on OCF_OCF
	help
	  Includes code to harvest random numbers from devices that support it.

config OCF_FIPS
	bool "enable fips RNG checks"
	depends on OCF_OCF && OCF_RANDOMHARVEST
	help
	  Run all RNG provided data through a fips check before
	  adding it /dev/random's entropy pool.

config OCF_CRYPTODEV
	tristate "cryptodev (user space support)"
	depends on OCF_OCF
	help
	  The user space API to access crypto hardware.

config OCF_CRYPTOSOFT
	tristate "cryptosoft (software crypto engine)"
	select CRYPTO_MANAGER
	depends on OCF_OCF
	help
	  A software driver for the OCF framework that uses
	  the kernel CryptoAPI.

config OCF_SAFE
	tristate "safenet (HW crypto engine)"
	depends on OCF_OCF
	help
	  A driver for a number of the safenet Excel crypto accelerators.
	  Currently tested and working on the 1141 and 1741.

config OCF_IXP4XX
	tristate "IXP4xx (HW crypto engine)"
	depends on OCF_OCF
	help
	  XScale IXP4xx crypto accelerator driver.  Requires the
	  Intel Access library.

config OCF_IXP4XX_SHA1_MD5
	bool "IXP4xx SHA1 and MD5 Hashing"
	depends on OCF_IXP4XX
	help
	  Allows the IXP4xx crypto accelerator to perform SHA1 and MD5 hashing.
	  Note: this is MUCH slower than using cryptosoft (software crypto engine).

config OCF_HIFN
	tristate "hifn (HW crypto engine)"
	depends on OCF_OCF
	help
	  OCF driver for various HIFN based crypto accelerators.
	  (7951, 7955, 7956, 7751, 7811)

config OCF_HIFNHIPP
	tristate "Hifn HIPP (HW packet crypto engine)"
	depends on OCF_OCF
	help
	  OCF driver for various HIFN (HIPP) based crypto accelerators
	  (7855)

config OCF_TALITOS
	tristate "talitos (HW crypto engine)"
	depends on OCF_OCF
	help
	  OCF driver for Freescale's security engine (SEC/talitos).

config OCF_PASEMI
	tristate "pasemi (HW crypto engine)"
	depends on OCF_OCF && PPC_PASEMI
	help
	  OCF driver for the PA Semi PWRficient DMA Engine

config OCF_EP80579
	tristate "ep80579 (HW crypto engine)"
	depends on OCF_OCF
	help
	  OCF driver for the Intel EP80579 Integrated Processor Product Line.

config OCF_CRYPTOCTEON
	tristate "cryptocteon (HW crypto engine)"
	depends on OCF_OCF
	help
	  OCF driver for the Cavium OCTEON Processors.

config OCF_KIRKWOOD
	tristate "kirkwood (HW crypto engine)"
	depends on OCF_OCF
	help
	  OCF driver for the Marvell Kirkwood (88F6xxx) Processors.

config OCF_C7108
	tristate "Micronas 7108 (HW crypto engine)"
	depends on OCF_OCF
	help
	  OCF driver for the Microna 7108 Cipher processors.

config OCF_OCFNULL
	tristate "ocfnull (fake crypto engine)"
	depends on OCF_OCF
	help
	  OCF driver for measuring ipsec overheads (does no crypto)

config OCF_BENCH
	tristate "ocf-bench (HW crypto in-kernel benchmark)"
	depends on OCF_OCF
	help
	  A very simple encryption test for the in-kernel interface
	  of OCF.  Also includes code to benchmark the IXP Access library
	  for comparison.

endmenu
```

## target/linux/generic/files/drivers/mtd/mtdsplit/Kconfig
```kconfig
config MTD_SPLIT
	def_bool n
	help
	  Generic MTD split support.

config MTD_SPLIT_SUPPORT
	def_bool MTD = y

comment "Rootfs partition parsers"

config MTD_SPLIT_SQUASHFS_ROOT
	bool "Squashfs based root partition parser"
	depends on MTD_SPLIT_SUPPORT
	select MTD_SPLIT
	default n
	help
	  This provides a parsing function which allows to detect the
	  offset and size of the unused portion of a rootfs partition
	  containing a squashfs.

comment "Firmware partition parsers"

config MTD_SPLIT_SEAMA_FW
	bool "Seama firmware parser"
	depends on MTD_SPLIT_SUPPORT
	select MTD_SPLIT

config MTD_SPLIT_UIMAGE_FW
	bool "uImage based firmware partition parser"
	depends on MTD_SPLIT_SUPPORT
	select MTD_SPLIT

config MTD_SPLIT_LZMA_FW
	bool "LZMA compressed kernel based firmware partition parser"
	depends on MTD_SPLIT_SUPPORT
	select MTD_SPLIT
```

## target/linux/generic/files/drivers/net/phy/b53/Kconfig
```kconfig
menuconfig B53
	tristate "Broadcom bcm53xx managed switch support"
	depends on SWCONFIG
	help
	  This driver adds support for Broadcom managed switch chips. It supports
	  BCM5325E, BCM5365, BCM539x, BCM53115 and BCM53125 as well as BCM63XX
	  integrated switches.

config B53_SPI_DRIVER
	tristate "B53 SPI connected switch driver"
	depends on B53 && SPI
	help
	  Select to enable support for registering switches configured through SPI.

config B53_PHY_DRIVER
	tristate "B53 MDIO connected switch driver"
	depends on B53
	select B53_PHY_FIXUP
	help
	  Select to enable support for registering switches configured through MDIO.

config B53_MMAP_DRIVER
	tristate "B53 MMAP connected switch driver"
	depends on B53
	help
	  Select to enable support for memory-mapped switches like the BCM63XX
	  integrated switches.

config B53_PHY_FIXUP
	bool
```

## target/linux/generic/files/drivers/pwm/Kconfig
```kconfig
#
# PWM infrastructure and devices
#

menuconfig GENERIC_PWM
	tristate "PWM Support"
	depends on SYSFS
	help
	  This enables PWM support through the generic PWM library.
	  If unsure, say N.

if GENERIC_PWM

config GPIO_PWM
       tristate "PWM emulation using GPIO"
       help
         This option enables a single-channel PWM device using
	 a kernel interval timer and a GPIO pin.  If unsure, say N.

endif
```

## target/linux/ifxmips/files-2.6.32/arch/mips/ifxmips/danube/Kconfig
```kconfig
if IFXMIPS_DANUBE

config IFXMIPS_ARCAYDIAN_BRNBOOT
	bool
	default n

menu "infineon SoC machine selection"

config DANUBE_MACH_EASY50712
	bool "Easy50712"
	default y

config DANUBE_MACH_EASY4010
	bool "Easy4010"
	default y

config DANUBE_MACH_ARV4519
	bool "ARV4519"
	default y
	select DANUBE_ARCAYDIAN_BRNBOOT

config DANUBE_MACH_ARV452
	bool "ARV452"
	default y
	select IFXMIPS_ARCAYDIAN_BRNBOOT

endmenu

endif
```

## target/linux/ifxmips/files-2.6.33/arch/mips/ifxmips/Kconfig
```kconfig
if IFXMIPS

choice
	prompt "Infineon SoC chip selection"
	default SOC_DANUBE
	help
		Select Infineon MIPS SoC type.

	config IFXMIPS_DANUBE
		bool "Danube/Twinpass"
		select SOC_DANUBE

endchoice

source "arch/mips/ifxmips/danube/Kconfig"

config SOC_DANUBE
	bool
	select DMA_NONCOHERENT
	select IRQ_CPU
	select CEVT_R4K
	select CSRC_R4K
	select SYS_HAS_CPU_MIPS32_R1
	select SYS_HAS_CPU_MIPS32_R2
	select HAVE_STD_PC_SERIAL_PORT
	select SYS_SUPPORTS_BIG_ENDIAN
	select SYS_SUPPORTS_32BIT_KERNEL
	select SYS_SUPPORTS_MULTITHREADING
	select SYS_HAS_EARLY_PRINTK
	select HW_HAS_PCI
	select ARCH_REQUIRE_GPIOLIB
	select SWAP_IO_SPACE
	select MIPS_MACHINE

if EARLY_PRINTK
menu "Infineon SoC settings"

choice
	prompt "Early printk port"
	help
	  Choose which serial port is used, until the console driver is loaded

config IFXMIPS_PROM_ASC0
	bool "ASC0"

config IFXMIPS_PROM_ASC1
	bool "ASC1"

endchoice

config IFXMIPS_COMPAT
	bool "Spinacer compatibility"
	default y
	help
	  Enable this to get some legacy API. This is needed if you use Lantiq DSL and VOIP drivers.

endmenu
endif
endif
```

## target/linux/ifxmips/files-2.6.33/arch/mips/ifxmips/ar9/Kconfig
```kconfig
if IFXMIPS_DANUBE

config IFXMIPS_ARCAYDIAN_BRNBOOT
	bool
	default n

menu "Lantiq SoC machine selection"

config DANUBE_MACH_EASY80712
	bool "Easy50812"
	default y

endmenu

endif
```

## target/linux/ifxmips/files/arch/mips/danube/Kconfig
```kconfig
# copyright 2007 john crispin <blogic@openwrt.org>

menu "Danube built-in"

config IFXMIPS_ASC_UART
	bool "Danube asc uart"
	select SERIAL_CORE
	select SERIAL_CORE_CONSOLE
	default y

config MTD_IFXMIPS
	bool "Danube flash map"
	default y

config IFXMIPS_WDT
	bool "Danube watchdog"
	default y

config IFXMIPS_LED
	bool "Danube led"
	default y

config IFXMIPS_GPIO
	bool "Danube gpio"
	default y

config IFXMIPS_SSC
	bool "Danube ssc"
	default y

config IFXMIPS_EEPROM
	bool "Danube eeprom"
	default y

endmenu
```

## target/linux/ifxmips/files/arch/mips/ifxmips/Kconfig
```kconfig
# copyright 2007 john crispin <blogic@openwrt.org>

menu "IFXMips built-in"

config MTD_IFXMIPS
	bool "IFXMips flash map"
	default y

config IFXMIPS_SSC
	bool "IFXMips ssc"
	default y

config IFXMIPS_EEPROM
	bool "IFXMips eeprom"
	default y

config IFXMIPS_MEI
	bool "IFXMips mei"
	default y

config IFXMIPS_GPIO_RST_BTN
	bool "Reset Button"
	default y

choice
	prompt "prom_printf ASC"
	help
	  Choose which serial port is used, until the console driver is loaded

config IFXMIPS_PROM_ASC0
	bool "ASC0"

config IFXMIPS_PROM_ASC1
	bool "ASC1"

endchoice


endmenu
```

## target/linux/ixp4xx-2.6/image/Config.in
```kconfig
config IXP4XX_INCLUDE_UCODE
	bool "Build images with Intel IXP4xx Microcode"
	depends LINUX_2_6_IXP4XX
	default y
	help
	  You must manually download IPL_ixp400NpeLibrary-2_4.zip from
	  http://www.intel.com/design/network/products/npfamily/ixp400_archives.htm
	  and put it in the dl/ directory of the build system.
	  You will need to agree to the Intel Public License to do so - please do read it!
```

## target/linux/lantiq/files-3.3/drivers/usb/ifxhcd/Kconfig
```kconfig
config USB_HOST_IFX
	tristate "Infineon USB Host Controller Driver"
	depends on USB
	default n
	help
	Infineon USB Host Controller

config USB_HOST_IFX_B
	bool "USB host mode on core 1 and 2"
	depends on USB_HOST_IFX
	help
	Both cores run as host

#config USB_HOST_IFX_1
#config USB_HOST_IFX_2

#config IFX_DANUBE
#config IFX_AMAZON_SE
config IFX_AR9
	depends on USB_HOST_IFX
	bool "AR9"

config IFX_VR9
	depends on USB_HOST_IFX
	bool "VR9"

#config USB_HOST_IFX_FORCE_USB11
#	bool "Forced USB1.1"
#	depends on USB_HOST_IFX
#	default n
#	help
#	force to be USB 1.1

#config USB_HOST_IFX_WITH_HS_ELECT_TST
#	bool "With HS_Electrical Test"
#	depends on USB_HOST_IFX
#	default n
#	help
#	With USBIF HSET routines

#config USB_HOST_IFX_WITH_ISO
#	bool "With ISO transfer"
#	depends on USB_HOST_IFX
#	default n
#	help
#	With USBIF ISO transfer

config USB_HOST_IFX_UNALIGNED_ADJ
	bool "Adjust"
	depends on USB_HOST_IFX
	help
	USB_HOST_IFX_UNALIGNED_ADJ

#config USB_HOST_IFX_UNALIGNED_CHK
#config USB_HOST_IFX_UNALIGNED_NONE
```

## target/linux/lantiq/files/arch/mips/configs/xway_defconfig
```kconfig
CONFIG_LANTIQ=y
CONFIG_CPU_MIPS32_R2=y
CONFIG_HIGH_RES_TIMERS=y
CONFIG_EXPERIMENTAL=y
CONFIG_DEFAULT_HOSTNAME="danube"
CONFIG_SYSVIPC=y
CONFIG_LOG_BUF_SHIFT=14
CONFIG_BLK_DEV_INITRD=y
CONFIG_INITRAMFS_SOURCE="../root-lantiq/ ../root-lantiq/initramfs-base-files.txt"
CONFIG_INITRAMFS_ROOT_UID=1000
CONFIG_INITRAMFS_ROOT_GID=1000
# CONFIG_RD_GZIP is not set
CONFIG_RD_LZMA=y
CONFIG_EMBEDDED=y
CONFIG_SLAB=y
CONFIG_MODULES=y
CONFIG_MODULE_UNLOAD=y
CONFIG_DEFAULT_DEADLINE=y
CONFIG_NET=y
CONFIG_PACKET=y
CONFIG_UNIX=y
CONFIG_INET=y
CONFIG_IP_MULTICAST=y
CONFIG_IP_ADVANCED_ROUTER=y
CONFIG_IP_MULTIPLE_TABLES=y
CONFIG_IP_ROUTE_MULTIPATH=y
CONFIG_IP_ROUTE_VERBOSE=y
CONFIG_IP_MROUTE=y
CONFIG_IP_MROUTE_MULTIPLE_TABLES=y
CONFIG_ARPD=y
CONFIG_SYN_COOKIES=y
CONFIG_NETFILTER=y
CONFIG_BRIDGE=m
CONFIG_VLAN_8021Q=y
CONFIG_NET_SCHED=y
CONFIG_UEVENT_HELPER_PATH="/sbin/hotplug"
CONFIG_MTD=y
CONFIG_MTD_CMDLINE_PARTS=y
CONFIG_MTD_CHAR=y
CONFIG_MTD_BLOCK=y
CONFIG_MTD_CFI=y
CONFIG_MTD_CFI_ADV_OPTIONS=y
CONFIG_MTD_CFI_GEOMETRY=y
CONFIG_MTD_CFI_INTELEXT=y
CONFIG_MTD_CFI_AMDSTD=y
CONFIG_MTD_COMPLEX_MAPPINGS=y
CONFIG_MTD_LANTIQ=y
CONFIG_MISC_DEVICES=y
CONFIG_NETDEVICES=y
CONFIG_MII=y
CONFIG_LANTIQ_ETOP=y
CONFIG_PHYLIB=y
CONFIG_SERIAL_LANTIQ=y
CONFIG_PINCTRL=y
CONFIG_GPIO_SYSFS=y
CONFIG_WATCHDOG=y
CONFIG_LANTIQ_WDT=y
CONFIG_TMPFS=y
CONFIG_JFFS2_FS=y
CONFIG_JFFS2_SUMMARY=y
CONFIG_JFFS2_FS_XATTR=y
CONFIG_JFFS2_COMPRESSION_OPTIONS=y
CONFIG_SQUASHFS=y
CONFIG_SQUASHFS_XZ=y
CONFIG_STRIP_ASM_SYMS=y
CONFIG_DEBUG_FS=y
```

## target/linux/lantiq/files/arch/mips/lantiq/falcon/Kconfig
```kconfig
if SOC_FALCON

menu "MIPS Machine"

config LANTIQ_MACH_EASY98000
	bool "Easy98000"
	default y

endmenu

endif
```
