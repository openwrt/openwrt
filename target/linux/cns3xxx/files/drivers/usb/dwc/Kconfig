## target/linux/cns3xxx/files/drivers/usb/dwc/Kconfig
```kconfig
#
# USB Dual Role (OTG-ready) Controller Drivers
# for silicon based on Synopsys DesignWare IP
#

comment "Enable Host or Gadget support for DesignWare OTG controller"
depends on !USB && USB_GADGET=n

config USB_DWC_OTG
	tristate "Synopsys DWC OTG Controller"
	depends on USB
	help
	   This driver provides USB Device Controller support for the
	   Synopsys DesignWare USB OTG Core used on the Cavium CNS34xx SOC.

config DWC_DEBUG
	bool "Enable DWC Debugging"
	depends on USB_DWC_OTG
	default n
	help
	   Enable DWC driver debugging

choice
	prompt "DWC Mode Selection"
	depends on USB_DWC_OTG
	default DWC_HOST_ONLY
	help
	   Select the DWC Core in OTG, Host only, or Device only mode.

config DWC_HOST_ONLY
	bool "DWC Host Only Mode"

config DWC_OTG_MODE
	bool "DWC OTG Mode"
	select USB_GADGET
	select USB_GADGET_SELECTED

config DWC_DEVICE_ONLY
	bool "DWC Device Only Mode"
	select USB_GADGET
	select USB_GADGET_SELECTED

endchoice
```

## target/linux/danube/files/arch/mips/danube/Kconfig
```kconfig
# copyright 2007 john crispin <blogic@openwrt.org>

menu "Danube built-in"

config DANUBE_ASC_UART
	bool "Danube asc uart"
	select SERIAL_CORE
	select SERIAL_CORE_CONSOLE
	default y

config MTD_DANUBE
	bool "Danube flash map"
	default y

config DANUBE_WDT
	bool "Danube watchdog"
	default y

config DANUBE_LED
	bool "Danube led"
	default y

config DANUBE_GPIO
	bool "Danube gpio"
	default y

config DANUBE_EEPROM
	bool "Danube eeprom"
	default y

endmenu
```

## target/linux/en75/files/arch/mips/en75/Kconfig
```kconfig
# SPDX-License-Identifier: GPL-2.0
if ECONET_EN75

choice
	prompt "EcoNet SoC selection"
	default SOC_EN751221
	help
	  Select EcoNet MIPS SoC type. EcoNet EN75xx are big endian MIPS
	  processors used in XPON (fiber), DSL, and SIM (4g) applications.
	  They have SPI, PCI, USB, GPIO, and Ethernet, with optional XPON,
	  SIM, DSL, and VoIP DSP cores.
	  Do not confuse these with EN7523 or EN7581 ARM processors which
	  are in the Airoha section.

	# Required kernel config parameters:
	# CONFIG_MIPS_RAW_APPENDED_DTB=y
	# CONFIG_ZBOOT_LOAD_ADDRESS=0x80020000

	config SOC_EN751221
		bool "EN751221 family"
		select SMP
		select SMP_UP
		select SYS_SUPPORTS_SMP
		select COMMON_CLK
		select IRQ_MIPS_CPU
		select EN751221_INTC
		select EN75_TIMER_HPT
		select SPI
		select SPI_MEM
		select SPI_MASTER
		select SPI_AIROHA_EN7523
		select MTD_SPI_NAND
		select MTD_NAND_MTK_BMT
		select MTD_UBI
		select MTD_UBI_BLOCK
		select UBIFS_FS
		select UBIFS_FS_LZO
		select UBIFS_FS_ZLIB
		select UBIFS_FS_ZSTD
		select UBIFS_ATIME_SUPPORT
		select UBIFS_FS_XATTR
		select UBIFS_FS_SECURITY
		select UBIFS_FS_AUTHENTICATION
		select SYS_SUPPORTS_ZBOOT_UART16550
		select DEBUG_ZBOOT
		select SERIAL_OF_PLATFORM
		help
		  The EN751221 family includes EN7512, RN7513, EN7521, EN7526.
		  They are based on single core MIPS 34Kc processors.
endchoice

endif
```

## target/linux/generic-2.6/files/drivers/gpio/Kconfig
```kconfig
menuconfig NEW_GPIO
	bool "GPIO Support"
	depends on GENERIC_GPIO
	help
	  Say Y to enable Linux GPIO device support.  This allows control of 
	  GPIO pins using a character device 

if NEW_GPIO

config GPIO_DEVICE
	tristate "GPIO device support"
	help
	  This option enables the gpio character device 

endif # NEW_GPIO
```

## target/linux/generic-2.6/files/drivers/pwm/Kconfig
```kconfig
#
# PWM infrastructure and devices
#

menuconfig GENERIC_PWM
	tristate "PWM Support"
	depends on SYSFS
	help
	  This enables PWM support through the generic PWM library.
	  If unsure, say N.

if GENERIC_PWM

config ATMEL_PWM
	tristate "Atmel AT32/AT91 PWM support"
	depends on AVR32 || ARCH_AT91
	help
	  This option enables device driver support for the PWMC
	  peripheral channels found on certain Atmel processors.
	  Pulse Width Modulation is used many for purposes, including
	  software controlled power-efficient backlights on LCD
	  displays, motor control, and waveform generation.  If
	  unsure, say N.

config GPIO_PWM
       tristate "PWM emulation using GPIO"
       help
         This option enables a single-channel PWM device using
	 a kernel interval timer and a GPIO pin.  If unsure, say N.

endif
```

## target/linux/generic/files/Documentation/devicetree/bindings/mfd/hasivo,stc8-mfd.yaml
```yaml
# SPDX-License-Identifier: GPL-2.0
# STC8 MFD binding for Hasivo STC8 microcontroller used in managed switches

title: "STC8 multi-function device"
description: |
  This binding describes the Hasivo STC8 multi-function device.
  This is an STC8 microcontroller with custom firmware used by Hasivo to
  provide various functions on their managed switch products.
  The main known functionality currently is to allow for discrete GPIO control
  which turns on/off LEDs and controls PWM for fan speed.
  It is known that for the discrete IO however, the host must send an execute
  flag (0x40) along with the register write to have the STC8 apply the change.
  This binding allows for specifying which registers require this execute flag
  to be set automatically by the MFD driver.

maintainers:
  - bevan.weiss@gmail.com

properties:
  compatible:
    description: >
      Must be "hasivo,stc8-mfd" for the MFD driver to bind.
      Some child devices may require that this also expose the "syscon" binding.
    type: string
    required: true

  reg:
    description: >
      I2C address of the STC8 device on the bus.
    type: integer
    required: true

  hasivo,execute-bit:
    description: >
      The mask that will be automatically ORd on writes to the registers
      specified in hasivo,execute-bit-regs.
      If not specified, defaults to 0x40.
    type: unsigned integer
    defaults: 0x40
    required: false

  hasivo,execute-bit-regs:
    description: >
      Array of registers for which the execute-bit mask should be
      automatically ORed on writes.
      If not specified, no registers will have the execute bit set.
    type: array of unsigned integers
    required: false

required:
  - compatible
  - reg

children:

examples:
  - |
    &i2c0 {
        status = "okay";

        stc8: stc8-mfd@0x4d {
            compatible = "hasivo,stc8-mfd", "syscon";
            reg = <0x4d>;
            hasivo,execute-bit = <0x40>;
            hasivo,execute-bit-regs = <0x01 0x02>;

            poe_led_lan1: led@1,1 {
                compatible = "register-bit-led";
                offset = <0x01>;
                mask = <0x01>;
                label = "orange:poe_led_lan1";
                default-state = "off";
            };
            poe_led_lan2: led@1,2 {
                compatible = "register-bit-led";
                offset = <0x01>;
                mask = <0x02>;
                label = "orange:poe_led_lan2";
                default-state = "off";
            };
            poe_led_lan3: led@1,3 {
                compatible = "register-bit-led";
                offset = <0x01>;
                mask = <0x04>;
                label = "orange:poe_led_lan3";
                default-state = "off";
            };
            poe_led_lan4: led@1,4 {
                compatible = "register-bit-led";
                offset = <0x01>;
                mask = <0x08>;
                label = "orange:poe_led_lan4";
                default-state = "off";
            };
        };
    };
```

## target/linux/generic/files/Documentation/devicetree/bindings/net/pse-pd/brcm,bcm59xxx.yaml
```yaml
# SPDX-License-Identifier: (GPL-2.0-only OR BSD-2-Clause)
%YAML 1.2
---
$id: http://devicetree.org/schemas/net/pse-pd/brcm,bcm59xxx.yaml#
$schema: http://devicetree.org/meta-schemas/core.yaml#

title: MCU front-end for Broadcom PoE PSE chips

maintainers:
  - Jonas Jelonek <jelonek.jonas@gmail.com>

description:
  Microcontroller (MCU) that fronts the PoE PSE hardware on switches using
  Broadcom PSE chips (BCM59011, BCM59111, BCM59121). The MCU exposes a
  small message-based protocol over either I2C/SMBus or UART; the actual
  PSE silicon is not accessed directly. The same protocol family is also
  spoken by MCUs fronting Realtek PSE chips (see realtek,rtl823x.yaml).

  The compatible identifies the PSE chip family managed by the MCU, not
  the MCU silicon itself (which varies across boards and is incidental
  to the protocol).

properties:
  compatible:
    enum:
      - brcm,bcm59011
      - brcm,bcm59111
      - brcm,bcm59121

  reg:
    maxItems: 1

  current-speed: true

  power-supply:
    description: Regulator supplying the PoE power rail.

  enable-gpios:
    maxItems: 1

  '#pse-cells':
    const: 1

  pse-pis:
    patternProperties:
      "^pse-pi@[0-9a-f]+$":
        properties:
          max-power-milliwatt:
            description: Per-port maximum power, capped by the chip family.

required:
  - compatible

allOf:
  - $ref: pse-controller.yaml#
  - if:
      properties:
        compatible:
          contains:
            enum:
              - brcm,bcm59011
              - brcm,bcm59111
    then:
      properties:
        pse-pis:
          patternProperties:
            "^pse-pi@[0-9a-f]+$":
              properties:
                max-power-milliwatt:
                  maximum: 30000   # TODO: verify on hardware
  - if:
      properties:
        compatible:
          contains:
            const: brcm,bcm59121
    then:
      properties:
        pse-pis:
          patternProperties:
            "^pse-pi@[0-9a-f]+$":
              properties:
                max-power-milliwatt:
                  maximum: 60000   # 802.3bt Type 3

unevaluatedProperties: false

examples:
  - |
    i2c {
        #address-cells = <1>;
        #size-cells = <0>;

        ethernet-pse@20 {
            compatible = "brcm,bcm59121";
            reg = <0x20>;
            #pse-cells = <1>;

            pse-pis {
                #address-cells = <1>;
                #size-cells = <0>;

                pse-pi@0 {
                    reg = <0>;
                    #pse-cells = <0>;
                    max-power-milliwatt = <60000>;
                };
            };
        };
    };
```

## target/linux/generic/files/Documentation/devicetree/bindings/net/pse-pd/hasivo,hs104.yaml
```yaml
# SPDX-License-Identifier: (GPL-2.0-only OR BSD-2-Clause)
%YAML 1.2
---
$id: http://devicetree.org/schemas/net/pse-pd/hasivo,hs104.yaml#
$schema: http://devicetree.org/meta-schemas/core.yaml#

title: Hasivo HS104 Power Sourcing Equipment controller

maintainers:
  - Bevan Weiss <bevan.weiss@gmail.com>

description: |
  The HS104PTI/HS104PBI are single-chip PoE PSE controllers managing 4
  delivery channels, allowing them to supply 4 ports of 802.3af/at/bt power.
  The HS104PTI can have 1x 802.3bt port and 3x 802.3at ports.
  The HS104PBI can have 4x 802.3bt ports.

allOf:
  - $ref: pse-controller.yaml#

properties:
  compatible:
    enum:
      - hasivo,hs104
      - hasivo,hs104pti
      - hasivo,hs104pbi

  reg:
    maxItems: 1

  '#pse-cells':
    const: 1

unevaluatedProperties: false

required:
  - compatible
  - reg
  - '#pse-cells'

examples:
  - |
    i2c {
      #address-cells = <1>;
      #size-cells = <0>;

      ethernet-pse@d {
        compatible = "hasivo,hs104";
        reg = <0x0d>;
        #pse-cells = <1>;
      };
    };
```

## target/linux/generic/files/Documentation/devicetree/bindings/net/pse-pd/realtek,rtl823x.yaml
```yaml
# SPDX-License-Identifier: (GPL-2.0-only OR BSD-2-Clause)
%YAML 1.2
---
$id: http://devicetree.org/schemas/net/pse-pd/realtek,rtl823x.yaml#
$schema: http://devicetree.org/meta-schemas/core.yaml#

title: MCU front-end for Realtek PoE PSE chips

maintainers:
  - Jonas Jelonek <jelonek.jonas@gmail.com>

description:
  Microcontroller (MCU) that fronts the PoE PSE hardware on Realtek-family
  PoE switches. The MCU exposes a small message-based protocol over either
  I2C/SMBus or UART; the actual PSE silicon is not accessed directly.

  The compatible identifies the PSE chip family managed by the MCU, not
  the MCU silicon itself (which varies across boards and is incidental
  to the protocol).

properties:
  compatible:
    enum:
      - realtek,rtl8238b
      - realtek,rtl8239
      - realtek,rtl8239c

  reg:
    maxItems: 1

  current-speed: true

  power-supply:
    description: Regulator supplying the PoE power rail.

  enable-gpios:
    maxItems: 1

  '#pse-cells':
    const: 1

  pse-pis:
    patternProperties:
      "^pse-pi@[0-9a-f]+$":
        properties:
          max-power-milliwatt:
            description: Per-port maximum power, capped by the chip family.

  realtek,i2c-protocol:
    $ref: /schemas/types.yaml#/definitions/string
    enum: [ i2c, smbus ]
    description: |
      Wire framing the MCU firmware expects on the I2C bus. "smbus" means
      reads carry a leading command byte (0x00) and a repeated start;
      "i2c" means bare 12-byte writes and reads with no command prefix.
      Required for the I2C attachment; not applicable to the UART one.

required:
  - compatible

allOf:
  - $ref: pse-controller.yaml#
  - if:
      required: [reg]
    then:
      required: [realtek,i2c-protocol]
    else:
      properties:
        realtek,i2c-protocol: false
  - if:
      properties:
        compatible:
          contains:
            const: realtek,rtl8238b
    then:
      properties:
        pse-pis:
          patternProperties:
            "^pse-pi@[0-9a-f]+$":
              properties:
                max-power-milliwatt:
                  maximum: 30000
  - if:
      properties:
        compatible:
          contains:
            enum:
              - realtek,rtl8239
              - realtek,rtl8239c
    then:
      properties:
        pse-pis:
          patternProperties:
            "^pse-pi@[0-9a-f]+$":
              properties:
                max-power-milliwatt:
                  maximum: 90000

unevaluatedProperties: false

examples:
  - |
    i2c {
        #address-cells = <1>;
        #size-cells = <0>;

        ethernet-pse@20 {
            compatible = "realtek,rtl8239";
            reg = <0x20>;
            #pse-cells = <1>;
            realtek,i2c-protocol = "smbus";

            pse-pis {
                #address-cells = <1>;
                #size-cells = <0>;

                pse-pi@0 {
                    reg = <0>;
                    #pse-cells = <0>;
                    max-power-milliwatt = <60000>;
                };
            };
        };
    };

  - |
    serial {
        ethernet-pse {
            compatible = "realtek,rtl8239c";
            current-speed = <115200>;
            #pse-cells = <1>;
        };
    };
```
