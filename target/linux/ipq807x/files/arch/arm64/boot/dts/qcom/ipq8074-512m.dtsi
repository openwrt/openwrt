// SPDX-License-Identifier: GPL-2.0-or-later OR MIT

#include "ipq8074.dtsi"

&q6_region {
	reg = <0x0 0x4b000000 0x0 0x03700000>;
};

&q6_etr_region {
	reg = <0x0 0x4e700000 0x0 0x100000>;
};

&m3_region {
	reg = <0x0 0x4e800000 0x0 0x100000>;
};
