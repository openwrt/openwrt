// SPDX-License-Identifier: GPL-2.0-or-later OR MIT

#include "qcom-ipq8068-ap-32x.dtsi"

/ {
	model = "Aruba AP-32x";
	compatible = "aruba,ap-32x", "qcom,ipq8064";

	memory@0 {
		reg = <0x41500000 0x1eb00000>;
		device_type = "memory";
	};
};
