// SPDX-License-Identifier: GPL-2.0-or-later OR MIT

/dts-v1/;

#include "ipq9574-archer-ge800-common.dtsi"

/ {
	model = "TP-Link Archer GE800";
	compatible = "tplink,archer-ge800", "qcom,ipq9574";
};

&phy5 {
	status = "okay";
};

&xgmac6 {
	phy-mode = "usxgmii";
	managed = "in-band-status";
	phy-handle = <&phy5>;
};
