// SPDX-License-Identifier: (GPL-2.0+ OR BSD-3-Clause)

/dts-v1/;

#include "ipq9554-jiorouter-ax6000-common.dtsi"

/ {
	model = "JioRouter AX6000 JIDU6811";
	compatible = "jiorouter,ax6000-jidu6811", "qcom,ipq9574";
};

&wifi0 {
	qcom,calibration-variant = "JIDU6811";
};

&wifi1 {
	qcom,calibration-variant = "JIDU6811";
};
