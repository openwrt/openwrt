// SPDX-License-Identifier: (GPL-2.0+ OR BSD-3-Clause)

/dts-v1/;

#include "ipq9554-jiorouter-ax6000-common.dtsi"

/ {
	model = "JioRouter AX6000 JIDU6411";
	compatible = "jiorouter,ax6000-jidu6411", "qcom,ipq9574";
};

&wifi0 {
	qcom,calibration-variant = "JIDU6411";
};

&wifi1 {
	qcom,calibration-variant = "JIDU6411";
};
