/*
 * Copyright (C) 2015 Imagination Technologies Ltd.
 *
 * This program is free software; you can redistribute it and/or modify
 * it under the terms of the GNU General Public License version 2 as
 * published by the Free Software Foundation.
 */


/ {
	uboot-count {
		compatible = "uboot,bootcount";
		reg = <0x18102120 0x4>;
	};
};
