// SPDX-License-Identifier: (GPL-2.0-only OR BSD-2-Clause)
/dts-v1/;
/plugin/;

#include <dt-bindings/gpio/gpio.h>
#include <dt-bindings/input/input.h>
#include <dt-bindings/leds/common.h>
#include "an7581-npu-mt7992.dtsi"

&{/} {
	model = "Airoha AN7581 Evaluation Board";
	compatible = "airoha,an7581-evb", "airoha,an7581", "airoha,en7581";
};

&i2c0 {
    status = "okay";
};

&snfi {
	status = "okay";
};
