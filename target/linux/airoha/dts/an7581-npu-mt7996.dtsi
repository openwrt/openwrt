// SPDX-License-Identifier: (GPL-2.0-only OR BSD-2-Clause)

#include "an7581-npu-wlan.dtsi"

&npu_dma {
	/* mt76 shares this pool for packet buffers and descriptors. */
	size = <0x0 0x4000000>;
	alignment = <0x0 0x40000>;
};

&npu {
	firmware-name = "airoha/en7581_MT7996_npu_rv32.bin",
                        "airoha/en7581_MT7996_npu_data.bin";
};
