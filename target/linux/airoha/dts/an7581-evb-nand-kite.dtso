/dts-v1/;
/plugin/;

#include <dt-bindings/leds/common.h>
#include <dt-bindings/gpio/gpio.h>
#include <dt-bindings/input/input.h>
#include "an7581-npu-mt7992.dtsi"

&{/} {
	compatible = "airoha,an7581-evb", "airoha,an7581", "airoha,en7581";
};

&snfi {
	status = "okay";
};
