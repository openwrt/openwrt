// SPDX-License-Identifier: GPL-2.0
/dts-v1/;

#include <dt-bindings/gpio/gpio.h>
#include <dt-bindings/input/input.h>
#include "armada-xp-98dx3236.dtsi"

/ {
	model = "Mikrotik CRS305";
	compatible = "mikrotik,crs305", "marvell,armadaxp-98dx3236", "marvell,armada-370-xp";

	chosen {
		bootargs = "console=ttyS0,115200";
		stdout-path = "serial0:115200n8";
/*		append-rootblock = "root=/dev/mtdblock"; */
	};

  memory {
	  device_type = "memory";
    reg = <0 0x00000000 0 0x20000000>; /* 512 MiB */
  };
};

&uart0 {
	status = "okay";
};
