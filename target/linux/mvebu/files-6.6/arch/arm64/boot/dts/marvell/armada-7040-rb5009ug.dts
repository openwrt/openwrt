// SPDX-License-Identifier: GPL-2.0-or-later OR MIT

/dts-v1/;

#include "armada-7040-rb5009.dtsi"

/ {
	model = "MikroTik RB5009UG";
	compatible = "mikrotik,rb5009ug", "mikrotik,rb5009", "marvell,armada7040",
	"marvell,armada-ap806-quad", "marvell,armada-ap806";
};
