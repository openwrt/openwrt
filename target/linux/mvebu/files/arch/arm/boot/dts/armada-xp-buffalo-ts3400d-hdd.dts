// SPDX-License-Identifier: GPL-2.0-or-later OR MIT
/dts-v1/;

#include "armada-xp-buffalo-ts3400d.dtsi"

/ {
	model = "Buffalo TeraStation TS3400D (HDD)";
	compatible = "buffalo,ts3400d-hdd", "marvell,armadaxp-mv78230", "marvell,armadaxp", "marvell,armada-370-xp";

	chosen {
		/*
		 * use the partition labeled as "rootfs" on HDD with GPT partition
		 * as rootfs
		 */
		bootargs-append = " 8250.nr_uarts=3 root=PARTLABEL=rootfs rootwait";
	};
};
