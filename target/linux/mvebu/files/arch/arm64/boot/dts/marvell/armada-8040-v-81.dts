// SPDX-License-Identifier: GPL-2.0-or-later OR MIT

/dts-v1/;

#include "armada-8040-v-81x.dtsi"

/ {
	model = "Check Point V-81";
	compatible = "checkpoint,v-81", "marvell,armada8040",
		     "marvell,armada-ap806-quad", "marvell,armada-ap806";
};

&cp0_pinctrl {
	pmx_pca9555_pins: pca9555-pins {
		marvell,pins = "mpp33";
		marvell,function = "gpio";
	};
};

/* Expander interrupt is wired up (used by the SFP signals) */
&gpio3 {
	pinctrl-0 = <&pmx_pca9555_pins>;
	pinctrl-names = "default";
	interrupt-parent = <&cp0_gpio2>;
	interrupts = <1 IRQ_TYPE_EDGE_FALLING>;
	interrupt-controller;
	#interrupt-cells = <2>;
};
