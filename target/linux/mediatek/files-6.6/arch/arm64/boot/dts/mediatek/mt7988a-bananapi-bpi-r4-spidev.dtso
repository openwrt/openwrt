// SPDX-License-Identifier: GPL-2.0-or-later OR MIT

/dts-v1/;
/plugin/;

/ {
        compatible = "bananapi,bpi-r4", "mediatek,mt7988a";

        fragment@0 {
                target-path = "/soc/spi@11008000";
                __overlay__ {

                pinctrl-names = "default";
                pinctrl-0 = <&spi1_pins>;
                status = "okay";

                spidev@0 {
                        compatible = "linux,spidev";
                        reg = <0>;
                        #address-cells = <1>;
                        #size-cells = <0>;
                        spi-max-frequency = <52000000>;
                        status = "okay";
                        };
                };
        };
};
