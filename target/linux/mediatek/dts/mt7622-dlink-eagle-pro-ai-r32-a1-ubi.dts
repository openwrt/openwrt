// SPDX-License-Identifier: GPL-2.0-or-later OR MIT

/dts-v1/;
#include "mt7622-dlink-eagle-pro-ai-ax3200-a1-ubi.dtsi"
#include "mt7622-dlink-eagle-pro-ai-r32-a1-common.dtsi"

/ {
	model = "D-Link EAGLE PRO AI R32 A1 (OpenWrt U-Boot (UBI) layout)";
	compatible = "dlink,eagle-pro-ai-r32-a1-ubi", "mediatek,mt7622";
};
