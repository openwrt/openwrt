// SPDX-License-Identifier: (GPL-2.0 OR MIT)

#include "mt7981b-cudy-tr3000-v1.dtsi"

/ {
	model = "Cudy TR3000 256MB v1";
	compatible = "cudy,tr3000-256mb-v1", "mediatek,mt7981";
};

&spi_nand {
	spi-cal-enable;
	spi-cal-mode = "read-data";
	spi-cal-datalen = <7>;
	spi-cal-data = /bits/ 8 <0x53 0x50 0x49 0x4E 0x41 0x4E 0x44>;
	spi-cal-addrlen = <5>;
	spi-cal-addr = /bits/ 32 <0x0 0x0 0x0 0x0 0x0>;

	mediatek,nmbm;
	mediatek,bmt-max-ratio = <1>;
	mediatek,bmt-max-reserved-blocks = <64>;
};

&ubi {
	reg = <0x5c0000 0xe600000>;
};

