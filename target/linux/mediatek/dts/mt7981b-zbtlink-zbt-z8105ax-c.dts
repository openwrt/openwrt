// SPDX-License-Identifier: GPL-2.0-or-later OR MIT

/dts-v1/;

#include "mt7981b-zbtlink-zbt-z8105ax-c.dtsi"

/ {
	model = "Zbtlink ZBT-Z8105AX-C";
	compatible = "zbtlink,zbt-z8105ax-c", "mediatek,mt7981b";
};

&port_4 {
	/* The 4th port must be defined but isn't usable in model C, so we set it to disabled. */
	status = "disabled";
};
