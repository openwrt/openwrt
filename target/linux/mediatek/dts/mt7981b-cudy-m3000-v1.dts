// SPDX-License-Identifier: (GPL-2.0 OR MIT)

/dts-v1/;

#include "mt7981b-cudy-m3000-v1.dtsi"

/ {
	model = "Cudy M3000 v1/v2";
	compatible = "cudy,m3000-v1", "mediatek,mt7981";
};

&spi_nand {
	mediatek,nmbm;
	mediatek,bmt-max-ratio = <1>;
	mediatek,bmt-max-reserved-blocks = <64>;
};
