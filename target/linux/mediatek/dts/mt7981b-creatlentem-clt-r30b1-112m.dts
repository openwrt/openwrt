// SPDX-License-Identifier: GPL-2.0-or-later OR MIT

#include "mt7981b-creatlentem-clt-r30b1-common.dtsi"

/ {
	model = "CreatLentem CLT-R30B1 (112M)";
	compatible = "creatlentem,clt-r30b1-112m", "mediatek,mt7981";
};

&partitions {
	partition@580000 {
		label = "ubi";
		reg = <0x0580000 0x7000000>;
	};
};
