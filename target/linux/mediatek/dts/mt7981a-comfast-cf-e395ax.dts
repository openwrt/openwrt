// SPDX-License-Identifier: GPL-2.0-or-later OR MIT

/dts-v1/;
#include "mt7981a-comfast-cf-e39xax-common.dtsi"

/ {
	model = "COMFAST CF-E395AX";
	compatible = "comfast,cf-e395ax", "mediatek,mt7981";
};

