// SPDX-License-Identifier: GPL-2.0-or-later OR MIT

/dts-v1/;
#include "mt7622-dlink-eagle-pro-ai-ax3200-a1-stock.dtsi"
#include "mt7622-dlink-eagle-pro-ai-m32-a1-common.dtsi"

/ {
	model = "D-Link EAGLE PRO AI M32 A1";
	compatible = "dlink,eagle-pro-ai-m32-a1", "mediatek,mt7622";
};
