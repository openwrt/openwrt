// SPDX-License-Identifier: (GPL-2.0 OR MIT)
/*
 * Copyright (C) 2023 SmartRG Inc.
 * Author: Chad Monroe <chad.monroe@smartrg.com>
 */

#include "mt7988a-smartrg-SDG-8733.dtsi"

/ {
	model = "SmartRG SDG-8733";
	compatible = "smartrg,sdg-8733", "mediatek,mt7988a";
};
