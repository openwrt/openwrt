// SPDX-License-Identifier: GPL-2.0-or-later OR MIT

/dts-v1/;

#include "mt7981b-zbtlink-zbt-z8106ax.dtsi"

/ {
	model = "Zbtlink ZBT-Z8106AX-S";
	compatible = "zbtlink,zbt-z8106ax-s", "mediatek,mt7981b";
};

&port_4 {
	/* The 4th port must be defined but isn't usable in model S, so we set it to disabled. */
	status = "disabled";
};

