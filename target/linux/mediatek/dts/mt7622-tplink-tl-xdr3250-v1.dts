// SPDX-License-Identifier: GPL-2.0-or-later OR MIT

/dts-v1/;
#include "mt7622-tplink-tl-xdr-common.dtsi"

/ {
	model = "TP-Link TL-XDR3250 v1";
	compatible = "tplink,tl-xdr3250-v1", "mediatek,mt7622";
};
