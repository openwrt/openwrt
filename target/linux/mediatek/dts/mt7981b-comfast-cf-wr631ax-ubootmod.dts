// SPDX-License-Identifier: GPL-2.0-or-later OR MIT

#include "mt7981b-comfast-cf-wr631ax.dts"
#include "mt7981b-comfast-common-ubootmod.dtsi"

/ {
	model = "COMFAST CF-WR631AX (OpenWrt U-Boot layout)";
	compatible = "comfast,cf-wr631ax-ubootmod", "mediatek,mt7981";
};
