// SPDX-License-Identifier: GPL-2.0-or-later OR MIT

/dts-v1/;

#include "mt7981b-zbtlink-zbt-z8103ax.dtsi"

/ {
	model = "Zbtlink 3000M(WiFi6) ZBT-Z8103AX-C";
	compatible = "zbtlink,zbt-z8103ax-c", "mediatek,mt7981b";
};
