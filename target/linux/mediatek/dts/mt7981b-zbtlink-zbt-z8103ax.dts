// SPDX-License-Identifier: GPL-2.0-or-later OR MIT

/dts-v1/;

#include "mt7981b-zbtlink-zbt-z8103ax.dtsi"

/ {
	model = "Zbtlink ZBT-Z8103AX";
	compatible = "zbtlink,zbt-z8103ax", "mediatek,mt7981b";
};

&ubi {
	/* reduce ubi partition size from .dtsi to fit into 64M Nand */ 
	reg = <0x580000 0x4000000>;
};
