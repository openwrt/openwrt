// SPDX-License-Identifier: GPL-2.0-or-later OR MIT
/dts-v1/;

#include "mt7622-elecom-wrc-x3200gst3.dtsi"

/ {
	model = "ELECOM WRC-X3200GST3";
	compatible = "elecom,wrc-x3200gst3", "mediatek,mt7622";
};
