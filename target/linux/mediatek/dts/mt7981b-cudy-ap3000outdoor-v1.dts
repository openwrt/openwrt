// SPDX-License-Identifier: (GPL-2.0 OR MIT)

/dts-v1/;

#include "mt7981b-cudy-ap3000outdoor-v1.dtsi"

/ {
	model = "Cudy AP3000 Outdoor v1";
	compatible = "cudy,ap3000outdoor-v1", "mediatek,mt7981";
};
