// SPDX-License-Identifier: (GPL-2.0 OR MIT)
/*
 * Copyright (C) 2023 SmartRG Inc.
 * Author: Chad Monroe <chad.monroe@smartrg.com>
 */

#include "mt7988a-smartrg-SDG-8734.dtsi"

/ {
	model = "SmartRG SDG-8734";
	compatible = "smartrg,sdg-8734", "mediatek,mt7988a";
};
