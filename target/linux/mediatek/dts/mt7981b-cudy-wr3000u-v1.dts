// SPDX-License-Identifier: (GPL-2.0 OR MIT)

/dts-v1/;
#include "mt7981b-cudy-wbr3000uax-v1.dtsi"

/ {
	model = "Cudy WR3000U v1";
	compatible = "cudy,wr3000u-v1", "mediatek,mt7981";
};

&spi_nand {
	mediatek,nmbm;
	mediatek,bmt-max-ratio = <1>;
	mediatek,bmt-max-reserved-blocks = <64>;
};

&ubi {
	reg = <0x5c0000 0xe600000>;
};
