// SPDX-License-Identifier: (GPL-2.0 OR MIT)

/dts-v1/;
#include "mt7981b-cudy-p2.dtsi"

/ {
	model = "Cudy P2 v1";
	compatible = "cudy,p2-v1", "mediatek,mt7981";
};

&voip_volte {
	gpio-export,output = <1>;
};

&gpio5gpwr {
	gpio-export,output = <0>;
};
