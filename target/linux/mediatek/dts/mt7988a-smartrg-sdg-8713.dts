// SPDX-License-Identifier: (GPL-2.0 OR MIT)
/*
 * Copyright (C) 2025 SmartRG Inc.
 * Author: Chad Monroe <chad.monroe@smartrg.com>
 */

#include "mt7988a-smartrg-sdg-8713.dtsi"

/ {
	model = "SmartRG SDG-8713";
	compatible = "smartrg,sdg-8713", "mediatek,mt7988a";
};
