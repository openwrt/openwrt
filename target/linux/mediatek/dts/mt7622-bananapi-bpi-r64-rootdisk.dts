// SPDX-License-Identifier: (GPL-2.0-only OR MIT)
/*
 * Copyright (c) 2018 MediaTek Inc.
 * Author: Ryder Lee <ryder.lee@mediatek.com>
 */

/dts-v1/;

#include "mt7622-bananapi-bpi-r64.dts"
/ {
	model = "Bananapi BPI-R64";
	compatible = "bananapi,bpi-r64-rootdisk", "mediatek,mt7622";

	chosen {
		stdout-path = "serial0:115200n8";
		bootargs = "earlycon=uart8250,mmio32,0x11002000 console=ttyS0,115200n1 swiotlb=512 root=/dev/mmcblk0p7 rootfstype=squashfs,f2fs";
	};
};
