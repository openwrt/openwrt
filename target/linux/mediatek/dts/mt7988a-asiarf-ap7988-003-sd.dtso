// SPDX-License-Identifier: (GPL-2.0 OR MIT)
/*
 * Copyright (C) 2025 AsiaRF Co., Ltd.
 * Author: Elwin Huang <elwin@asiarf.com>
 */

/dts-v1/;
/plugin/;
#include <dt-bindings/gpio/gpio.h>

/ {
	compatible = "asiarf,ap7988-003", "mediatek,mt7988a";

	fragment@1 {
		target = <&mmc0>;
		__overlay__ {
			pinctrl-names = "default", "state_uhs";
			pinctrl-0 = <&mmc0_pins_sdcard>;
			pinctrl-1 = <&mmc0_pins_sdcard>;
			cd-gpios = <&pio 4 GPIO_ACTIVE_LOW>;
			bus-width = <4>;
			max-frequency = <50000000>;
			cap-sd-highspeed;
			vmmc-supply = <&reg_3p3v>;
			vqmmc-supply = <&reg_3p3v>;
			status = "okay";
		};
	};
};
