// SPDX-License-Identifier: GPL-2.0-or-later OR MIT

/dts-v1/;

#include "mt7981b-zbtlink-zbt-z8106ax.dtsi"

/ {
	model = "Zbtlink ZBT-Z8106AX-T";
	compatible = "zbtlink,zbt-z8106ax-t", "mediatek,mt7981b";
};
