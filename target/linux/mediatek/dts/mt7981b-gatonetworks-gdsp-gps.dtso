// SPDX-License-Identifier: GPL-2.0-or-later OR MIT

/dts-v1/;
/plugin/;

/ {
	compatible = "gatonetworks,gdsp", "mediatek,mt7981";

	fragment@0 {
		target = <&uart1>;
		__overlay__ {
			status = "okay";
		};
	};
};
