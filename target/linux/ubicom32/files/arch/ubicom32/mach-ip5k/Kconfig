## toolchain/gdb/Config.in
```kconfig
comment "Gdb Options"

config PACKAGE_GDB_CLIENT
	bool "Build gdb client for the Host"
	default n
	help
	    Build gdb to run on the host to debug programs running on the target.
```

## toolchain/glibc/Config.in
```kconfig
# malloc tuning

config GLIBC_TUNE_MALLOC_ARENA
	bool "glibc: tune default malloc arena behavior" if TOOLCHAINOPTS
	default y
	depends on USE_GLIBC && !EXTERNAL_TOOLCHAIN
	help
	  By default, glibc will allocate a number of "arenas" for dynamic memory allocation.
	  Notes from official documentation:

	    For 32-bit systems the limit (note: maximum number of arenas) is twice the number of cores online
	    and on 64-bit systems, it is eight times the number of cores online.

	  Thus:
	  1) it takes time to reserve memory (with O(n) complexity);
	  2) it takes somewhat excessive native memory.

	  OpenWrt changes this behavior by:
	  1) limiting per-core multiplier;
	  2) limiting number of online cores to be accounted.

	  If this option is disabled then default glibc behavior is in effect.

if GLIBC_TUNE_MALLOC_ARENA

config GLIBC_MALLOC_ARENA_PERCORE_MULT
	int "glibc: malloc: per-core arena multiplier"
	range 1 16
	default 2
	help
	  Set per-core arena multiplier for maximum number of arenas.

	  Note: glibc default value depends on target system:
	    32-bit systems: 2
	    64-bit systems: 8

	  Default: 2.

config GLIBC_MALLOC_ARENA_CORE_LIMIT
	int "glibc: malloc: online core limit"
	range 1 16
	default 4
	help
	  Limit number of online cores to be accounted for maximum number of arenas.

	  Note: glibc doesn't have this setting.

	  Default: 4.

# GLIBC_TUNE_MALLOC_ARENA
endif
```

## toolchain/musl/Config.in
```kconfig
# Debug version.

config MUSL_ENABLE_DEBUG
	bool "Build with debug information"
	depends on TOOLCHAINOPTS && USE_MUSL
	default n
```

## toolchain/uClibc/Config.in
```kconfig
# Debug version.

config UCLIBC_ENABLE_DEBUG
	bool "Build with debug information"
	depends on TOOLCHAINOPTS && USE_UCLIBC
	default n
```

## tools/Config.in
```kconfig
config TOOLS_BUILD_7z
	bool
	default y if TARGET_realtek

config TOOLS_BUILD_b43-tools
	bool
	default y if SDK || PACKAGE_kmod-b43 || BRCMSMAC_USE_FW_FROM_WL
	help
	  Build tools for kmod-b43 and broadcom firmware

config TOOLS_BUILD_bzip2
	bool
	default y if SDK || TARGET_INITRAMFS_COMPRESSION_BZIP2

config TOOLS_BUILD_cbootimage
	bool
	default y if TARGET_tegra

config TOOLS_BUILD_dwarves
	bool
	default y if DWARVES

config TOOLS_BUILD_elftosb-sdimage
	bool
	default y if TARGET_mxs

config TOOLS_BUILD_genext2fs
	bool
	default y if TARGET_apm821xx || TARGET_gemini

config TOOLS_BUILD_gmp
	bool
	default y if !EXTERNAL_TOOLCHAIN

config TOOLS_BUILD_isl
	bool
	default y if !EXTERNAL_TOOLCHAIN && GCC_USE_GRAPHITE

config TOOLS_BUILD_kernel2minor
	bool
	default y if USES_MINOR

config TOOLS_BUILD_liblzo
	bool

config TOOLS_BUILD_llvm-bpf
	bool
	default y if USE_LLVM_BUILD

config TOOLS_BUILD_lz4
	bool
	default y if SDK || TARGET_INITRAMFS_COMPRESSION_LZ4

config TOOLS_BUILD_lzop
	bool
	default y if SDK || TARGET_INITRAMFS_COMPRESSION_LZO

config TOOLS_BUILD_mold
	bool
	default y if USE_MOLD

config TOOLS_BUILD_mpc
	bool
	default y if !EXTERNAL_TOOLCHAIN

config TOOLS_BUILD_mpfr
	bool
	default y if !EXTERNAL_TOOLCHAIN

config TOOLS_BUILD_sparse
	bool
	default y if USE_SPARSE

config TOOLS_BUILD_squashfs3-lzma
	bool
	default y if TARGET_ath79
```

## xnd/openflow/openvswitch/Config.in
```kconfig
menu "Configuration"
	depends on PACKAGE_openvswitch

	config	OPENVSWITCH_WITH_LIBUNBOUND
		bool
		default y
		prompt "Build with libunbound library."
endmenu
```

## xnd/wifi-ax/batman-adv/Config.in
```kconfig
# SPDX-License-Identifier: GPL-2.0
# Copyright (C) 2007-2019  B.A.T.M.A.N. contributors:
#
# Marek Lindner, Simon Wunderlich

#
# B.A.T.M.A.N meshing protocol
#

config BATMAN_ADV_BATMAN_V
	bool "B.A.T.M.A.N. V protocol"
	depends on PACKAGE_kmod-batman-adv
	default y
	help
	  This option enables the B.A.T.M.A.N. V protocol, the successor
	  of the currently used B.A.T.M.A.N. IV protocol. The main
	  changes include splitting of the OGM protocol into a neighbor
	  discovery protocol (Echo Location Protocol, ELP) and a new OGM
	  Protocol OGMv2 for flooding protocol information through the
	  network, as well as a throughput based metric.
	  B.A.T.M.A.N. V is currently considered experimental and not
	  compatible to B.A.T.M.A.N. IV networks.

config BATMAN_ADV_BLA
	bool "Bridge Loop Avoidance"
	depends on PACKAGE_kmod-batman-adv
	select PACKAGE_kmod-lib-crc16
	default y
	help
	  This option enables BLA (Bridge Loop Avoidance), a mechanism
	  to avoid Ethernet frames looping when mesh nodes are connected
	  to both the same LAN and the same mesh. If you will never use
	  more than one mesh node in the same LAN, you can safely remove
	  this feature and save some space.

config BATMAN_ADV_DAT
	bool "Distributed ARP Table"
	depends on PACKAGE_kmod-batman-adv
	default y
	help
	  This option enables DAT (Distributed ARP Table), a DHT based
	  mechanism that increases ARP reliability on sparse wireless
	  mesh networks. If you think that your network does not need
	  this option you can safely remove it and save some space.

config BATMAN_ADV_NC
	bool "Network Coding"
	depends on PACKAGE_kmod-batman-adv
	help
	  This option enables network coding, a mechanism that aims to
	  increase the overall network throughput by fusing multiple
	  packets in one transmission.
	  Note that interfaces controlled by batman-adv must be manually
	  configured to have promiscuous mode enabled in order to make
	  network coding work.
	  If you think that your network does not need this feature you
	  can safely disable it and save some space.

config BATMAN_ADV_MCAST
	bool "Multicast optimisation"
	depends on PACKAGE_kmod-batman-adv
	default y
	help
	  This option enables the multicast optimisation which aims to
	  reduce the air overhead while improving the reliability of
	  multicast messages.

config BATMAN_ADV_DEBUG
	bool "B.A.T.M.A.N. debugging"
	depends on PACKAGE_kmod-batman-adv
	help
	  This is an option for use by developers; most people should
	  say N here. This enables compilation of support for
	  outputting debugging information to the debugfs log or tracing
	  buffer. The output is controlled via the batadv netdev specific
	  log_level setting.

config BATMAN_ADV_TRACING
	bool "B.A.T.M.A.N. tracing support"
	depends on PACKAGE_kmod-batman-adv
	select KERNEL_FTRACE
	select KERNEL_ENABLE_DEFAULT_TRACERS
	help
	  This is an option for use by developers; most people should
	  say N here. Select this option to gather traces like the debug
	  messages using the generic tracing infrastructure of the kernel.
	  BATMAN_ADV_DEBUG must also be selected to get trace events for
	  batadv_dbg.
```
