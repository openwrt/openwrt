## target/linux/ubicom32/files/arch/ubicom32/mach-ip5k/Kconfig
```kconfig
config IP5170DPF
	bool "IP5170DPF"
	select UBICOM32_V3
	select I2C
	select I2C_GPIO
	select FB
	select FB_UBICOM32
	select BACKLIGHT_LCD_SUPPORT
	select BACKLIGHT_CLASS_DEVICE
	select UBICOM_HID
	select NEW_LEDS
	select LEDS_CLASS
	select LEDS_GPIO
	help
		IP5170 Digital Picture Frame board, 8005-1113, IP5K-BEV-0011-13 v1.3

config IP5160DEV
	bool "IP5160Dev_Ver1Dot1"
	select UBICOM32_V3
	help
		Ubicom StreamEngine 5000 Development Board, IP5K-BDV-0004-11 v1.1

config IP5160EVAL
	bool "IP5160RGWEval_Ver2Rev2"
	select UBICOM32_V3
	help
		Ubicom StreamEngine 5000 RGW Evaluation Board, IP5K-RGW-0004-11 v2.2
```

## target/linux/ubicom32/files/arch/ubicom32/mach-ip7k/Kconfig
```kconfig
config IP7145DPF
	bool "IP7145DPF"
	select UBICOM32_V4
	select UBICOM_INPUT
	select UBICOM_INPUT_I2C
	select RTC_CLASS
	select RTC_DRV_S35390A
	select I2C
	select I2C_GPIO
	select GPIO_PCA953X
	select FB
	select FB_UBICOM32
	select LCD_CLASS_DEVICE
	select LCD_UBICOM32POWER
	select BACKLIGHT_LCD_SUPPORT
	select BACKLIGHT_CLASS_DEVICE
	select BACKLIGHT_UBICOM32
	select SND_UBI32
	select MMC_UBICOM32
	select MMC
	select MMC_BLOCK
	help
		IP7145 Digital Picture Frame reference design, supports:
			8007-0410 v1.0

config IP7160RGW
	bool "IP7160RGW"
	select UBICOM32_V4
	select UBICOM_INPUT
	select NEW_LEDS
	select LEDS_CLASS
	select LEDS_GPIO
	select SPI
	select SPI_UBICOM32_GPIO
	select VLAN_8021Q
	select UBICOM_SWITCH
	select UBICOM_SWITCH_BCM539X
	help
		Ubicom IP7160 RGW Eval, supports:
			8007-0110 v1.0
			8007-0111 v1.1
			8007-0112 v1.2

config IP7160RGWLCD
	bool "IP7160RGWLCD"
	select UBICOM32_V4
	select UBICOM_INPUT
	select NEW_LEDS
	select LEDS_CLASS
	select LEDS_GPIO
	select SPI
	select SPI_UBICOM32_GPIO
	select VLAN_8021Q
	select UBICOM_SWITCH
	select UBICOM_SWITCH_BCM539X
	select INPUT_TOUCHSCREEN
	select TOUCHSCREEN_TSC2007
	select FB
	select FB_UBICOM32_VIRTUAL
	select I2C
	select I2C_GPIO
	help
		Ubicom IP7160 RGW Eval, supports:
			8007-0112 v1.2 + 8007-1410 v1.0

		With Ubicom LCD Adapter
			8007-0920 v2.0
			8007-0921 v2.1


config IP7160BRINGUP
	bool "IP7160BRINGUP"
	select UBICOM32_V4
	select NEW_LEDS
	select LEDS_CLASS
	select LEDS_GPIO
	help
		Ubicom IP7160 Bringup, supports:
			8007-0010 v1.0

config IP7160DPF
	bool "IP7160DPF"
	select UBICOM32_V4
	select I2C
	select I2C_GPIO
	select FB
	select FB_UBICOM32
	select BACKLIGHT_LCD_SUPPORT
	select BACKLIGHT_CLASS_DEVICE
	select SND_UBI32
	select SND_UBI32_AUDIO_CS4350
	select UBICOM_HID
	help
		IP7160 Digital Picture Frame board, supports:
			8007-0211 Rev 1.1

config IP7500MODULE
	bool "IP7500MODULE"
	select UBICOM32_V4
	help
		Ubicom IP7500 CPU Module board, supports:
			8007-0510  v1.0
			8007-0510A v1.0

		Please see ip7500module.c for more details.

config IP7500AV
	bool "IP7500AV"
	select UBICOM32_V4
	select I2C
	select I2C_GPIO
	select SND_UBI32
	select SND_UBI32_AUDIO_CS4384
	select FB
	select FB_UBICOM32
	help
		Ubicom IP7500 Audio Video board, supports:
			8007-0810  v1.0

		With Ubicom IP7500 CPU Module board:
			8007-0510  v1.0 -or-
			8007-0510A v1.0

		Please see ip7500av.c for more details.

config IP7500MEDIA
	bool "IP7500MEDIA"
	select UBICOM32_V4
	select UBICOM_INPUT_I2C
	select RTC_CLASS
	select RTC_DRV_S35390A
	select I2C
	select I2C_GPIO
	select GPIO_PCA953X
	select FB
	select FB_UBICOM32
	select FB_UBICOM32_VIRTUAL
	select FB_UBICOM32_VIRTUAL_NOAUTO
	select LCD_CLASS_DEVICE
	select LCD_UBICOM32POWER
	select BACKLIGHT_LCD_SUPPORT
	select BACKLIGHT_CLASS_DEVICE
	select BACKLIGHT_UBICOM32
	select INPUT_TOUCHSCREEN
	select TOUCHSCREEN_TSC2007
	select SOUND
	select SND
	select SND_UBI32
	select SND_UBI32_AUDIO_CS4350
	select MMC_UBICOM32
	select MMC
	select MMC_BLOCK
	help
		IP7500 Media Board w/ IP7500 CPU Module board, supports:
			8007-0610 v1.0 w/ 8007-0510 v1.0
			8007-0610 v1.0 w/ 8007-0510 v1.0 NOPHY
			8007-0610 v1.0 w/ 8007-0511 v1.1 NOPHY

		Also supports optional LCD Adapter board:
			8006-0920 v2.0
			8006-0921 v2.1

		Please see ip7500media.c for more details.

config IP7500WSPKR
	bool "IP7500WSPKR"
	select UBICOM32_V4
	select I2C
	select I2C_GPIO
	select SOUND
	select SND
	select SND_UBI32
	select SND_UBI32_AUDIO_CS4350
	help
		IP7500 Wireless Speaker Board, supports:
			8007-1210 v1.0

		Please see ip7500wspkr.c for more details.

config IP7500IAP
	bool "IP7500IAP"
	select UBICOM32_V4
	select I2C
	select I2C_GPIO
	select FB
	select FB_UBICOM32_VIRTUAL
	select SOUND
	select SND
	select SND_UBI32
	select SND_UBI32_AUDIO_CS4350
	select RTC_CLASS
	select RTC_DRV_S35390A
	select INPUT_TOUCHSCREEN
	select TOUCHSCREEN_TSC2007
	select BACKLIGHT_LCD_SUPPORT
	select BACKLIGHT_CLASS_DEVICE
	select BACKLIGHT_UBICOM32
	help
		IP7500 Internet Audio Player, supports:
			8007-1110 v1.0

		Please see ip7500iap.c for more details.


		Please see ip7500media.c for more details.
```

## target/linux/ubicom32/files/sound/ubicom32/Kconfig
```kconfig
# ALSA Ubicom32 drivers

menuconfig SND_UBI32
	tristate "Ubicom32 sound devices"
	select SND_PCM
	default n
	help
	  Say Y here to include support for audio on the Ubicom32 platform.
	  To compile this driver as a module, say M here: the module will be
	  called snd_ubi32.

if SND_UBI32

config SND_UBI32_AUDIO_GENERIC_CAPTURE
	bool "Generic Capture Support"
	default n
	help
	  Use this option to support ADCs which don't require special drivers.

config SND_UBI32_AUDIO_GENERIC
	bool "Generic Playback Support"
	default n
	help
	  Use this option to support DACs which don't require special drivers.

comment "I2C Based Codecs"

config SND_UBI32_AUDIO_CS4350
	bool "Cirrus Logic CS4350 DAC"
	depends on I2C
	default n
	help
	  Support for the Cirrus Logic CS4350 DAC.

config SND_UBI32_AUDIO_CS4384
	bool "Cirrus Logic CS4384 DAC"
	depends on I2C
	default n
	help
	  Support for the Cirrus Logic CS4384 DAC.

endif #SND_UBI32
```

## target/linux/x86-2.6/image/Config.in
```kconfig
config X86_GRUB_IMAGES
    bool "Build GRUB images (Linux x86 or x86_64 host only)"
    depends LINUX_2_6_X86
    depends TARGET_ROOTFS_EXT2FS || TARGET_ROOTFS_JFFS2
    default y

config X86_GRUB_BAUDRATE
    int "Serial port baud rate"
    depends X86_GRUB_IMAGES
    default 38400

config X86_GRUB_KERNELPART
    int "Kernel partition size (in MB)"
    depends X86_GRUB_IMAGES
    default 4

config X86_GRUB_ROOTPART
    string
    prompt "Root partition on target device" if X86_GRUB_IMAGES
    default "/dev/hda2"
    help
        The root partition on the final device.  If you don't know,
        you probably want the default (/dev/hda2).

config X86_GRUB_BOOTOPTS
    string
    prompt "Extra kernel boot options" if X86_GRUB_IMAGES
    default ""
    help
        If you don't know, just leave it blank.
```

## target/linux/x86/image/Config.in
```kconfig
config X86_ETHERBOOT_IMAGES
	bool "Build Etherboot image"
	depends on TARGET_x86_thincan_DBE61
	default y
	help
	  Builds network bootable image for ThinCan DBE61 (Etherboot BIOS)

config X86_ETHERBOOT_BOOTOPTS
	string "Extra kernel boot options"
	depends on X86_ETHERBOOT_IMAGES
	default "ip=dhcp nbdport=2000 " if TARGET_ROOTFS_SQUASHFS
	default "ip=dhcp root=/dev/nfs nfsroot=192.168.0.1:/srv/dbe61"
	help
	  Kernel arguments to pass to the kernel eg. NFS root location etc.
```

## target/linux/xburst/files-2.6.32/arch/mips/jz4740/Kconfig
```kconfig
choice
    prompt "Machine type"
    depends on MACH_JZ
    default JZ4740_QI_LB60

config JZ4740_QI_LB60
	bool "Qi Hardware Ben NanoNote"
	select DMA_NONCOHERENT
	select SOC_JZ4740

config JZ4740_N516
	bool "Hanvon n516 eBook reader"
	select DMA_NONCOHERENT
	select SOC_JZ4740

config JZ4740_N526
	bool "Hanvon n526 eBook reader"
	select DMA_NONCOHERENT
	select SOC_JZ4740


endchoice

config SOC_JZ4740
	bool
	select JZSOC
	select GENERIC_GPIO
	select ARCH_REQUIRE_GPIOLIB
	select SYS_HAS_EARLY_PRINTK
	select SYS_SUPPORTS_LITTLE_ENDIAN
	select IRQ_CPU

config JZSOC
	bool
	select JZRISC
	select SYS_HAS_CPU_MIPS32_R1
	select SYS_SUPPORTS_32BIT_KERNEL

config JZRISC
	bool
```

## target/linux/xburst/files-2.6.32/sound/soc/jz4740/Kconfig
```kconfig
config SND_JZ4740_SOC
	tristate "SoC Audio for Ingenic JZ4740 SoC"
	depends on SOC_JZ4740 && SND_SOC
	help
	  Say Y or M if you want to add support for codecs attached to
	  the Jz4740 AC97, I2S or SSP interface. You will also need
	  to select the audio interfaces to support below.

config SND_JZ4740_SOC_QI_LB60
	tristate "SoC Audio support for Qi Hardware Ben Nanonote"
	depends on SND_JZ4740_SOC && JZ4740_QI_LB60
	select SND_JZ4740_SOC_I2S
    select SND_SOC_JZCODEC
	help
	  Say Y if you want to add support for SoC audio of internal codec on Ingenic Jz4740 QI_LB60 board.

config SND_JZ4740_SOC_N526
	tristate "SoC Audio support for Hanvon N526 eBook reader"
	depends on SND_JZ4740_SOC && JZ4740_N526
	select SND_JZ4740_SOC_I2S
    select SND_SOC_JZCODEC
	help
	  Say Y if you want to enable support for SoC audio on the Hanvon N526.

config SND_JZ4740_SOC_I2S
	depends on SND_JZ4740_SOC
	tristate "SoC Audio (I2S protocol) for Ingenic jz4740 chip"
	help
	  Say Y if you want to use I2S protocol and I2S codec on Ingenic Jz4740 QI_LB60 board.
```

## target/sdk/Config.in
```kconfig
config SDK
	bool "Build the OpenWrt SDK"
	help
	  This is essentially a stripped-down version of the buildroot
	  with a precompiled toolchain. It can be used to develop and
	  test packages for OpenWrt before including them in the buildroot
```

## target/sdk/files/Config.in
```kconfig
mainmenu "OpenWrt Configuration"

menu "Global build settings"

	config ALL_NONSHARED
		bool "Select all target specific packages by default"
		default ALL

	config ALL_KMODS
		bool "Select all kernel module packages by default"
		default ALL

	config ALL
		bool "Select all userspace packages by default"
		default y

	config SIGNED_PACKAGES
		bool "Cryptographically sign package lists"
		default y

	comment "General build options"

	config BUILD_PATENTED
		default n
		bool "Compile with support for patented functionality"
		help
		  When this option is disabled, software which provides patented functionality
		  will not be built.  In case software provides optional support for patented
		  functionality, this optional support will get disabled for this package.

	config BUILD_NLS
		default n
		bool "Compile with full language support"
		help
		  When this option is enabled, packages are built with the full versions of
		  iconv and GNU gettext instead of the default OpenWrt stubs.

	comment "Package build options"

	config DEBUG
		bool
		prompt "Compile packages with debugging info"
		help
		  Adds -g3 to the CFLAGS.

	comment "Stripping options"

	choice
		prompt "Binary stripping method"
		default USE_STRIP   if USE_GLIBC
		default USE_SSTRIP
		help
		  Select the binary stripping method you wish to use.

		config NO_STRIP
			bool "none"
			help
			  This will install unstripped binaries (useful for native
			  compiling/debugging).

		config USE_STRIP
			bool "strip"
			help
			  This will install binaries stripped using strip from binutils.

		config USE_SSTRIP
			bool "sstrip"
			depends on !USE_GLIBC
			help
			  This will install binaries stripped using sstrip.
	endchoice

	config STRIP_ARGS
		string
		prompt "Strip arguments"
		depends on USE_STRIP
		default "--strip-unneeded --remove-section=.comment --remove-section=.note" if DEBUG
		default "--strip-all"
		help
		  Specifies arguments passed to the strip command when stripping binaries.

endmenu

menu "Advanced configuration options (for developers)"

	config BROKEN
		bool "Show broken packages"

	config DOWNLOAD_FOLDER
		string "Download folder"
		default ""
		help
		  Store downloaded source bundles in this directory.
		  If not set then defaults to './dl', which is removed by operations such as
		  'git clean -xdf' or 'make distclean'.
		  This option is useful if you have a low bandwidth Internet connection, and by
		  setting a path outside the OpenWrt tree downloads will be saved.

	config LOCALMIRROR
		string "Local mirror for source packages"
		default ""

	config AUTOREBUILD
		bool "Automatic rebuild of packages"
		default y
		help
		  Automatically rebuild packages when their files change.

	config AUTOREMOVE
		bool "Automatic removal of build directories"
		default y
		help
		  Automatically delete build directories after make target completed.
		  This allows you to symlink build_dir into a scratch location, e.g. a ramdisk,
		  which does not have enough space to keep a complete build_dir.

	config CCACHE
		bool "Use ccache"
		help
		  Compiler cache; see https://ccache.samba.org/

	config CCACHE_DIR
		string "Set ccache directory" if CCACHE
		default ""
		help
		  Store ccache in this directory.
		  If not set, uses './.ccache'

	config BUILD_LOG
		bool "Enable log files during build process"
		help
		  If enabled, log files will be written to the ./log directory.

	config SRC_TREE_OVERRIDE
		bool "Enable package source tree override"
		help
		  If enabled, you can force a package to use a git tree as source
		  code instead of the normal tarball. Create a symlink 'git-src'
		  in the package directory, pointing to the .git tree that you want
		  to pull the source code from.

endmenu

config IN_SDK
	default y
	bool

config MODULES
	bool
	default y
	modules

source "Config-build.in"
source "tmp/.config-package.in"
```

## target/squashfs/Config.in
```kconfig
config BR2_TARGET_ROOTFS_SQUASHFS
	bool "squashfs"
	default n
	help
	  Build a squashfs root filesystem
```

## target/toolchain/Config.in
```kconfig
config MAKE_TOOLCHAIN
	bool "Package the CShoreWrt-based Toolchain"
	depends on !EXTERNAL_TOOLCHAIN
	help
	  Package the created toolchain as a tarball under the bin/ directory as
	  CShoreWrt-Toolchain-$(BOARD)-for-$(ARCH)$(ARCH_SUFFIX)-gcc-$(GCCV)$(DIR_SUFFIX).
	  For example, a toolchain for the MIPS architecture might be named
	  CShoreWrt-Toolchain-malta-for-mipsel_mips32-gcc-4.8-linaro_uClibc-0.9.33.2.tar.bz2.
```

## target/tools/Config.in
```kconfig
config MAKE_TOOLS
	bool "Package the OpenWrt-based build tools"
	imply BUILD_ALL_HOST_TOOLS
	imply AUTOREMOVE
	default BUILDBOT
	help
	  Package the local build tools as a tarball under the bin/ directory as
	  openwrt-tools.$(HOST_OS)-$(HOST_ARCH).tar.xz
	  This can be copied into another buildroot and unpacked
	  to overwrite current tools with the ones in this prebuilt set
	  or to skip the need to build the tools altogether.
	  The buildroot that this is used with must have
	  CONFIG_AUTOREMOVE enabled.
	  Unpack directly in the top level directory (openwrt folder)
	  $ xzcat openwrt-tools.Linux-x86_64.tar.xz | tar -xf - -C openwrt
```
