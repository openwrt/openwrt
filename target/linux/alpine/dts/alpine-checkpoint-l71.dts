// SPDX-License-Identifier: GPL-2.0-or-later OR MIT

/dts-v1/;

#include "alpine-checkpoint-l71-common.dtsi"

/ {
	model = "Check Point L-71";
	compatible = "checkpoint,l-71", "annapurna-labs,alpine";
};
