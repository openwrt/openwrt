## target/linux/alpine/files-6.18/drivers/crypto/al/Kconfig
```kconfig
config CRYPTO_DEV_AL_CRYPTO
	tristate "Support for Annapurna Labs Crypto engine"
	depends on ARCH_ALPINE
	select CRYPTO_AES
	select CRYPTO_DES
	select CRYPTO_MD5
	select CRYPTO_SHA1
	select CRYPTO_SHA256
	select CRYPTO_SHA512
	select CRYPTO_ALGAPI
	select CRYPTO_AUTHENC
	select CRYPTO_BLKCIPHER
	select CRYPTO_CRC32C
	select SG_SPLIT
	help
	  Enable support for the Annapurna Labs Crypto acceleration engine.
	  Currently AES and SHA256 are supported.

config CRYPTO_DEV_AL_CRYPTO_STATS
	bool "Annapurna Labs Crypto statistics enabled"
	depends on CRYPTO_DEV_AL_CRYPTO
	help
	  Enable Annapurna Labs Crypto acceleration engine statistics.

config CRYPTO_DEV_AL_AHASH_CRC
	def_bool CRYPTO_DEV_AL_CRYPTO
```

## target/linux/alpine/files-6.18/drivers/dma/al/Kconfig
```kconfig
config AL_DMA
	tristate "Annapurna Labs DMA support"
	depends on ARCH_ALPINE
	select DMA_ENGINE
	select ASYNC_TX_ENABLE_CHANNEL_SWITCH
	help
	  Enable support for the Annapurna Labs DMA and RAID acceleration
	  engine.

config AL_DMA_STATS
	bool "Annapurna Labs DMA statistics enabled"
	depends on AL_DMA
	help
	  Enable Annapurna Labs DMA and RAID acceleration engine statistics.

config AL_DMA_PCI_IOV
	bool "Annapurna Labs DMA Virtual Function enabled"
	depends on AL_DMA
	help
	  Enable Annapurna Labs DMA Virtual Function.
```

## target/linux/alpine/files-6.18/drivers/edac/al/Kconfig
```kconfig
config EDAC_AL_MC
	tristate "Annapurna Labs Memory Controller"
	depends on ARCH_ALPINE
	help
	  Support for error detection and correction for Annapurna
	  Labs Alpine chipset
```

## target/linux/amazon/files/arch/mips/amazon/Kconfig
```kconfig
# copyright 2007 john crispin <blogic@openwrt.org>

menu "Amazon built-in"

config AMAZON_ASC_UART
	bool "Amazon asc uart"
	select SERIAL_CORE
	select SERIAL_CORE_CONSOLE
	default y

config AMAZON_PCI
	bool "Amazon PCI support"
	default y
	select HW_HAS_PCI
	select PCI

config AMAZON_NET_SW
	bool "Amazon network"
	default y

config AMAZON_WDT
	bool "Amazon watchdog timer"
	default y

config AMAZON_MTD
	bool "Amazon MTD map"
	default y

config ADM6996_SUPPORT
	bool "Amazon ADM6996 Switch driver"
	default y

choice 
	prompt "Flash Size"
	depends on AMAZON_MTD

config MTD_AMAZON_FLASH_SIZE_2
	bool "2MB"

config MTD_AMAZON_FLASH_SIZE_4
	bool "4MB"

config MTD_AMAZON_FLASH_SIZE_8
	bool "8MB"

config MTD_AMAZON_FLASH_SIZE_16
	bool "16MB"

endchoice

choice 
	prompt "Bus Width"
	depends on AMAZON_MTD

config MTD_AMAZON_BUS_WIDTH_8
	bool "8-bit"

config MTD_AMAZON_BUS_WIDTH_16
	bool "16-bit"

config MTD_AMAZON_BUS_WIDTH_32
	bool "32-bit"

endchoice


endmenu
```

## target/linux/ar7-2.4/Config.in
```kconfig
config BR2_PACKAGE_KMOD_CPMAC
	prompt "kmod-cpmac........................ AR7 CPMAC Network Driver"
	tristate
	default y
	depends BR2_LINUX_2_4_AR7
	help
	  Driver for the AR7 CPMAC network chip

config BR2_PACKAGE_KMOD_SANGAM_ATM_A
	prompt "kmod-sangam-atm-annex-a........... AR7 Sangam ADSL Driver (Annex A)"
	tristate
	default m
	depends BR2_LINUX_2_4_AR7
	select BR2_PACKAGE_KMOD_ATM
	help
	  ATM driver for the Sangam ADSL chip on AR7
	  Annex A version

config BR2_PACKAGE_KMOD_SANGAM_ATM_B
	prompt "kmod-sangam-atm-annex-b........... AR7 Sangam ADSL Driver (Annex B)"
	tristate
	default y
	depends BR2_LINUX_2_4_AR7
	select BR2_PACKAGE_KMOD_ATM
	help
	  ATM driver for the Sangam ADSL chip on AR7
	  Annex B version
```

## target/linux/ar7/files-2.6.30/drivers/vlynq/Kconfig
```kconfig
menu "TI VLYNQ"

config VLYNQ
	bool "TI VLYNQ bus support"
	depends on AR7 && EXPERIMENTAL
	help
	  Support for the TI VLYNQ bus

	  The module will be called vlynq

	  If unsure, say N

endmenu
```

## target/linux/ar71xx/files/arch/mips/ar71xx/Kconfig
```kconfig
if ATHEROS_AR71XX

menu "Atheros AR71xx machine selection"
config AR71XX_MACH_ALL0258N
	bool "Allnet ALL0258N support"
	select SOC_AR724X
	select AR71XX_DEV_M25P80
	select AR71XX_DEV_AP91_PCI if PCI
	select AR71XX_DEV_GPIO_BUTTONS
	select AR71XX_DEV_LEDS_GPIO

config AR71XX_MACH_AP81
	bool "Atheros AP81 board support"
	select SOC_AR913X
	select AR71XX_DEV_M25P80
	select AR71XX_DEV_AR9XXX_WMAC
	select AR71XX_DEV_GPIO_BUTTONS
	select AR71XX_DEV_LEDS_GPIO
	select AR71XX_DEV_USB

config AR71XX_MACH_AP83
	bool "Atheros AP83 board support"
	select SOC_AR913X
	select AR71XX_DEV_AR9XXX_WMAC
	select AR71XX_DEV_GPIO_BUTTONS
	select AR71XX_DEV_LEDS_GPIO
	select AR71XX_DEV_USB

config AR71XX_MACH_AP96
	bool "Atheros AP96 board support"
	select SOC_AR71XX
	select AR71XX_DEV_M25P80
	select AR71XX_DEV_AP94_PCI if PCI
	select AR71XX_DEV_GPIO_BUTTONS
	select AR71XX_DEV_LEDS_GPIO
	select AR71XX_DEV_USB

config AR71XX_MACH_AP121
	bool "Atheros AP121 board support"
	select AR71XX_DEV_M25P80
	select AR71XX_DEV_GPIO_BUTTONS
	select AR71XX_DEV_LEDS_GPIO
	select AR71XX_DEV_USB
	select AR71XX_DEV_AR9XXX_WMAC
	select SOC_AR933X

config AR71XX_MACH_DB120
	bool "Atheros DB120 board support"
	select SOC_AR934X
	select AR71XX_DEV_AR9XXX_WMAC
	select AR71XX_DEV_DB120_PCI if PCI
	select AR71XX_DEV_GPIO_BUTTONS
	select AR71XX_DEV_LEDS_GPIO
	select AR71XX_DEV_USB

config AR71XX_MACH_DIR_600_A1
	bool "D-Link DIR-600 rev. A1 support"
	select SOC_AR724X
	select AR71XX_DEV_AP91_PCI if PCI
	select AR71XX_DEV_M25P80
	select AR71XX_DEV_GPIO_BUTTONS
	select AR71XX_DEV_LEDS_GPIO
	select AR71XX_NVRAM

config AR71XX_MACH_DIR_615_C1
	bool "D-Link DIR-615 rev. C1 support"
	select SOC_AR913X
	select AR71XX_DEV_M25P80
	select AR71XX_DEV_AR9XXX_WMAC
	select AR71XX_DEV_GPIO_BUTTONS
	select AR71XX_DEV_LEDS_GPIO
	select AR71XX_NVRAM

config AR71XX_MACH_DIR_825_B1
	bool "D-Link DIR-825 rev. B1 board support"
	select SOC_AR71XX
	select AR71XX_DEV_M25P80
	select AR71XX_DEV_AP94_PCI if PCI
	select AR71XX_DEV_GPIO_BUTTONS
	select AR71XX_DEV_LEDS_GPIO
	select AR71XX_DEV_USB

config AR71XX_MACH_JA76PF
	bool "jjPlus JA76PF board support"
	select SOC_AR71XX
	select AR71XX_DEV_M25P80
	select AR71XX_DEV_GPIO_BUTTONS
	select AR71XX_DEV_PB42_PCI if PCI
	select AR71XX_DEV_LEDS_GPIO
	select AR71XX_DEV_USB

config AR71XX_MACH_JWAP003
	bool "jjPlus JWAP003 board support"
	select SOC_AR71XX
	select AR71XX_DEV_M25P80
	select AR71XX_DEV_GPIO_BUTTONS
	select AR71XX_DEV_PB42_PCI if PCI
	select AR71XX_DEV_USB

config AR71XX_MACH_PB42
	bool "Atheros PB42 board support"
	select SOC_AR71XX
	select AR71XX_DEV_M25P80
	select AR71XX_DEV_GPIO_BUTTONS
	select AR71XX_DEV_PB42_PCI if PCI

config AR71XX_MACH_PB44
	bool "Atheros PB44 board support"
	select SOC_AR71XX
	select AR71XX_DEV_GPIO_BUTTONS
	select AR71XX_DEV_PB42_PCI if PCI
	select AR71XX_DEV_LEDS_GPIO
	select AR71XX_DEV_USB

config AR71XX_MACH_PB92
	bool "Atheros PB92 board support"
	select SOC_AR724X
	select AR71XX_DEV_GPIO_BUTTONS
	select AR71XX_DEV_PB9X_PCI if PCI
	select AR71XX_DEV_LEDS_GPIO
	select AR71XX_DEV_USB

config AR71XX_MACH_AW_NR580
	bool "AzureWave AW-NR580 board support"
	select SOC_AR71XX
	select AR71XX_DEV_M25P80
	select AR71XX_DEV_GPIO_BUTTONS
	select AR71XX_DEV_PB42_PCI if PCI
	select AR71XX_DEV_LEDS_GPIO

config AR71XX_MACH_WZR_HP_AG300H
	bool "Buffalo WZR-HP-AG300H board support"
	select SOC_AR71XX
	select AR71XX_DEV_M25P80
	select AR71XX_DEV_GPIO_BUTTONS
	select AR71XX_DEV_LEDS_GPIO
	select AR71XX_DEV_USB

config AR71XX_MACH_WZR_HP_G300NH
	bool "Buffalo WZR-HP-G300NH board support"
	select SOC_AR913X
	select AR71XX_DEV_AR9XXX_WMAC
	select AR71XX_DEV_GPIO_BUTTONS
	select AR71XX_DEV_LEDS_GPIO
	select AR71XX_DEV_USB
	select RTL8366_SMI

config AR71XX_MACH_WHR_HP_G300N
	bool "Buffalo WHR-HP-G300N board support"
	select SOC_AR724X
	select AR71XX_DEV_M25P80
	select AR71XX_DEV_AP91_PCI if PCI
	select AR71XX_DEV_GPIO_BUTTONS
	select AR71XX_DEV_LEDS_GPIO

config AR71XX_MACH_WP543
	bool "Compex WP543/WPJ543 board support"
	select SOC_AR71XX
	select MYLOADER
	select AR71XX_DEV_M25P80
	select AR71XX_DEV_GPIO_BUTTONS
	select AR71XX_DEV_PB42_PCI if PCI
	select AR71XX_DEV_LEDS_GPIO
	select AR71XX_DEV_USB

config AR71XX_MACH_WRT160NL
	bool "Linksys WRT160NL board support"
	select SOC_AR913X
	select AR71XX_DEV_M25P80
	select AR71XX_DEV_AR9XXX_WMAC
	select AR71XX_DEV_GPIO_BUTTONS
	select AR71XX_DEV_LEDS_GPIO
	select AR71XX_DEV_USB
	select AR71XX_NVRAM

config AR71XX_MACH_WRT400N
	bool "Linksys WRT400N board support"
	select SOC_AR71XX
	select AR71XX_DEV_AP94_PCI if PCI
	select AR71XX_DEV_M25P80
	select AR71XX_DEV_GPIO_BUTTONS
	select AR71XX_DEV_LEDS_GPIO

config AR71XX_MACH_RB4XX
	bool "MikroTik RouterBOARD 4xx series support"
	select SOC_AR71XX
	select AR71XX_DEV_GPIO_BUTTONS
	select AR71XX_DEV_LEDS_GPIO
	select AR71XX_DEV_USB

config AR71XX_MACH_RB750
	bool "MikroTik RouterBOARD 750 support"
	select SOC_AR724X

config AR71XX_MACH_WNDR3700
	bool "NETGEAR WNDR3700 board support"
	select SOC_AR71XX
	select AR71XX_DEV_M25P80
	select AR71XX_DEV_AP94_PCI if PCI
	select AR71XX_DEV_GPIO_BUTTONS
	select AR71XX_DEV_LEDS_GPIO
	select AR71XX_DEV_USB

config AR71XX_MACH_WNR2000
	bool "NETGEAR WNR2000 board support"
	select SOC_AR913X
	select AR71XX_DEV_M25P80
	select AR71XX_DEV_AR9XXX_WMAC
	select AR71XX_DEV_GPIO_BUTTONS
	select AR71XX_DEV_LEDS_GPIO

config AR71XX_MACH_OM2P
	bool "OpenMesh OM2P board support"
	select SOC_AR724X
	select AR71XX_DEV_M25P80
	select AR71XX_DEV_AP91_PCI if PCI
	select AR71XX_DEV_GPIO_BUTTONS
	select AR71XX_DEV_LEDS_GPIO

config AR71XX_MACH_MZK_W04NU
	bool "Planex MZK-W04NU board support"
	select SOC_AR913X
	select AR71XX_DEV_M25P80
	select AR71XX_DEV_AR9XXX_WMAC
	select AR71XX_DEV_GPIO_BUTTONS
	select AR71XX_DEV_LEDS_GPIO
	select AR71XX_DEV_USB

config AR71XX_MACH_MZK_W300NH
	bool "Planex MZK-W300NH board support"
	select SOC_AR913X
	select AR71XX_DEV_M25P80
	select AR71XX_DEV_AR9XXX_WMAC
	select AR71XX_DEV_GPIO_BUTTONS
	select AR71XX_DEV_LEDS_GPIO

config AR71XX_MACH_NBG460N
	bool "Zyxel NBG460N/550N/550NH board support"
	select SOC_AR913X
	select AR71XX_DEV_M25P80
	select AR71XX_DEV_AR9XXX_WMAC
	select AR71XX_DEV_GPIO_BUTTONS
	select AR71XX_DEV_LEDS_GPIO

config AR71XX_MACH_TL_MR3X20
	bool "TP-LINK TL-MR3220/3420 support"
	select SOC_AR724X
	select AR71XX_DEV_M25P80
	select AR71XX_DEV_AP91_PCI if PCI
	select AR71XX_DEV_GPIO_BUTTONS
	select AR71XX_DEV_LEDS_GPIO
	select AR71XX_DEV_USB

config AR71XX_MACH_TL_WA901ND
	bool "TP-LINK TL-WA901ND support"
	select SOC_AR724X
	select AR71XX_DEV_M25P80
	select AR71XX_DEV_AP91_PCI if PCI
	select AR71XX_DEV_GPIO_BUTTONS
	select AR71XX_DEV_LEDS_GPIO

config AR71XX_MACH_TL_WA901ND_V2
	bool "TP-LINK TL-WA901ND v2 support"
	select SOC_AR913X
	select AR71XX_DEV_M25P80
	select AR71XX_DEV_AR9XXX_WMAC
	select AR71XX_DEV_GPIO_BUTTONS
	select AR71XX_DEV_LEDS_GPIO

config AR71XX_MACH_TL_WR703N
	bool "TP-LINK TL-WR703N support"
	select SOC_AR933X
	select AR71XX_DEV_M25P80
	select AR71XX_DEV_GPIO_BUTTONS
	select AR71XX_DEV_LEDS_GPIO
	select AR71XX_DEV_USB
	select AR71XX_DEV_AR9XXX_WMAC

config AR71XX_MACH_TL_WR741ND
	bool "TP-LINK TL-WR741ND support"
	select SOC_AR724X
	select AR71XX_DEV_M25P80
	select AR71XX_DEV_AP91_PCI if PCI
	select AR71XX_DEV_GPIO_BUTTONS
	select AR71XX_DEV_LEDS_GPIO

config AR71XX_MACH_TL_WR741ND_V4
	bool "TP-LINK TL-WR741ND v4 support"
	select SOC_AR933X
	select AR71XX_DEV_M25P80
	select AR71XX_DEV_GPIO_BUTTONS
	select AR71XX_DEV_LEDS_GPIO
	select AR71XX_DEV_AR9XXX_WMAC

config AR71XX_MACH_TL_WR841N_V1
	bool "TP-LINK TL-WR841N v1 support"
	select SOC_AR71XX
	select AR71XX_DEV_M25P80
	select AR71XX_DEV_PB42_PCI if PCI
	select AR71XX_DEV_DSA
	select AR71XX_DEV_GPIO_BUTTONS
	select AR71XX_DEV_LEDS_GPIO

config AR71XX_MACH_TL_WR941ND
	bool "TP-LINK TL-WR941ND support"
	select SOC_AR913X
	select AR71XX_DEV_M25P80
	select AR71XX_DEV_AR9XXX_WMAC
	select AR71XX_DEV_DSA
	select AR71XX_DEV_GPIO_BUTTONS
	select AR71XX_DEV_LEDS_GPIO

config AR71XX_MACH_TL_WR1043ND
	bool "TP-LINK TL-WR1043ND support"
	select SOC_AR913X
	select AR71XX_DEV_M25P80
	select AR71XX_DEV_AR9XXX_WMAC
	select AR71XX_DEV_GPIO_BUTTONS
	select AR71XX_DEV_LEDS_GPIO
	select AR71XX_DEV_USB

config AR71XX_MACH_TEW_632BRP
	bool "TRENDnet TEW-632BRP support"
	select SOC_AR913X
	select AR71XX_DEV_M25P80
	select AR71XX_DEV_AR9XXX_WMAC
	select AR71XX_DEV_GPIO_BUTTONS
	select AR71XX_DEV_LEDS_GPIO
	select AR71XX_NVRAM

config AR71XX_MACH_UBNT
	bool "Ubiquiti AR71xx based boards support"
	select SOC_AR71XX
	select SOC_AR724X
	select AR71XX_DEV_M25P80
	select AR71XX_DEV_AP91_PCI if PCI
	select AR71XX_DEV_GPIO_BUTTONS
	select AR71XX_DEV_LEDS_GPIO
	select AR71XX_DEV_PB42_PCI if PCI
	select AR71XX_DEV_USB

config AR71XX_MACH_EAP7660D
	bool "Senao EAP7660D support"
	select SOC_AR71XX
	select AR71XX_DEV_M25P80
	select AR71XX_DEV_GPIO_BUTTONS
	select AR71XX_DEV_LEDS_GPIO

config AR71XX_MACH_ZCN_1523H
	bool "Zcomax ZCN-1523H support"
	select SOC_AR724X
	select AR71XX_DEV_M25P80
	select AR71XX_DEV_AP91_PCI if PCI
	select AR71XX_DEV_GPIO_BUTTONS
	select AR71XX_DEV_LEDS_GPIO

endmenu

config SOC_AR71XX
	bool
	select USB_ARCH_HAS_EHCI
	select USB_ARCH_HAS_OHCI

config SOC_AR724X
	bool
	select USB_ARCH_HAS_EHCI
	select USB_ARCH_HAS_OHCI

config SOC_AR913X
	bool
	select USB_ARCH_HAS_EHCI

config SOC_AR934X
	bool
	select USB_ARCH_HAS_EHCI

config AR71XX_DEV_M25P80
	def_bool n

config AR71XX_DEV_AP91_PCI
	select AR71XX_PCI_ATH9K_FIXUP
	def_bool n

config AR71XX_DEV_AP94_PCI
	select AR71XX_PCI_ATH9K_FIXUP
	def_bool n

config AR71XX_DEV_AR9XXX_WMAC
	def_bool n

config AR71XX_DEV_DB120_PCI
	select AR71XX_PCI_ATH9K_FIXUP
	def_bool n

config AR71XX_DEV_DSA
	def_bool n

config AR71XX_DEV_GPIO_BUTTONS
	def_bool n

config AR71XX_DEV_LEDS_GPIO
	def_bool n

config AR71XX_DEV_PB42_PCI
	def_bool n

config AR71XX_DEV_PB9X_PCI
	def_bool n

config AR71XX_DEV_USB
	def_bool n

config AR71XX_NVRAM
	def_bool n

config AR71XX_PCI_ATH9K_FIXUP
	def_bool n

config SOC_AR933X
	bool
	select USB_ARCH_HAS_EHCI

endif
```

## target/linux/ar71xx/files/drivers/net/ag71xx/Kconfig
```kconfig
config AG71XX
	tristate "Atheros AR71xx built-in ethernet mac support"
	depends on ATHEROS_AR71XX
	select PHYLIB
	help
	  If you wish to compile a kernel for AR71xx/91xx and enable
	  ethernet support, then you should always answer Y to this.

config AG71XX_DEBUG
	bool "Atheros AR71xx built-in ethernet driver debugging"
	depends on AG71XX
	default n
	help
	  Atheros AR71xx built-in ethernet driver debugging messages.
```

## target/linux/armsr/image/Config.in
```kconfig
config BUSYBOX_CUSTOM
	bool
	default y
config BUSYBOX_DEFAULT_MDEV
	bool
	default y
config BUSYBOX_DEFAULT_FEATURE_MDEV_CONF
	bool
	default y
config BUSYBOX_DEFAULT_FEATURE_MDEV_RENAME
	bool
	default y
config BUSYBOX_DEFAULT_FEATURE_MDEV_RENAME_REGEXP
	bool
	default y
config BUSYBOX_DEFAULT_FEATURE_MDEV_EXEC
	bool
	default y
config BUSYBOX_DEFAULT_FEATURE_MDEV_LOAD_FIRMWARE
	bool
	default y
config BUSYBOX_DEFAULT_FEATURE_MDEV_DAEMON
	bool
	default y
```

## target/linux/at91-2.6/image/Config.in
```kconfig
config AT91_ROMBOOT
	bool "Build romboot loader"
	depends LINUX_2_6_AT91
	default y

config AT91_UBOOT
	bool "Build u-boot loader"
	depends LINUX_2_6_AT91
	default y

config UBOOT_TARGET
	string "U-Boot Board Configuration"
	default "vlink"
	help
	  For all supported boards there are reqdy-to-use default
		configurations available; just type "<board_name>".
```

## target/linux/at91/image/Config.in
```kconfig
config AT91_DFBOOT
	bool "Build dataflashboot loader"
	depends on TARGET_at91

config FLEXIBITY_ROOT
	bool "Build Flexibity RootFS (with embedded kernel)"
	depends on TARGET_at91_flexibity
```

## target/linux/atheros-2.6/files/arch/mips/atheros/Kconfig
```kconfig
config ATHEROS_AR5312
	bool "Atheros 5312/2312+ support"
	depends on ATHEROS
	default y

config ATHEROS_AR5315
	bool "Atheros 5315/2315+ support"
	depends on ATHEROS
	default y
```
