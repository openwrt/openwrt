## target/linux/atheros/files/arch/mips/atheros/Kconfig
```kconfig
config ATHEROS_AR5312
	bool "Atheros 5312/2312+ support"
	depends on ATHEROS
	default y

config ATHEROS_AR5315
	bool "Atheros 5315/2315+ support"
	depends on ATHEROS
	select DMA_NONCOHERENT
	select CEVT_R4K
	select CSRC_R4K
	select IRQ_CPU
	select SYS_HAS_CPU_MIPS32_R1
	select SYS_SUPPORTS_32BIT_KERNEL
	select SYS_SUPPORTS_BIG_ENDIAN
	select GENERIC_GPIO
	default y

config ATHEROS_AR5315_PCI
	bool "PCI support"
	select HW_HAS_PCI
	select PCI
	select USB_ARCH_HAS_HCD
	select USB_ARCH_HAS_OHCI
	select USB_ARCH_HAS_EHCI
	depends on ATHEROS_AR5315
	default n
```

## target/linux/avr32/image/Config.in
```kconfig
config AVR32_UBOOT
	bool "Build U-Boot bootloader"
	depends on TARGET_avr32
	default n

config AVR32_UBOOT_TARGET
	string "U-Boot target board"
	depends on TARGET_avr32
	depends on AVR32_UBOOT
	default "atngw100"
	help
	  For all supported boards there are ready-to-use default
		configurations available; just type "<board_name>".
```

## target/linux/bcm27xx/image/Config.in
```kconfig
config BCM27XX_BOOT_FILES_PARTNAME
	string "Bootloader files location"
	depends on TARGET_bcm27xx
	help
		Specify folder with files for override content of boot partition on final image.
	
```

## target/linux/bcm4908/image/bootfs-generic.its
```
// SPDX-License-Identifier: GPL-2.0-or-later OR MIT

/dts-v1/;

/ {
	description = "OpenWrt bootfs image";
	#address-cells = <1>;

	images {
		atf {
			description = "ATF";
			data = /incbin/("${images_dir}/bl31.bin");
			type = "firmware";
			arch = "arm64";
			os = "arm-trusted-firmware";
			compression = "none";
			load = <0x4000>;
			entry = <0x4000>;

			hash-1 {
				algo = "sha256";
			};
		};

		uboot {
			description = "U-Boot";
			data = /incbin/("${images_dir}/u-boot/u-boot-nodtb.bin");
			os = "U-Boot";
			arch = "arm64";
			compression = "none";
			load = <0x1000000>;
			entry = <0x1000000>;

			hash-1 {
				algo = "sha256";
			};
		};

		kernel {
			description = "Linux kernel";
			data = /incbin/("${kernel}");
			type = "kernel";
			os = "linux";
			arch = "arm64";
			compression = "lzma";
			load = <0x80000>;
			entry = <0x80000>;

			hash-1 {
				algo = "sha256";
			};
		};

		fdt_uboot {
			description = "dtb";
			data = /incbin/("${images_dir}/u-boot/u-boot.dtb");
			type = "flat_dt";
			compression = "none";

			hash-1 {
				algo = "sha256";
			};
		};

		fdt_GTAX6000 {
			description = "dtb";
			data = /incbin/("${images_dir}/u-boot/GTAX6000.dtb");
			type = "flat_dt";
			compression = "none";

			hash-1 {
				algo = "sha256";
			};
		};

		fdt_uboot_RAX220 {
			description = "dtb";
			data = /incbin/("${images_dir}/u-boot/RAX220.dtb");
			type = "flat_dt";
			compression = "none";

			hash-1 {
				algo = "sha256";
			};
		};

		fdt_linux_RAX220 {
			description = "dtb";
			data = /incbin/("${dts_dir}/broadcom/bcm4908/bcm4908-netgear-raxe500.dtb");
			arch = "arm64";
			type = "flat_dt";
			compression = "none";
		};
	};

	configurations {
		default = "conf_uboot";

		conf_uboot {
			description = "BRCM 63xxx with uboot";
			fdt = "fdt_uboot";
			loadables = "atf", "uboot";
		};

		conf_ub_GTAX6000 {
			description = "GTAX6000";
			fdt = "fdt_GTAX6000";
			loadables = "atf", "uboot";
		};

		conf_ub_RAX220 {
			description = "RAX220";
			fdt = "fdt_uboot_RAX220";
			loadables = "atf", "uboot";
		};

		conf_lx_RAX220 {
			description = "BRCM 63xxx linux";
			kernel = "kernel";
			fdt = "fdt_linux_RAX220";
		};
	};
};
```

## target/linux/brcm-2.4/Config.in
```kconfig
config PACKAGE_KMOD_BRCM_WL
	prompt "kmod-brcm-wl...................... Broadcom Wireless Network Driver"
	tristate
	depends LINUX_2_4_BRCM
	default y
	help
	  Proprietary driver for Broadcom Wireless chipsets

config PACKAGE_KMOD_BRCM_WL2
	prompt "kmod-brcm-wl2..................... Broadcom Wireless Network Driver (new)"
	tristate
	depends LINUX_2_4_BRCM
	default m
	help
	  Proprietary driver for Broadcom Wireless chipsets
	  New version with Multi-BSS capability
```

## target/linux/brcm47xx-2.6/files/drivers/ssb/Kconfig
```kconfig
menu "Sonics Silicon Backplane"

config SSB
	tristate "Sonics Silicon Backplane support"
	depends on EXPERIMENTAL
	help
	  Support for the Sonics Silicon Backplane bus

	  The module will be called ssb

	  If unsure, say M

config SSB_PCIHOST
	bool "Support for SSB on PCI-bus host"
	depends on SSB && PCI
	default y
	help
	  Support for a Sonics Silicon Backplane on top
	  of a PCI device.

	  If unsure, say Y

config SSB_PCMCIAHOST
	bool "Support for SSB on PCMCIA-bus host"
	depends on SSB && PCMCIA
	help
	  Support for a Sonics Silicon Backplane on top
	  of a PCMCIA device.

	  If unsure, say N

config SSB_SILENT
	bool "No SSB kernel messages"
	depends on SSB
	help
	  This option turns off all Sonics Silicon Backplane printks.
	  Note that you won't be able to identify problems, once
	  messages are turned off.
	  This might only be desired for production kernels on
	  embedded devices to reduce the kernel size.

	  Say N

config SSB_DEBUG
	bool "SSB debugging"
	depends on SSB && !SSB_SILENT
	help
	  This turns on additional runtime checks and debugging
	  messages. Turn this on for SSB troubleshooting.

	  If unsure, say N

config SSB_SERIAL
	bool
	depends on SSB
	# ChipCommon and ExtIf serial support routines.

config SSB_DRIVER_PCICORE
	bool "SSB PCI core driver"
	depends on SSB && SSB_PCIHOST
	default y
	help
	  Driver for the Sonics Silicon Backplane attached
	  Broadcom PCI core.

	  If unsure, say Y

config SSB_PCICORE_HOSTMODE
	bool "Hostmode support for SSB PCI core"
	depends on SSB_DRIVER_PCICORE && SSB_DRIVER_MIPS
	help
	  PCIcore hostmode operation (external PCI bus).

endmenu
```

## target/linux/brcm63xx-2.6/files/arch/mips/bcm963xx/Kconfig
```kconfig
# Kernel and Driver configuration for Broadcom Commengine ADSL board
choice
	prompt "Broadcom Commengine ADSL board"
	depends on BCM963XX
	default BCM96348
	help
	  Select different Broadcom ADSL board

config BCM96338
	bool "96338 ADSL board"
	select DMA_NONCOHERENT
	select HW_HAS_PCI

config BCM96345
	bool "96345 ADSL board"
	select DMA_NONCOHERENT
	select HW_HAS_PCI

config BCM96348
	bool "96348 ADSL board"
	select DMA_NONCOHERENT
	select HW_HAS_PCI

endchoice

config BCM_BOARD
	bool "Support for Broadcom Board"
	depends on BCM96338 || BCM96345 || BCM96348

config BCM_SERIAL
	bool "Support for Serial Port"
	depends on BCM96338 || BCM96345 || BCM96348

config BCM_ENET
	tristate "Support for Ethernet"
	depends on BCM96338 || BCM96345 || BCM96348

config BCM_USB
	tristate "Support for USB"
	depends on BCM96338 || BCM96345 || BCM96348

config BCM_WLAN
	tristate "Support for Wireless"
	depends on BCM96338 || BCM96345 || BCM96348

config BCM_PCI
	bool "Support for PCI"
	depends on BCM96338 || BCM96345 || BCM96348
	select PCI

config BCM_ATMAPI
	tristate "Support for ATM"
	depends on BCM96338 || BCM96345 || BCM96348

config BCM_ATMTEST
	tristate "Support for ATM Diagnostic"
	depends on BCM96338 || BCM96345 || BCM96348

config BCM_ADSL
	tristate "Support for ADSL"
	depends on BCM96338 || BCM96345 || BCM96348

config BCM_ENDPOINT
	tristate "Support for VOICE"
	depends on BCM96338 || BCM96345 || BCM96348

config BCM_PROCFS
	tristate "Support for PROCFS"
	depends on BCM96338 || BCM96345 || BCM96348

config BCM_VDSL
	tristate "Support for VDSL"
	depends on BCM96338 || BCM96345 || BCM96348

config BCM_SECURITY
	tristate "Support for SECURITY"
	depends on BCM96338 || BCM96345 || BCM96348

config BCM_HPNA
	tristate "Support for HPNA"
	depends on BCM96338 || BCM96345 || BCM96348

config BCM_BOARD_IMPL
	int "Implementation index for ADSL Board"
	depends on BCM96338 || BCM96345 || BCM96348

config BCM_SERIAL_IMPL
	int "Implementation index for Serial"
	depends on BCM96338 || BCM96345 || BCM96348

config BCM_ENET_IMPL
	int "Implementation index for Ethernet"
	depends on BCM96338 || BCM96345 || BCM96348

config BCM_USB_IMPL
	int "Implementation index for USB"
	depends on BCM96338 || BCM96345 || BCM96348

config BCM_WLAN_IMPL
	int "Implementation index for WIRELESS"
	depends on BCM96338 || BCM96345 || BCM96348

config BCM_ATMAPI_IMPL
	int "Implementation index for ATM"
	depends on BCM96338 || BCM96345 || BCM96348

config BCM_ATMTEST_IMPL
	int "Implementation index for ATM Diagnostic"
	depends on BCM96338 || BCM96345 || BCM96348

config BCM_BLAA_IMPL
	int "Implementation index for BLAA"
	depends on BCM96338 || BCM96345 || BCM96348

config BCM_ADSL_IMPL
	int "Implementation index for ADSL"
	depends on BCM96338 || BCM96345 || BCM96348

config BCM_ENDPOINT_IMPL
	int "Implementation index for VOICE"
	depends on BCM96338 || BCM96345 || BCM96348

config BCM_PROCFS_IMPL
	int "Implementation index for PROCFS"
	depends on BCM96338 || BCM96345 || BCM96348

config BCM_VDSL_IMPL
	int "Implementation index for VDSL"
	depends on BCM96338 || BCM96345 || BCM96348

config BCM_SECURITY_IMPL
	int "Implementation index for SECURITY"
	depends on BCM96338 || BCM96345 || BCM96348

config BCM_HPNA_IMPL
	int "Implementation index for HPNA"
	depends on BCM96338 || BCM96345 || BCM96348
```

## target/linux/brcm63xx/files/arch/mips/bcm63xx/boards/Kconfig
```kconfig
choice
	prompt "Board support"
	depends on BCM63XX
	default BOARD_BCM963XX

config BOARD_BCM963XX
       bool "Generic Broadcom 963xx boards"
       help

config BOARD_LIVEBOX
	bool "Inventel Livebox(es) boards"
	help
	  Boards using RedBoot.

endchoice
```
