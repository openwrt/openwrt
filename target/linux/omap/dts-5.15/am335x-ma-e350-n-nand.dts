// SPDX-License-Identifier: GPL-2.0-or-later

/dts-v1/;

#include "am335x-ma-e350-n.dtsi"

/ {
	model = "Century Systems FutureNet MA-E350/N (NAND)";
	compatible = "centurysystems,ma-e350-n-nand", "ti,am33xx";
};
