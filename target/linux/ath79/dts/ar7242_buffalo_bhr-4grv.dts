// SPDX-License-Identifier: GPL-2.0-or-later OR MIT
/dts-v1/;

#include "ar7242_buffalo_wzr-bhr.dtsi"

/ {
	compatible = "buffalo,bhr-4grv", "qca,ar7242";
	model = "Buffalo BHR-4GRV";
};

&sec_vpn {
	label = "buffalo:orange:vpn";
};
