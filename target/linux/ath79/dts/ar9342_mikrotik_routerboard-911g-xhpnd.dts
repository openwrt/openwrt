// SPDX-License-Identifier: GPL-2.0-or-later

#include "ar9342_mikrotik_routerboard-911g.dtsi"

#include <dt-bindings/gpio/gpio.h>
#include <dt-bindings/input/input.h>

/ {
	compatible = "mikrotik,routerboard-911g-xhpnd", "qca,ar9342";
	model = "MikroTik RouterBOARD 911G-(2,5)HPnD";
};
