// SPDX-License-Identifier: GPL-2.0-or-later OR MIT
/dts-v1/;

#include "qca9558_tplink_tl-wdr4900-v2.dts"

/ {
	compatible = "tplink,tl-wdr4900-v2-16m", "qca,qca9558";
	model = "TP-Link TL-WDR4900 v2 16M";
};

&firmware {
	reg = <0x020000 0xfd0000>;
};

&art {
	reg = <0xff0000 0x010000>;
};
