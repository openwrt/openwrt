// SPDX-License-Identifier: GPL-2.0-or-later OR MIT

#include "ar9344_nec_aterm.dtsi"

/ {
	compatible = "nec,wr8750n", "qca,ar9344";
	model = "NEC Aterm WR8750N";
};

&partitions {
	partition@40000 {
		compatible = "denx,uimage";
		label = "firmware";
		reg = <0x040000 0x7c0000>;
	};
};
