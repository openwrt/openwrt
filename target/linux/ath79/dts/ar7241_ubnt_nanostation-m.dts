// SPDX-License-Identifier: GPL-2.0-or-later OR MIT

#include "ar7241.dtsi"
#include "ar724x_ubnt_xm.dtsi"
#include "ar724x_ubnt_xm_outdoor.dtsi"

/ {
	compatible = "ubnt,nanostation-m", "ubnt,xm", "qca,ar7241";
	model = "Ubiquiti Nanostation M (XM)";
};

&cal_art_1000 {
	reg = <0x1000 0xeb8>;
};

&wifi {
	compatible = "pci168c,002a";
};
