// SPDX-License-Identifier: GPL-2.0-or-later OR MIT
// Copyright (c) 2021 Cezary Jackiewicz
// Copyright (c) 2021, 2022 Lech Perczak
#include "qca9563_zte_mf286ar.dtsi"

/ {
	model = "ZTE MF286C";
	compatible = "zte,mf286c", "qca,qca9563";
};

&wifi_ath10k {
	qcom,ath10k-calibration-variant = "ZTE-MF286C";
};
