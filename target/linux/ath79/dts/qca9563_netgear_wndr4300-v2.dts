// SPDX-License-Identifier: GPL-2.0-or-later OR MIT

#include <dt-bindings/leds/common.h>

#include "qca9563_netgear_wndr.dtsi"

/ {
	compatible = "netgear,wndr4300-v2", "qca,qca9563";
	model = "Netgear WNDR4300 v2";
};

&leds {
	usb_green {
		function = LED_FUNCTION_USB;
		color = <LED_COLOR_ID_GREEN>;
		gpios = <&gpio 7 GPIO_ACTIVE_LOW>;
		trigger-sources = <&hub_port0>;
		linux,default-trigger = "usbport";
	};
};
