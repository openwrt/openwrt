// SPDX-License-Identifier: GPL-2.0-or-later OR MIT
/dts-v1/;

#include "qca9533_mikrotik_lhg-hb.dtsi"

/ {
	compatible = "mikrotik,lhg-2nd", "qca,qca9533";
	model = "MikroTik LHG 2nD (RBLHG-2nD)";
};
