// SPDX-License-Identifier: GPL-2.0-or-later OR MIT
/dts-v1/;

#include <dt-bindings/gpio/gpio.h>
#include <dt-bindings/input/input.h>

#include "qca9558_tl-archer-c7.dtsi"

/ {
	compatible = "tplink,tl-archer-c7-v2", "qca,qca9558";
	model = "TP-Link Archer C7 Version 2";
};

&rfkill {
	gpios = <&gpio 23 GPIO_ACTIVE_LOW>;
};
