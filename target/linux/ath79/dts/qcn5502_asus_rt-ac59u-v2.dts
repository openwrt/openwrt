// SPDX-License-Identifier: GPL-2.0-or-later OR MIT

#include "qcn5502_asus_rt-ac59u.dtsi"

#include <dt-bindings/gpio/gpio.h>
#include <dt-bindings/input/input.h>

/ {
	compatible = "asus,rt-ac59u-v2", "qca,qcn5500", "qca,qca9560";
	model = "ASUS RT-AC59U v2";
};

&mtdparts {
	partition@60000 {
		label = "firmware";
		reg = <0x060000 0x1fa0000>;
		compatible = "denx,uimage";
	};
};
