// SPDX-License-Identifier: GPL-2.0-or-later OR MIT
/dts-v1/;

#include "ar9331_tl-wr703n.dtsi"

/ {
	model = "TP-Link MR10U";
	compatible = "tplink,tl-mr10u";

	reg_usb_vbus: reg_usb_vbus {
		compatible = "regulator-fixed";
		regulator-name = "usb_vbus";
		regulator-min-microvolt = <5000000>;
		regulator-max-microvolt = <5000000>;
		gpio = <&gpio 28 GPIO_ACTIVE_HIGH>;
		enable-active-high;
	};

};
