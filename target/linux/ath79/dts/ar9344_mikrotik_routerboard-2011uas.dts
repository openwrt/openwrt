// SPDX-License-Identifier: GPL-2.0-or-later OR MIT

#include "ar9344_mikrotik_routerboard-2011.dtsi"
#include "ar9344_mikrotik_routerboard-2011-sfp.dtsi"
#include "ar9344_mikrotik_routerboard-2011-usb.dtsi"

/ {
	compatible = "mikrotik,routerboard-2011uas", "qca,ar9344";
	model = "MikroTik RouterBOARD 2011UAS";
};
