// SPDX-License-Identifier: GPL-2.0-or-later OR MIT

/dts-v1/;

#include "qca9563_glinet_gl-ar750s.dtsi"

/ {
	compatible = "glinet,gl-ar750s-nor-nand", "qca,qca9563";
	model = "GL.iNet GL-AR750S (NOR/NAND)";
};

&nor_partitions {
	partition@60000 {
		label = "kernel";
		reg = <0x060000 0x200000>;
	};
};

&nand_ubi {
	label = "ubi";
};
