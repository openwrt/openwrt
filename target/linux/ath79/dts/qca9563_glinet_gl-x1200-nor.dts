// SPDX-License-Identifier: GPL-2.0-or-later OR MIT

/dts-v1/;

#include "qca9563_glinet_gl-x1200.dtsi"

/ {
	compatible = "glinet,gl-x1200-nor", "qca,qca9563";
	model = "GL.iNet GL-X1200 (NOR)";
};

&nor_partitions {
	partition@60000 {
		compatible = "denx,uimage";
		label = "firmware";
		reg = <0x060000 0xfa0000>;
	};
};
