// SPDX-License-Identifier: GPL-2.0-or-later OR MIT

#include <dt-bindings/leds/common.h>

#include "qca9533_tplink_cpexxx.dtsi"

&leds {
	lan {
		function = LED_FUNCTION_LAN;
		color = <LED_COLOR_ID_GREEN>;
		gpios = <&gpio 11 GPIO_ACTIVE_LOW>;
	};
};

&eth1 {
	compatible = "syscon", "simple-mfd";
};
