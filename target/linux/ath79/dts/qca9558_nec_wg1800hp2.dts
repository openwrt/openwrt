// SPDX-License-Identifier: GPL-2.0-or-later OR MIT

#include "qca9558_nec_aterm.dtsi"

/ {
	compatible = "nec,wg1800hp2", "qca,qca9558";
	model = "NEC Aterm WG1800HP2";
};

&eth0 {
	pll-data = <0x96000000 0x00000101 0x00001616>;
};
