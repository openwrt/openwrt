// SPDX-License-Identifier: GPL-2.0-or-later OR MIT

#include "qca9531_glinet_gl-e750.dtsi"

/ {
	compatible = "glinet,gl-e750", "qca,qca9531";
	model = "GL.iNet GL-E750";

	aliases {
		label-mac-device = &eth0;
	};
};
