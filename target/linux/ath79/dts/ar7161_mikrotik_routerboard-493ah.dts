// SPDX-License-Identifier: GPL-1.0-or-later OR MIT
/dts-v1/;

#include "ar7100_mikrotik_routerboard-4xx.dtsi"

/ {
	compatible = "mikrotik,routerboard-493ah", "qca,ar7161";
	model = "MikroTik RouterBOARD 493AH";

	keys: keys {
		compatible = "gpio-keys";

		status = "disabled";

		reset_key: reset {
			label = "reset";
			linux,code = <KEY_RESTART>;
			gpios = <&gpio 7 GPIO_ACTIVE_LOW>;
			debounce-interval = <60>;
		};
	};
};
