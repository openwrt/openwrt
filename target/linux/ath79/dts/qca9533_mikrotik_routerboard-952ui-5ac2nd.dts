// SPDX-License-Identifier: GPL-2.0-or-later OR MIT

#include "qca9533_mikrotik_routerboard-95x.dtsi"

/ {
	compatible = "mikrotik,routerboard-952ui-5ac2nd", "qca,qca9533";
	model = "MikroTik RouterBOARD 952Ui-5ac2nD (hAP ac lite)";
};

&pcie0 {
	status = "okay";

	wifi@0,0 {
		compatible = "qcom,ath10k";
		reg = <0 0 0 0 0>;
	};
};

