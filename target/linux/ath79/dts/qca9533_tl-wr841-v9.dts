// SPDX-License-Identifier: GPL-2.0-or-later OR MIT
/dts-v1/;

#include <dt-bindings/gpio/gpio.h>
#include <dt-bindings/input/input.h>

#include "qca9533_tl-wr841.dtsi"

/ {
	compatible = "tplink,tl-wr841n-v9", "qca,qca9533";
	model = "TP-Link TL-WR841N/ND Version 9";
};
