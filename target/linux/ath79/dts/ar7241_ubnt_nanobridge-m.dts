// SPDX-License-Identifier: GPL-2.0-or-later OR MIT
/dts-v1/;

#include "ar7241_ubnt_xm_outdoor.dtsi"

/ {
	compatible = "ubnt,nanobridge-m", "ubnt,xm", "qca,ar7241";
	model = "Ubiquiti NanoBridge M";
};

&eth1 {
	compatible = "syscon", "simple-mfd";
};
