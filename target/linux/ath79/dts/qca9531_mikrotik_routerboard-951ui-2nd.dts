// SPDX-License-Identifier: GPL-2.0-or-later OR MIT

#include "qca9533_mikrotik_routerboard-95x.dtsi"

/ {
	compatible = "mikrotik,routerboard-951ui-2nd", "qca,qca9531";
	model = "MikroTik RouterBOARD 951Ui-2nD (hAP)";
};
