// SPDX-License-Identifier: GPL-2.0-or-later OR MIT

/dts-v1/;

#include "qca9531_xwrt_gw521.dtsi"

/ {
	compatible = "xwrt,gw521-nand", "qca,qca9531";
	model = "XWRT GW521 (NAND)";
};

&nand_kernel {
	label = "kernel";
};

&nand_ubi {
	label = "ubi";
};
