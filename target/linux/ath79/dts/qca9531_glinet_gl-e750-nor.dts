// SPDX-License-Identifier: GPL-2.0-or-later OR MIT

/dts-v1/;

#include "qca9531_glinet_gl-e750.dtsi"

/ {
	compatible = "glinet,gl-e750-nor", "qca,qca9531";
	model = "GL.iNet GL-E750 (NOR)";
};

&nor_partitions {
	partition@60000 {
		compatible = "denx,uimage";
		label = "firmware";
		reg = <0x060000 0xfa0000>;
	};
};
