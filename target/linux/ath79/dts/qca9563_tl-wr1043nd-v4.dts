// SPDX-License-Identifier: GPL-2.0-or-later OR MIT
/dts-v1/;

#include <dt-bindings/gpio/gpio.h>
#include <dt-bindings/input/input.h>

#include "qca9563_tl-wr1043n.dtsi"

/ {
	compatible = "tplink,tl-wr1043nd-v4", "qca,qca9563";
	model = "TP-Link TL-WR1043ND Version 4";
};
