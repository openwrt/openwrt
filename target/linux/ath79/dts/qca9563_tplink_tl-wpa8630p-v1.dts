// SPDX-License-Identifier: GPL-2.0-or-later OR MIT

#include "qca9563_tplink_tl-wpa8630-v1.dtsi"

/ {
	compatible = "tplink,tl-wpa8630p-v1", "qca,qca9563";
	model = "TP-Link TL-WPA8630P v1";

	aliases {
		label-mac-device = &eth0;
	};
};

