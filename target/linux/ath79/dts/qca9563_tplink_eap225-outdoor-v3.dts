// SPDX-License-Identifier: GPL-2.0-or-later OR MIT

#include "qca9563_tplink_eap225-outdoor-v3.dtsi"

/ {
	compatible = "tplink,eap225-outdoor-v3", "qca,qca9563";
	model = "TP-Link EAP225-Outdoor v3";
};
