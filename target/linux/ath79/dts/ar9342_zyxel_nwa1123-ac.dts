// SPDX-License-Identifier: GPL-2.0-or-later OR MIT

#include "ar9342_zyxel_nwa112x.dtsi"

/ {
	compatible = "zyxel,nwa1123-ac", "qca,ar9342";
	model = "Zyxel NWA1123-AC";
};

&pcie {
	status = "okay";
};
