## target/linux/ramips/files/arch/mips/ralink/rt305x/Kconfig
```kconfig
if RALINK_RT305X

menu "Ralink RT350x machine selection"

config RT305X_MACH_CARAMBOLA
	bool "8devices Carambola dev board support"
	select RALINK_DEV_GPIO_BUTTONS
	select RALINK_DEV_GPIO_LEDS

config RT305X_MACH_3G_6200N
	bool "Edimax 3G-6200N board support"
	select RALINK_DEV_GPIO_BUTTONS
	select RALINK_DEV_GPIO_LEDS

config RT305X_MACH_WR6202
	bool "Accton WR6202"
	select RALINK_DEV_GPIO_BUTTONS
	select RALINK_DEV_GPIO_LEDS

config RT305X_MACH_ALL0256N
	bool "Allnet ALL0256N support"
	select RALINK_DEV_GPIO_BUTTONS
	select RALINK_DEV_GPIO_LEDS

config RT305X_MACH_ALL5002
	bool "Allnet ALL5002 support"
	select RALINK_DEV_GPIO_BUTTONS
	select RALINK_DEV_GPIO_LEDS

config RT305X_MACH_W502U
	bool "ALFA Networks W502U board support"
	select RALINK_DEV_GPIO_BUTTONS
	select RALINK_DEV_GPIO_LEDS

config RT305X_MACH_ARGUS_ATP52B
	bool "Argus ATP-52B support"
	select RALINK_DEV_GPIO_BUTTONS
	select RALINK_DEV_GPIO_LEDS

config RT305X_MACH_RT_G32_REVB
	bool "Asus RT-G32 revB board support"
	select RALINK_DEV_GPIO_BUTTONS

config RT305X_MACH_RT_N10_PLUS
	bool "Asus RT-N10+ board support"
	select RALINK_DEV_GPIO_BUTTONS
	select RALINK_DEV_GPIO_LEDS

config RT305X_MACH_WL_330N
	bool "Asus WL-330N board support"
	select RALINK_DEV_GPIO_BUTTONS
	select RALINK_DEV_GPIO_LEDS

config RT305X_MACH_WL_330N3G
	bool "Asus WL-330N3G board support"
	select RALINK_DEV_GPIO_BUTTONS
	select RALINK_DEV_GPIO_LEDS

config RT305X_MACH_HW550_3G
	bool "Aztech HW550-3G support"
	select RALINK_DEV_GPIO_BUTTONS
	select RALINK_DEV_GPIO_LEDS

config RT305X_MACH_F5D8235_V2
	bool "Belkin F5D8235 v2 support"
	select RALINK_DEV_GPIO_BUTTONS
	select RALINK_DEV_GPIO_LEDS

config RT305X_MACH_WHR_G300N
	bool "Buffalo WHR-G300N support"
	select RALINK_DEV_GPIO_BUTTONS
	select RALINK_DEV_GPIO_LEDS

config RT305X_MACH_DIR_300_REVB
	bool "D-Link DIR-300 revB board support"
	select RALINK_DEV_GPIO_BUTTONS
	select RALINK_DEV_GPIO_LEDS

config RT305X_MACH_DIR_615_H1
	bool "D-Link DIR-615 H1 board support"
	select RALINK_DEV_GPIO_BUTTONS
	select RALINK_DEV_GPIO_LEDS

config RT305X_MACH_DAP_1350
	bool "D-Link DAP-1350 board support"
	select RALINK_DEV_GPIO_BUTTONS
	select RALINK_DEV_GPIO_LEDS

config RT305X_MACH_ESR_9753
	bool "EnGenius ESR-9753 support"
	select RALINK_DEV_GPIO_BUTTONS
	select RALINK_DEV_GPIO_LEDS

config RT305X_MACH_BROADWAY
	bool "Hauppauge Broadway support"
	select RALINK_DEV_GPIO_BUTTONS
	select RALINK_DEV_GPIO_LEDS

config RT305X_MACH_FONERA20N
	bool "La Fonera20N board support"
	select RALINK_DEV_GPIO_BUTTONS
	select RALINK_DEV_GPIO_LEDS

config RT305X_MACH_RT_N13U
	bool "ASUS RT-N13U board support"
	select RALINK_DEV_GPIO_BUTTONS
	select RALINK_DEV_GPIO_LEDS

config RT305X_MACH_FREESTATION5
	bool "ARC FreeStation5"

config RT305X_MACH_MOFI3500_3GN
	bool "MoFi Network MOFI3500-3GN support"
	select RALINK_DEV_GPIO_BUTTONS
	select RALINK_DEV_GPIO_LEDS

config RT305X_MACH_WR512_3GN
	bool "SH-WR512NU/WS-WR512N1-like 3GN router"
	select RALINK_DEV_GPIO_BUTTONS
	select RALINK_DEV_GPIO_LEDS

config RT305X_MACH_UR_336UN
	bool "UR-336UN Wireless N router"
	select RALINK_DEV_GPIO_BUTTONS
	select RALINK_DEV_GPIO_LEDS

config RT305X_MACH_NW718
	bool "Netcore NW718"
	select RALINK_DEV_GPIO_BUTTONS
	select RALINK_DEV_GPIO_LEDS

config RT305X_MACH_BC2
	bool "NexAira BC2"
	select RALINK_DEV_GPIO_BUTTONS
	select RALINK_DEV_GPIO_LEDS

config RT305X_MACH_OMNI_EMB
	bool "Omnima MiniEMBWiFi"
	select RALINK_DEV_GPIO_BUTTONS
	select RALINK_DEV_GPIO_LEDS

config RT305X_MACH_PSR_680W
	bool "Petatel PSR-680W Wireless 3G Router support"
	select RALINK_DEV_GPIO_BUTTONS
	select RALINK_DEV_GPIO_LEDS

config RT305X_MACH_PWH2004
	bool "Prolink PWH2004 / Abocom WR5205 support (32M RAM, 8M flash)"
	select RALINK_DEV_GPIO_BUTTONS
	select RALINK_DEV_GPIO_LEDS

config RT305X_MACH_V22RW_2X2
	bool "Ralink AP-RT3052-V22RW-2X2 board support"
	select RALINK_DEV_GPIO_BUTTONS
	select RALINK_DEV_GPIO_LEDS

config RT305X_MACH_W306R_V20
	bool "Tenda W306R V2.0 board support"
	select RALINK_DEV_GPIO_BUTTONS
	select RALINK_DEV_GPIO_LEDS

config RT305X_MACH_WL341V3
	bool "Sitecom WL-341 v3 board support"
	select RALINK_DEV_GPIO_BUTTONS
	select RALINK_DEV_GPIO_LEDS

config RT305X_MACH_WL351
	bool "Sitecom WL-351 support"
	select RALINK_DEV_GPIO_BUTTONS
	select RALINK_DEV_GPIO_LEDS

config RT305X_MACH_SL_R7205
	bool "Skyline SL-R7205 Wireless 3G Router support"
	select RALINK_DEV_GPIO_BUTTONS
	select RALINK_DEV_GPIO_LEDS

config RT305X_MACH_WCR150GN
	bool "Sparklan WCR-150GN support"
	select RALINK_DEV_GPIO_BUTTONS
	select RALINK_DEV_GPIO_LEDS

config RT305X_MACH_NBG_419N
	bool "ZyXEL NBG-419N support"
	select RALINK_DEV_GPIO_BUTTONS
	select RALINK_DEV_GPIO_LEDS

config RT305X_MACH_XDX_RN502J
	bool "Unknown board XDX-RN502J"
	select RALINK_DEV_GPIO_BUTTONS
	select RALINK_DEV_GPIO_LEDS

endmenu

endif
```

## target/linux/ramips/files/arch/mips/ralink/rt3883/Kconfig
```kconfig
if RALINK_RT3883

menu "Ralink RT3662/RT3883 machine selection"

config RT3883_MACH_RT_N56U
	bool "Asus RT-N56U support"
	select HW_HAS_PCI
	select RALINK_DEV_GPIO_BUTTONS
	select RALINK_DEV_GPIO_LEDS

config RT3883_MACH_DIR_645
	bool "D-Link DIR-645 support"
	select RALINK_DEV_GPIO_BUTTONS
	select RALINK_DEV_GPIO_LEDS

config RT3883_MACH_TEW_691GR
	bool "TRENDnet TEW-691GR support"
	select RALINK_DEV_GPIO_BUTTONS
	select RALINK_DEV_GPIO_LEDS

config RT3883_MACH_TEW_692GR
	bool "TRENDnet TEW-692GR support"
	select HW_HAS_PCI
	select RALINK_DEV_GPIO_BUTTONS
	select RALINK_DEV_GPIO_LEDS

endmenu

endif
```

## target/linux/ramips/files/drivers/net/ethernet/ralink/Kconfig
```kconfig
config NET_RALINK
	tristate "Ralink ethernet driver"
	depends on RALINK
	help
	  This driver supports the ethernet mac inside the ralink wisocs

if NET_RALINK
choice
	prompt "MAC type"

config NET_RALINK_RT288X
	bool "RT288X"
	depends on SOC_RT288X

config NET_RALINK_RT305X
	bool "RT305X"
	depends on (SOC_RT305X || SOC_MT7620)

config NET_RALINK_RT3883
	bool "RT3883"
	depends on SOC_RT3883

config NET_RALINK_MT7620
	bool "MT7620"
	depends on SOC_MT7620

config NET_RALINK_MT7621
	bool "MT7621"
	depends on SOC_MT7621

endchoice

config NET_RALINK_MDIO
	def_bool NET_RALINK
	depends on (NET_RALINK_RT288X || NET_RALINK_RT3883 || NET_RALINK_MT7620 || NET_RALINK_MT7621)
	select PHYLIB

config NET_RALINK_MDIO_RT2880
	def_bool NET_RALINK
	depends on (NET_RALINK_RT288X || NET_RALINK_RT3883)
	select NET_RALINK_MDIO

config NET_RALINK_ESW_RT3052
	def_bool NET_RALINK
	depends on NET_RALINK_RT305X
	select PHYLIB
	select SWCONFIG

config NET_RALINK_GSW_MT7620
	def_bool NET_RALINK
	depends on NET_RALINK_MT7620 || NET_RALINK_MT7621
	select NET_RALINK_MDIO
	select PHYLIB
	select SWCONFIG
endif
```

## target/linux/ramips/files/drivers/net/ethernet/ramips/Kconfig
```kconfig
config NET_RAMIPS
       tristate "Ralink RT288X/RT3X5X/RT3662/RT3883 ethernet driver"
       depends on MIPS_RALINK
       select PHYLIB if (SOC_RT288X || SOC_RT3883)
       help
         This driver supports the etehrnet mac inside the ralink wisocs

if NET_RAMIPS

config NET_RAMIPS_DEBUG
       bool "Enable debug messages in the Ralink ethernet driver"

endif
```

## target/linux/realtek/files-5.10/Documentation/devicetree/bindings/clock/realtek,rtl8380-clock.yaml
```yaml
# SPDX-License-Identifier: GPL-2.0
%YAML 1.2
---
$id: http://devicetree.org/schemas/clock/realtek,rtl8380-clock.yaml#
$schema: http://devicetree.org/meta-schemas/core.yaml#

title: Realtek clock control unit Device Tree Bindings

maintainers:
  - Markus Stockhausen <markus.stockhausen@gmx.de>

description: |
  The driver provides basic clock support for the central core clock unit (CCU)
  and its PLLs inside the RTL838X, RTL8389X and RTL930X SOC. All provided clocks
  are derived from an oscillator that runs at a fixed speed of 25 MHz. Currently
  switch, CPU, memory and LXB (Lexra Bus) clock information can be accessed. The
  clocks can be referenced by 'include/dt-bindings/clock/rtl83xx-clk.h'.

  If changing of clock speeds is required then SRAM must be defined via DT.
  The relevant code is copied to SRAM and run from there. To provide SRAM
  see http://devicetree.org/schemas/sram/sram.yaml#. E.g.
 
  sram0: sram@9f000000 {
      compatible = "mmio-sram";
      reg = <0x9f000000 0x18000>;
      #address-cells = <1>;
      #size-cells = <1>;
      ranges = <0 0x9f000000 0x18000>;
  };

  If SRAM is enabled and clock changing is allowed the driver can be directly
  used by the DT based cpufreq driver (enabled by CONFIG_CPUFREQ_DT). At least
  if CPU references the right clock and sane operating points (OPP) are
  provided. E.g.
 
  cpu@0 {
      compatible = "mips,mips4KEc";
      reg = <0>;
      clocks = <&ccu CLK_CPU>;
      operating-points-v2 = <&cpu_opp_table>;
  };
 
  cpu_opp_table: opp-table-0 {
      compatible = "operating-points-v2";
      opp-shared;
      opp00 {
          opp-hz = /bits/ 64 <425000000>;
      };
      ...
  }

  Changing of clocks is often realized by busy waiting. When using that feature
  the additional load should be considered.      

properties:
  "#clock-cells":
    const: 1

  compatible:
    enum:
      - realtek,rtl8380-clock
      - realtek,rtl8390-clock
      - realtek,rtl9300-clock

required:
  - "#clock-cells"
  - compatible

examples:
  - |
    ccu: clock-controller {
        compatible = "realtek,rtl9300-clock";
        #clock-cells = <1>;
    };

...
```

## target/linux/realtek/files-6.18/Documentation/devicetree/bindings/crypto/realtek,realtek-crypto.yaml
```yaml
# SPDX-License-Identifier: (GPL-2.0-only OR BSD-2-Clause)
%YAML 1.2
---
$id: http://devicetree.org/schemas/crypto/realtek,realtek-crypto.yaml#
$schema: http://devicetree.org/meta-schemas/core.yaml#

title: Realtek crypto engine bindings

maintainers:
  - Markus Stockhausen <markus.stockhausen@gmx.de>

description: |
  The Realtek crypto engine provides hardware accelerated AES, SHA1 & MD5
  algorithms. It is included in SoCs of the RTL838x series, such as RTL8380,
  RTL8381, RTL8382, as well as SoCs from the RTL930x series, such as RTL9301,
  RTL9302 and RTL9303.

properties:
  compatible:
    const: realtek,realtek-crypto

  reg:
    minItems: 1
    maxItems: 1

  interrupt-parent:
    minItems: 1
    maxItems: 1

  interrupts:
    minItems: 1
    maxItems: 1

required:
  - compatible
  - reg
  - interrupt-parent
  - interrupts

additionalProperties: false

examples:
  - |
    crypto0: crypto@c000 {
      compatible = "realtek,realtek-crypto";
      reg = <0xc000 0x10>;
      interrupt-parent = <&intc>;
      interrupts = <22 3>;
    };

...
```

## target/linux/realtek/files-6.18/Documentation/devicetree/bindings/i2c/i2c-gpio-shared.yaml
```yaml
# SPDX-License-Identifier: (GPL-2.0-only OR BSD-2-Clause)
%YAML 1.2
---
$id: http://devicetree.org/schemas/i2c/i2c-gpio-shared.yaml#
$schema: http://devicetree.org/meta-schemas/core.yaml#

title: Multiple GPIO bitbanged I2C buses with shared SCL

maintainers:
  - Markus Stockhausen <markus.stockhausen@gmx.de>

description: |
  Bitbanging I2C bus driver that supports multiple independent I2C buses
  sharing a single SCL line. Each child node represents one I2C bus with
  its own SDA line. The index of each entry in the parent's sda-gpios
  property must match the reg value of the corresponding child bus node.

    +------------+
    | SoC        |
    |            |               +-----+  +-----+
    |   +------+ |  SDA0         | dev |  | dev |
    |   | GPIO |-|-----------+   +-----+  +-----+
    |   +------+ |           |      |        |
    |            |           +------+--------+ bus 0 on SDA0/SCL
    |   +------+ |  SCL      |
    |   | GPIO |-|-----------+
    |   +------+ |           |
    |            |           +------+--------+ bus 1 on SDA1/SCL
    |   +------+ |  SDA1     |      |        |
    |   | GPIO |-|-----------+   +-----+  +-----+
    |   +------+ |               | dev |  | dev |
    +------------+               +-----+  +-----+

properties:
  compatible:
    const: i2c-gpio-shared

  scl-gpios:
    maxItems: 1
    description:
      GPIO used for the shared SCL signal. Must be configured as open-drain.

  sda-gpios:
    minItems: 2
    maxItems: 32
    description:
      GPIOs used for the SDA signals of the individual I2C buses. The index
      of the GPIO in this list corresponds to the 'reg' property of the
      child bus nodes (e.g., the first GPIO is for the child with reg = <0>).
      Must be configured as open-drain.

  "#address-cells":
    const: 1

  "#size-cells":
    const: 0

required:
  - compatible
  - scl-gpios
  - sda-gpios
  - "#address-cells"
  - "#size-cells"

patternProperties:
  "^i2c@[0-9a-f]+$":
    type: object
    $ref: /schemas/i2c/i2c-controller.yaml#
    unevaluatedProperties: false

    properties:
      reg:
        maxItems: 1
        description:
          Index into the sda-gpios array used by this specific bus.

      clock-frequency:
        minimum: 1
        maximum: 400000
        default: 100000
        description:
          Desired I2C bus clock frequency in Hz.

    required:
      - reg

additionalProperties: false

examples:
  - |
    #include <dt-bindings/gpio/gpio.h>

    i2c {
        compatible = "i2c-gpio-shared";
        scl-gpios = <&gpio1 31 (GPIO_ACTIVE_HIGH | GPIO_OPEN_DRAIN)>;
        sda-gpios = <&gpio1 6 (GPIO_ACTIVE_HIGH | GPIO_OPEN_DRAIN)>,
                    <&gpio1 7 (GPIO_ACTIVE_HIGH | GPIO_OPEN_DRAIN)>;
        #address-cells = <1>;
        #size-cells = <0>;

        i2c@0 {
            reg = <0>;
            clock-frequency = <100000>;
            #address-cells = <1>;
            #size-cells = <0>;

            eeprom@50 {
                compatible = "atmel,24c02";
                reg = <0x50>;
            };
        };

        i2c@1 {
            reg = <1>;
            clock-frequency = <400000>;
            #address-cells = <1>;
            #size-cells = <0>;
        };
    };
```

## target/linux/realtek/files-6.18/Documentation/devicetree/bindings/watchdog/hasivo,mcu-wdt.yaml
```yaml
# SPDX-License-Identifier: (GPL-2.0-only OR BSD-2-Clause)
%YAML 1.2
---
$id: http://devicetree.org/schemas/watchdog/hasivo,mcu-wdt.yaml#
$schema: http://devicetree.org/meta-schemas/core.yaml#

title: Hasivo / Horaco external management MCU watchdog

maintainers:
  - Carlo Szelinsky <github@szelinsky.de>
  - Manuel Stocker <mensi@mensi.ch>

description: |
  Management microcontroller found on Hasivo and Horaco network switches,
  exposed on the system I2C bus. Provides a hardware watchdog that must be
  armed and periodically retriggered by the host via I2C writes.

allOf:
  - $ref: watchdog.yaml#

properties:
  compatible:
    const: hasivo,mcu-wdt

  reg:
    maxItems: 1

required:
  - compatible
  - reg

unevaluatedProperties: false

examples:
  - |
    i2c {
        #address-cells = <1>;
        #size-cells = <0>;

        watchdog@6f {
            compatible = "hasivo,mcu-wdt";
            reg = <0x6f>;
        };
    };
...
```
