## target/linux/realtek/files-6.6/Documentation/devicetree/bindings/phy/realtek,otto-serdes.yaml
```yaml
# SPDX-License-Identifier: GPL-2.0-only OR BSD-2-Clause
%YAML 1.2
---
$id: http://devicetree.org/schemas/phy/realtek,otto-serdes.yaml#
$schema: http://devicetree.org/meta-schemas/core.yaml#

title: Realtek Otto SerDes controller

maintainers:
  - Markus Stockhausen <markus.stockhausen@gmx.de>

description: |
  The MIPS based Realtek Switch SoCs of the Realtek RTL838x, RTL839x, RTL930x and
  RTL931x series have multiple SerDes built in. They are linked to different single,
  quad or octa PHYs like the RTL8218B, RTL8218D or RTL8214FC and are the integral
  part of the up-to-52-port switch architecture.
  Although these SerDes controllers have common basics they behave differently on
  the SoC families and rely on heavy register magic. To keep the driver clean it can
  load patch sequences from devictree and execute them during the controller actions
  like phy_init(), ...
  The driver exposes the SerDes registers different from the hardware but instead
  gives a consistent view and programming interface. So the RTL838x series has 6 ports
  and 4 pages, the RTL839x has 14 ports and 12 pages, the RTL930x has 12 ports and
  64 pages and the RTL931x has 14 ports and 192 pages.

properties:
  $nodename:
    pattern: "^serdes@[0-9a-f]+$"

  compatible:
    items:
      - enum:
          - realtek,rtl8380-serdes
          - realtek,rtl8390-serdes
          - realtek,rtl9300-serdes
          - realtek,rtl9310-serdes

  reg:
    items:
      - description: |
        The primary serdes register memory location. Other SerDes control and
        management registers are distributed all over the I/O memory space and
        are identified by the driver automatically.

  controlled-ports:
    description: |
      A bit mask defining the ports that are actively controlled by the driver. In
      case a bit is not set the driver will only process read operations on the
      SerDes. If not set the driver will run all ports in read only mode.

  "#phy-cells":
    const: 4
    description: |
      The first number defines the SerDes to use. The second number a linked
      SerDes. E.g. if a octa 1G PHY is attached to two QSGMII SerDes. The third
      number is the first switch port this SerDes is working for, the fourth number
      is the last switch port the SerDes is working for.

  cmd-setup:
    description: |
      A field of 16 bit values that contain a patch/command sequence to run on the
      SerDes registers during driver setup.

  cmd-init:
    description: |
      A field of 16 bit values that contain a patch/command sequence to run on the
      SerDes registers when a controller calls phy_init().

  cmd-power-on:
    description: |
      A field of 16 bit values that contain a patch/command sequence to run on the
      SerDes registers when a controller calls phy_power_on().

  cmd-pre-set-mode:
    description: |
      A field of 16 bit values that contain a patch/command sequence to run on the
      SerDes registers when a controller calls phy_set_mode() and before the driver
      actually sets the mode.

  cmd-post-set-mode:
    description: |
      A field of 16 bit values that contain a patch/command sequence to run on the
      SerDes registers when a controller calls phy_set_mode() and after the driver
      has set the mode.

  cmd-pre-reset:
    description: |
      A field of 16 bit values that contain a patch/command sequence to run on the
      SerDes registers when a controller calls phy_reset() and before the driver
      actually resets the SerDes.

  cmd-post-reset:
    description: |
      A field of 16 bit values that contain a patch/command sequence to run on the
      SerDes registers when a controller calls phy_reset() and after the driver
      has reset the SerDes.

  cmd-pre-power-off:
    description: |
      A field of 16 bit values that contain a patch/command sequence to run on the
      SerDes registers when a controller calls phy_power_off() and before the
      driver actually powers off the SerDes.

  cmd-post-power-off:
    description: |
      A field of 16 bit values that contain a patch/command sequence to run on the
      SerDes registers when a controller calls phy_power_off() and after the driver
      has powered off the SerDes.

reguired:
  - compatible
  - reg
  - port-count
  - page-count
  - "#phy-cells"

additionalProperties:
  false

examples:
  - |
    serdes: serdes@1b00e780 {
      compatible = "realtek,rtl8380-serdes", "realtek,otto-serdes";
      reg = <0x1b00e780 0x1200>;
      controlled-ports = <0x003f>;
      #phy-cells = <2>;
    };
  - |
    serdes: serdes@1b00a000 {
      compatible = "realtek,rtl8390-serdes", "realtek,otto-serdes";
      reg = <0x1b00a000 0x1c00>;
      controlled-ports = <0x3fff>;
      #phy-cells = <2>;
    };
  - |
    serdes: serdes@1b0003b0 {
      compatible = "realtek,rtl9300-serdes", "realtek,otto-serdes";
      reg = <0x1b0003b0 0x8>;
      controlled-ports = <0x0fff>;
      #phy-cells = <2>;
    };
  - |
    serdes: serdes@1b005638 {
      compatible = "realtek,rtl9310-serdes", "realtek,otto-serdes";
      reg = <0x1b005638 0x8>;
      controlled-ports = <0x3fff>;
      #phy-cells = <2>;
    };
  - |
    #define _MASK_ 1
    #define _WAIT_ 2
    serdes: serdes@1b00a000 {
      compatible = "realtek,rtl8390-serdes", "realtek,otto-serdes";
      reg = <0x1b00a000 0x1c00>;
      controlled-ports = <0x3fff>;
      #phy-cells = <2>;
      cmd-setup = /bits/ 16 <
        /*
         * set clock edge bit 14 during driver setup for ports 10-11 on page 0,
         * register 7. Wait 128 ms. Afterwards set whole register 0 on page 10
         * of ports 8, 9, 12, 13 to 0x5800.
         */
        _MASK_ 0x0c00 0x00 0x07 0x4000 0x4000
        _WAIT_ 0x0c00 0x00 0x00 0x0080 0x0000
        _MASK_ 0x3300 0x0a 0x00 0x5800 0xffff
      >;
    };
```

## target/linux/realtek/files/arch/mips/realtek/Kconfig
```kconfig
if REALTEK

menu "Realtek RLX based machine selection"

config REALTEK_MACH_GENERIC
	bool "Generic Realtek RLX based board"

config REALTEK_MACH_AU_HOME_SPOT_CUBE
	bool "AU HOME SPOT CUBE board"
	help
	  Say 'Y' here if you want your kernel to support the
	  AU HOME SPOT CUBE board.

endmenu

endif
```

## target/linux/realtek/files/drivers/net/ethernet/re865x/Kconfig
```kconfig
config RE865X
	tristate "Realtek RTL865X-style built-in ethernet mac and switch support"
	depends on REALTEK
	help
	  This is a driver for the built-in ethernet mac and switch of
	  Realtek RTL819X SoCs. If you have one of those, say Y here.
```

## target/linux/rtd1xxx/files-5.15/drivers/clk/realtek/Kconfig
```kconfig
# SPDX-License-Identifier: GPL-2.0-only
menuconfig COMMON_CLK_REALTEK
	bool "Realtek Clock drivers"
	depends on ARCH_REALTEK || COMPILE_TEST
	default y

if COMMON_CLK_REALTEK

config RTK_CLK_COMMON
	tristate
	select RESET_CONTROLLER
	select MFD_SYSCON

config RTK_CLK_PLL_MMC
	bool

config COMMON_CLK_RTD1295
	tristate "RTD1295 Clock Controller"
	select RTK_CLK_COMMON
	default y
	help
	  Support for the clock controller on RTD1295

config COMMON_CLK_RTD1319
	tristate "RTD1319 Clock Controller"
	select RTK_CLK_COMMON
	select RTK_CLK_PLL_DIF
	select RTK_CLK_PLL_MMC
	default y
	help
	  Support for the clock controller on RTD1319

config COMMON_CLK_RTD1619B
	tristate "RTD1619B Clock Controller"
	select RTK_CLK_COMMON
	select RTK_CLK_PLL_MMC
	default y
	help
	  Support for the clock controller on RTD1619B
endif
```

## target/linux/rtd1xxx/files-5.15/drivers/pinctrl/realtek/Kconfig
```kconfig
config PINCTRL_RTD
	tristate "Realtek DHC pin controller driver"
	depends on ARCH_REALTEK
	default y
	select PINMUX
	select GENERIC_PINCONF
```

## target/linux/rtd1xxx/files-5.15/drivers/soc/realtek/Kconfig
```kconfig
menu "Realtek SoC drivers"

config REALTEK_SOC
	bool
	depends on ARCH_REALTEK
	default y
	help
	  Realtek SoC drivers.

	  If unsure, say N.

config REALTEK_RBUS_BARRIER
	bool "Realtek rbus barrier"
	default ARCH_REALTEK
	default n
	help
	  Enable helper functions for R-bus barrier. If unsure, say N.

source "drivers/soc/realtek/common/Kconfig"

endmenu
```

## target/linux/rtd1xxx/files-5.15/drivers/soc/realtek/common/Kconfig
```kconfig
config REALTEK_CHIP_INFO
	tristate "Realtek SoC information"
	default y
	select SOC_BUS
	help
	  The Realtek chips information.
```

## target/linux/s3c24xx/files-2.6.30/drivers/ar6000/Kconfig
```kconfig
config AR6000_WLAN
        tristate "AR6000 wireless networking over SDIO"
	depends on MMC
        select WIRELESS_EXT
        default m
        help
          good luck.

config AR6000_WLAN_DEBUG
	bool "Enable retrieval of firmware debugging information"
	depends on AR6000_WLAN
	default n
	help
	  The AR6k firmware maintains a log of debugging events that
	  gets flushed to the host on various occasions. Retrieval of
	  this data is very slow, taking several seconds.

	  If in doubt, say N.

config AR6000_WLAN_RESET
	bool "Soft-reset when shutting down"
	depends on AR6000_WLAN
	default n
	help
	  The AR6k module can be explicitly reset when shutting down
	  the device. This adds a delay of about two seconds to suspend,
	  module removal, and so on. Since the WLAN SDIO function is
	  generally disabled soon thereafter anyway, this reset seems
	  superfluous.

	  If in doubt, say N.
```

## target/linux/s3c24xx/files-2.6.30/drivers/mfd/glamo/Kconfig
```kconfig
config MFD_GLAMO
	bool "Smedia Glamo 336x/337x support"
	select MFD_CORE
	help
	  This enables the core driver for the Smedia Glamo 336x/337x
	  multi-function device.  It includes irq_chip demultiplex as
	  well as clock / power management and GPIO support.

config MFD_GLAMO_FB
	tristate "Smedia Glamo 336x/337x framebuffer support"
	depends on FB && MFD_GLAMO
	select FB_CFB_FILLRECT
	select FB_CFB_COPYAREA
	select FB_CFB_IMAGEBLIT
	help
	  Frame buffer driver for the LCD controller in the Smedia Glamo
	  336x/337x.

	  This driver is also available as a module ( = code which can be
	  inserted and removed from the running kernel whenever you want). The
	  module will be called glamofb. If you want to compile it as a module,
	  say M here and read <file:Documentation/modules.txt>.

	  If unsure, say N.

config MFD_GLAMO_FB_XGLAMO_WORKAROUND
	bool "Smedia Glamo 336x/337x Xglamo rotation workaround"
	depends on MFD_GLAMO_FB
	help
	  This is a workaround for a Xglamo bug. This should be fixed
	  in Xglamo and not in kernel space.

	  If unsure, say N.


config MFD_GLAMO_SPI_GPIO
	tristate "Glamo GPIO SPI bitbang support"
	depends on MFD_GLAMO
	select SPI_BITBANG

	help
          Enable a bitbanging SPI adapter driver for the Smedia Glamo.

config MFD_GLAMO_MCI
	tristate "Glamo S3C SD/MMC Card Interface support"
	depends on MFD_GLAMO && MMC
	help
	  This selects a driver for the MCI interface found in
	  the S-Media GLAMO chip, as used in Openmoko
	  neo1973 GTA-02.

	  If unsure, say N.
```

## target/linux/s3c24xx/files-2.6.31/drivers/mfd/glamo/Kconfig
```kconfig
config MFD_GLAMO
	bool "Smedia Glamo 336x/337x support"
	select MFD_CORE
	help
	  This enables the core driver for the Smedia Glamo 336x/337x
	  multi-function device.  It includes irq_chip demultiplex as
	  well as clock / power management and GPIO support.

config MFD_GLAMO_FB
	tristate "Smedia Glamo 336x/337x framebuffer support"
	depends on FB && MFD_GLAMO
	select FB_CFB_FILLRECT
	select FB_CFB_COPYAREA
	select FB_CFB_IMAGEBLIT
	help
	  Frame buffer driver for the LCD controller in the Smedia Glamo
	  336x/337x.

	  This driver is also available as a module ( = code which can be
	  inserted and removed from the running kernel whenever you want). The
	  module will be called glamofb. If you want to compile it as a module,
	  say M here and read <file:Documentation/modules.txt>.

	  If unsure, say N.

config MFD_GLAMO_GPIO
	tristate "Glamo GPIO support"
	depends on MFD_GLAMO

	help
		Enable a bitbanging SPI adapter driver for the Smedia Glamo.

config MFD_GLAMO_MCI
	tristate "Glamo S3C SD/MMC Card Interface support"
	depends on MFD_GLAMO && MMC && REGULATOR
	help
	  This selects a driver for the MCI interface found in
	  the S-Media GLAMO chip, as used in Openmoko
	  neo1973 GTA-02.

	  If unsure, say N.
```

## target/linux/siflower/files/drivers/net/ethernet/siflower/Kconfig
```kconfig
# SPDX-License-Identifier: GPL-2.0
#
# Siflower network device configuration
#

config NET_VENDOR_SIFLOWER
	bool "Siflower Ethernet"
	default y
	depends on SOC_SIFLOWER

if NET_VENDOR_SIFLOWER

config NET_SIFLOWER_ETH_DPNS
	tristate "Siflower DPNS driver"
	help
	  Support the Dataplane network subsystem of SiFlower SF21A6826P SoC.

config NET_SIFLOWER_ETH_XGMAC
	tristate "Siflower Ethernet MAC driver"
	depends on NET_SIFLOWER_ETH_DPNS
 	select MII
	select PAGE_POOL
	select PHYLINK
	select NET_SIFLOWER_ETH_DMA
	help
	  Support the Ethernet controller of SiFlower SF21A6826P SoC.

config NET_SIFLOWER_ETH_DMA
	tristate "Siflower Ethernet DMA driver"
	depends on NET_SIFLOWER_ETH_DPNS
	select PAGE_POOL
	help
	  Support the Ethernet controller of SiFlower SF21A6826P SoC.

if NET_SIFLOWER_ETH_DMA

config NET_SIFLOWER_ETH_USE_INTERNAL_SRAM
	bool "Use internal SRAM for DMA descriptors"
	select SRAM
	help
	  Use internal SRAM instead of system memory for DMA descriptors.

endif # NET_SIFLOWER_ETH_DMA

endif # NET_VENDOR_SIFLOWER
```

## target/linux/siflower/image/sign_image/sign.its
```
/dts-v1/;

/ {
	description = "Sample kernel config";
	#address-cells = <1>;

	images {
		kernel@1 {
			data = /incbin/("IMG_PATH");
			type = "kernel";
			arch = "mips";
			os = "linux";
			compression = "COMPRESS_TYPE";
			load = <0x80100000>;
			entry = <KERNEL_ENTRY>;
			signature@1 {
				algo = "sha1,rsa1024";
				key-name-hint = "dev";
				sign-images = "kernel";
			};
		};
	};

	configurations {
		default = "conf@1";
		conf@1 {
			kernel = "kernel@1";
		};
	};
};
```

## target/linux/socfpga/image/Config.in
```kconfig
config SOCFPGA_SD_BOOT_PARTSIZE
	int "Boot (SD Card) filesystem partition size (in MB)"
	depends on TARGET_socfpga
	default 20
```
