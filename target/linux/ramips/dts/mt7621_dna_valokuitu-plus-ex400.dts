// SPDX-License-Identifier: GPL-2.0-or-later OR MIT

#include "mt7621_genexis_pulse-ex400-common.dtsi"

/ {
	compatible = "dna,valokuitu-plus-ex400", "mediatek,mt7621-soc";
	model = "DNA Valokuitu Plus EX400";

	aliases {
		led-boot = &led_status_red;
		led-failsafe = &led_status_red;
		led-running = &led_status_green;
		led-upgrade = &led_update_green;
	};
};

&leds {
		led_update_green: led-2 {
			color = <LED_COLOR_ID_GREEN>;
			function = LED_FUNCTION_PROGRAMMING;
			gpios = <&gpio 12 GPIO_ACTIVE_LOW>;
		};
};
