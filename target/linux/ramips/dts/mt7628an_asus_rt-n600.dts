// SPDX-License-Identifier: GPL-2.0-or-later OR MIT

#include "mt7628an_asus_rt-ac1200.dtsi"
#include "mt7628an_asus_rt-ac1200.dts"
/ {
	compatible = "asus,rt-n600", "mediatek,mt7628an-soc";
	model = "Asus RT-N600";
};
