#include "mt7621_zbtlink_zbt-wg1327.dtsi"

/ {
	compatible = "zbtlink,zbt-wg1327-32m", "zbtlink,zbt-wg1327", "mediatek,mt7621-soc";
	model = "Zbtlink ZBT-WG1327 (32M)";
};

&firmware {
	reg = <0x50000 0x1fb0000>;
};
