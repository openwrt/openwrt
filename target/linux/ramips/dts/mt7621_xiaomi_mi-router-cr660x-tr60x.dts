// SPDX-License-Identifier: GPL-2.0-or-later OR MIT

#include "mt7621_xiaomi_mi-router-cr660x.dtsi"

/ {
	compatible = "xiaomi,mi-router-cr660x-tr60x", "mediatek,mt7621-soc";
	model = "Xiaomi Mi Router CR660x-TR60x";
};
