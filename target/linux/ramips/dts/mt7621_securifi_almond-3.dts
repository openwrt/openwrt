// SPDX-License-Identifier: GPL-2.0-or-later OR MIT
/*
 * Copyright (c) 2026
 * Author: Fil Dunsky <filipp.dunsky@gmail.com>
 */

#include "mt7621_securifi_almond.dtsi"

/ {
	compatible = "securifi,almond-3", "mediatek,mt7621-soc";
	model = "Securifi Almond 3";
};
