#include "mt7621_zbtlink_zbt-wg259.dtsi"

/ {
	compatible = "zbtlink,zbt-wg259-32m", "zbtlink,zbt-wg259", "mediatek,mt7621-soc";
	model = "Zbtlink ZBT-WG259 (32M)";
};

&firmware {
	reg = <0x50000 0x1fb0000>;
};
