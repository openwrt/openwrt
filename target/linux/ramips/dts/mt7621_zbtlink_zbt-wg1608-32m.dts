// SPDX-License-Identifier: GPL-2.0-or-later OR MIT

#include "mt7621_zbtlink_zbt-wg1608.dtsi"

/ {
	compatible = "zbtlink,zbt-wg1608-32m", "mediatek,mt7621-soc";
	model = "Zbtlink ZBT-WG1608 (32M)";
};

&flash0 {
	broken-flash-reset;
};

&firmware {
	reg = <0x50000 0x1fb0000>;
};
