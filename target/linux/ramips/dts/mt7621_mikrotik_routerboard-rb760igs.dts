// SPDX-License-Identifier: GPL-2.0-or-later OR MIT
/dts-v1/;

#include "mt7621_mikrotik.dtsi"

/ {
	compatible = "mikrotik,rb760igs", "mediatek,mt7621-soc";
	model = "MikroTik RouterBOARD 760iGS";
};
