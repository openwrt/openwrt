// SPDX-License-Identifier: GPL-2.0-or-later OR MIT

#include "mt7621_dlink_dir_nand_128m.dtsi"

/ {
	compatible = "dlink,dir-1960-a1", "mediatek,mt7621-soc";
	model = "D-Link DIR-1960 A1";
};

&leds {
	usb_white {
		function = LED_FUNCTION_USB;
		color = <LED_COLOR_ID_WHITE>;
		gpios = <&gpio 14 GPIO_ACTIVE_LOW>;
		trigger-sources = <&xhci_ehci_port1>;
		linux,default-trigger = "usbport";
	};
};
