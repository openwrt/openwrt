// SPDX-License-Identifier: GPL-2.0-or-later OR MIT

#include "mt7621_elecom_wrc-2533ghbk.dtsi"

/ {
	compatible = "elecom,wrc-2533ghbk2-t", "mediatek,mt7621-soc";
	model = "ELECOM WRC-2533GHBK2-T";
};

&partitions {
	partition@50000 {
		compatible = "denx,uimage";
		label = "firmware";
		reg = <0x50000 0xfb0000>;
	};
};
