/dts-v1/;

#include "WITI.dtsi"


/ {
	compatible = "mqmaker,witi", "mqmaker,witi (256)", "mediatek,mt7621-soc";
	model = "MQmaker WiTi";

	memory@0 {
		device_type = "memory";
		reg = <0x0 0x10000000>;
	};
};

