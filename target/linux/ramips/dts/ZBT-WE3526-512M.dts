/dts-v1/;

#include "ZBT-WE3526.dtsi"

/ {
	compatible = "zbtlink,zbt-we3526-512m", "zbtlink,zbt-we3526", "mediatek,mt7621-soc";
	model = "ZBT-WE3526 (512M)";

	memory@0 {
		device_type = "memory";
		reg = <0x0 0x1c000000>, <0x20000000 0x4000000>;
	};
};


