#include "mt7621_zbtlink_zbt-wg259.dtsi"

/ {
	compatible = "zbtlink,zbt-wg259-16m", "zbtlink,zbt-wg259", "mediatek,mt7621-soc";
	model = "Zbtlink ZBT-WG259 (16M)";
};

&firmware {
	reg = <0x50000 0xfb0000>;
};
