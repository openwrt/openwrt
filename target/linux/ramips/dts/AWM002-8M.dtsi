/include/ "AWM002.dtsi"

/ {
	compatible = "AWM002", "ralink,rt5350-soc";
	model = "AsiaRF AWM002";

	palmbus@10000000 {
		spi@b00 {
			m25p80@0 {
				compatible = "mx25l6405d";
				linux,modalias = "m25p80", "mx25l6405d";
			};
		};
	};
};
