// SPDX-License-Identifier: GPL-2.0-or-later OR MIT

#include "mt7621_zte_mf286c3.dtsi"

#include <dt-bindings/gpio/gpio.h>
#include <dt-bindings/input/input.h>
#include <dt-bindings/leds/common.h>

/ {
	compatible = "zte,mf286c3-a", "mediatek,mt7621-soc";
	model = "ZTE MF286C3 (bank A)";

	chosen {
		bootargs-override = "console=ttyS0,57600 rootfstype=squashfs ubi.mtd=10";
	};

};
