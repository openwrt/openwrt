/dts-v1/;

#include "mt7621_ubiquiti_edgerouterx.dtsi"

/ {
	model = "UBNT-ERX-SFP";
	compatible = "ubiquiti,edgerouterx-sfp", "mediatek,mt7621-soc";
};

&i2c {
	status = "okay";

	pca9555@25 {
		compatible = "nxp,pca9555";
		reg = <0x25>;
	};
};
