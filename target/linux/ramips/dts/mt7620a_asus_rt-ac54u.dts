// SPDX-License-Identifier: GPL-2.0-or-later OR MIT

#include "mt7620a_asus_rt-ac5x.dtsi"

/ {
	compatible = "asus,rt-ac54u", "ralink,mt7620a-soc";
	model = "Asus RT-AC54U";
};

&pcie0 {
	wifi@0,0 {
		reg = <0x0000 0 0 0 0>;
		nvmem-cells = <&eeprom_factory_8000>;
		nvmem-cell-names = "eeprom";
		ieee80211-freq-limit = <5000000 6000000>;

		led {
			led-sources = <2>;
		};
	};
};
