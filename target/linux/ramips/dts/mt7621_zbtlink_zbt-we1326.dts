// SPDX-License-Identifier: GPL-2.0-or-later OR MIT

#include "mt7621_zbtlink_zbt-wexx26.dtsi"

/ {
	compatible = "zbtlink,zbt-we1326", "mediatek,mt7621-soc";
	model = "Zbtlink ZBT-WE1326";

	aliases {
		label-mac-device = &wifi1;
	};
};
