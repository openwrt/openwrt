// SPDX-License-Identifier: GPL-2.0-or-later OR MIT

#include "mt7621_dlink_dir-8xx.dtsi"
#include "mt7621_dlink_flash-16m-r1.dtsi"

/ {
	compatible = "dlink,dir-878-r1", "mediatek,mt7621-soc";
	model = "D-Link DIR-878 R1";
};
