/dts-v1/;

#include "ZBT-WE1326.dtsi"

/ {
	compatible = "zbtlink,zbt-we1326-256m", "zbtlink,zbt-we1326", "mediatek,mt7621-soc";
	model = "ZBT-WE1326 (256M)";

	memory@0 {
		device_type = "memory";
		reg = <0x0 0x10000000>;
	};
};
