#include "mt7621_zbtlink_zbt-wg1327.dtsi"

/ {
	compatible = "zbtlink,zbt-wg1327-16m", "zbtlink,zbt-wg1327", "mediatek,mt7621-soc";
	model = "Zbtlink ZBT-WG1327 (16M)";
};

&firmware {
	reg = <0x50000 0xfb0000>;
};
