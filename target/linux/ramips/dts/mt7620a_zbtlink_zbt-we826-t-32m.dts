#include "mt7620a_zbtlink_zbt-we826-t.dtsi"

/ {
	compatible = "zbtlink,zbt-we826-t-32m", "zbtlink,zbt-we826-t", "ralink,mt7620a-soc";
	model = "Zbtlink ZBT-WE826-T2 (32M)";
};

&flash0 {
	broken-flash-reset;
};

&firmware {
	reg = <0x50000 0x1fb0000>;
};

