// SPDX-License-Identifier: GPL-2.0-or-later OR MIT

#include "mt7621_xiaomi_mi-router-4a-3g-v2.dtsi"

/ {
	compatible = "xiaomi,mi-router-4a-gigabit", "mediatek,mt7621-soc";
	model = "Xiaomi Mi Router 4A Gigabit Edition";
};

&spi0 {
	status = "okay";

	flash@0 {
		compatible = "jedec,spi-nor";
		reg = <0>;
		spi-max-frequency = <80000000>;
		m25p,fast-read;
	};
};
