// SPDX-License-Identifier: GPL-2.0-or-later OR MIT

#include "mt7628an_teltonika_rut2xx.dtsi"

/ {
	//hardware version up to 4
	compatible = "teltonika,rut241", "mediatek,mt7628an-soc";
	model = "Teltonika RUT241";
};
