/*
 * Copyright 2015 Gateworks Corporation
 *
 * The code contained herein is licensed under the GNU General Public
 * License. You may obtain a copy of the GNU General Public License
 * Version 2 or later at the following locations:
 *
 * http://www.opensource.org/licenses/gpl-license.html
 * http://www.gnu.org/copyleft/gpl.html
 */

/dts-v1/;
#include "imx6q.dtsi"
#include "imx6qdl-gw553x.dtsi"

/ {
	model = "Gateworks Ventana i.MX6 Dual/Quad GW553X";
	compatible = "gw,imx6q-gw553x", "gw,ventana", "fsl,imx6q";
};
