/*
 * Copyright 2015 DH electronics GmbH
 *
 * This program is free software; you can redistribute it and/or modify
 * it under the terms of the GNU General Public License version 2 as
 * published by the Free Software Foundation.
 */

/dts-v1/;

//******************************************************************************
// C P U - T Y P E
//******************************************************************************
#include "imx6q.dtsi"
#define IMX6_CPU_DUAL_QUAD // Used to distinguish the CPU types


//******************************************************************************
// D H C O M - M O D U L E
//******************************************************************************

// Basic configuration
//**********************************************************
// HW300 base
#include "imx6qdl-dhcom3B.dtsi"

// Special configurations
//**********************************************************
// Enables NAND, disables eMMC
//#include "imx6qdl-dhcom_cfg-nand.dtsi"

// Enable RS485 for UART2 (ttymxc4)
//#include "imx6qdl-dhcom_cfg-rs485.dtsi"

// Enables WEIM example config with UIO-Driver
//#include "imx6qdl-dhcom_cfg-weim.dtsi"


//******************************************************************************
// B O A R D - C O N F I G U R A T I O N
//******************************************************************************
#include "imx6qdl-dh_pdk2.dtsi"


/ {
	model = "Freescale i.MX6 Quad DHCOM Premium Developer Kit (2)";
	compatible = "fsl,imx6q-dhcom3B-pdk2", "fsl,imx6q";
};
