/*
 * Copyright 2016 DH electronics GmbH
 *
 * The code contained herein is licensed under the GNU General Public
 * License. You may obtain a copy of the GNU General Public License
 * Version 2 or later at the following locations:
 *
 * http://www.opensource.org/licenses/gpl-license.html
 * http://www.gnu.org/copyleft/gpl.html
 */
#include "imx6qdl-dhcom3B.dtsi"							// Include interfaces from basic device tree
#define DHCOM_HISPEED								// Use it in other device tree files, e.g. imx6qdl-dh_xxx.dtsi

// Interfaces of the DHCOM hispeed connector will be configured here with the
// status "disabled". If you need the interface set it to status "okay" in the
// corresponding board file.
&pcie {
	status = "disabled";
};

// Only for DUAL and QUAD architecture
#ifdef IMX6_CPU_DUAL_QUAD
&sata {
	status = "disabled";
};
#endif
