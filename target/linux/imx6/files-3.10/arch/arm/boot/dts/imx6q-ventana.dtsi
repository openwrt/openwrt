/*
 * Copyright 2013 Gateworks Corporation
 *
 * The code contained herein is licensed under the GNU General Public
 * License. You may obtain a copy of the GNU General Public License
 * Version 2 or later at the following locations:
 *
 * http://www.opensource.org/licenses/gpl-license.html
 * http://www.gnu.org/copyleft/gpl.html
 */

#include "imx6q.dtsi"

/ {
	model = "Gateworks Ventana";
	system-serial = "";

	// these are used by bootloader for disabling nodes
	aliases {
		// ethernet0 = &eth0;
		// ethernet1 = &eth1;
		ssi0 = &ssi1;
		ssi1 = &ssi2;
		ipu0 = &ipu1;
		ipu1 = &ipu2;
		// mipi_csi = &mipi_csi;
		// mipi_dsi = &mipi_dsi;
		usdhc0 = &usdhc1;
		usdhc1 = &usdhc2;
		usdhc2 = &usdhc3;
		usdhc3 = &usdhc4;
		i2c0 = &i2c1;
		i2c1 = &i2c2;
		i2c2 = &i2c3;
		usb0 = &usbh3;
		usb1 = &usbotg;
		spi0 = &ecspi1;
		spi1 = &ecspi2;
		spi2 = &ecspi3;
		spi3 = &ecspi4;
		spi4 = &ecspi5;
		pwm0 = &pwm1;
		pwm1 = &pwm2;
		pwm2 = &pwm3;
		pwm3 = &pwm4;
		can0 = &can1;
		led0 = &led0;
		led1 = &led1;
		led2 = &led2;
	};
};
