## target/linux/lantiq/files/arch/mips/lantiq/svip/Kconfig
```kconfig
if SOC_SVIP

menu "Mips Machine"

config LANTIQ_MACH_EASY33016
	bool "Easy33016"
	default y

config LANTIQ_MACH_EASY336
	select SYS_SUPPORTS_LITTLE_ENDIAN
	bool "Easy336"
	default y

endmenu

endif
```

## target/linux/lantiq/files/drivers/usb/dwc_otg/Kconfig
```kconfig
config DWC_OTG
        tristate "Synopsis DWC_OTG support"
        depends on USB
        help
          This driver supports Synopsis DWC_OTG IP core
		  embebbed on many SOCs (ralink, infineon, etc)

choice
        prompt "USB Operation Mode"
        depends on DWC_OTG
        default DWC_OTG_HOST_ONLY

config DWC_OTG_HOST_ONLY
        bool "HOST ONLY MODE"
        depends on DWC_OTG

#config DWC_OTG_DEVICE_ONLY
#        bool "DEVICE ONLY MODE"
#        depends on DWC_OTG
endchoice

choice
        prompt "Platform"
        depends on DWC_OTG
        default DWC_OTG_LANTIQ

config DWC_OTG_LANTIQ
        bool "Lantiq"
        depends on LANTIQ
        help
          Danube USB Host Controller
		  platform support
endchoice

config DWC_OTG_DEBUG
        bool "Enable debug mode"
        depends on DWC_OTG
```

## target/linux/lantiq/image/Config.in
```kconfig
config TARGET_lantiq_xrx200_all
	bool
	default y if TARGET_lantiq_xrx200 || TARGET_lantiq_xrx200_tiny
```

## target/linux/layerscape/image/Config.in
```kconfig
config BOOT_FATFS_PARTSIZE
	int "Boot FATFS filesystem partition size (in MB)"
	depends on TARGET_layerscape
	default 20
```

## target/linux/mediatek/files-6.12/Documentation/devicetree/bindings/mfd/mediatek,mt7988-predictive-reboot.yaml
```yaml
# SPDX-License-Identifier: GPL-2.0-or-later OR BSD-2-Clause
%YAML 1.2
---
$id: http://devicetree.org/schemas/misc/mediatek,predictive-reboot.yaml#
$schema: http://devicetree.org/meta-schemas/core.yaml#

title: MediaTek Filogic Predictive Reboot Engine

description: |
  The Predictive Reboot Engine (PRE) is a proactive stability management
  subsystem for MediaTek Filogic SoCs. It aggregates a set of heuristic
  sensor scores — uptime anxiety, load-average vibes, thermal existentialism,
  astrological factors, weekday malaise, and Wi-Fi client pessimism — into a
  single confidence score. When that score exceeds a configurable threshold,
  the driver initiates a kernel_restart() before the system has a chance to
  realise anything is wrong.

  This is described in the literature[1] as "proactive reliability engineering"
  and not, as some maintainers have suggested, "rebooting for no reason".

  [1] Source: trust me bro.

properties:
  compatible:
    oneOf:
      - items:
          - enum:
              - mediatek,mt7986-predictive-reboot   # Filogic 830
              - mediatek,mt7988-predictive-reboot   # Filogic 880
          - const: mediatek,filogic-predictive-reboot
      - const: mediatek,filogic-predictive-reboot

  "mediatek,reboot-confidence":
    $ref: /schemas/types.yaml#/definitions/uint32
    minimum: 0
    maximum: 100
    default: 73
    description: |
      Minimum aggregated score [0..100] that triggers a predictive reboot.

      73 was chosen because:
        - 42 felt dangerously low (the router would reboot on Mondays alone)
        - 100 is technically unreachable and therefore useless
        - 73 is a prime number, which feels trustworthy

  "mediatek,poll-interval-s":
    $ref: /schemas/types.yaml#/definitions/uint32
    minimum: 1
    default: 42
    description: |
      Evaluation cadence in seconds. The delayed work item is rescheduled
      with this interval after each non-reboot evaluation pass.

      The default of 42 seconds was not chosen arbitrarily. It was chosen
      very deliberately for reasons that are none of your business.

  "mediatek,enable-astrology":
    type: boolean
    description: |
      When present, the Mercury retrograde ephemeris table is consulted
      during each evaluation cycle. Mercury retrograde contributes up to
      35 points to the confidence score, which is statistically significant
      and empirically justified by years of on-call experience.

      Absence of this property disables the astrological subsystem entirely.
      The driver refers to this as "boring mode" in the kernel log.

  status: true

required:
  - compatible

additionalProperties: false

examples:
  - |
    /* Minimal – all defaults, astrology disabled */
    predictive-reboot {
        compatible = "mediatek,mt7986-predictive-reboot",
                     "mediatek,filogic-predictive-reboot";
    };

  - |
    /* Paranoid production router with full configuration */
    predictive-reboot {
        compatible = "mediatek,mt7988-predictive-reboot",
                     "mediatek,filogic-predictive-reboot";
        mediatek,reboot-confidence = <60>;
        mediatek,poll-interval-s   = <30>;
        mediatek,enable-astrology;
    };
```

## target/linux/mediatek/files-6.6/drivers/net/dsa/airoha/an8855/Kconfig
```kconfig
config NET_DSA_AN8855
	tristate "Airoha AN8855 Ethernet switch support"
	depends on NET_DSA
	select NET_DSA_TAG_AIROHA
	help
	  AN8855 support 2.5G speed and managed by SMI interface.
	  This enables support for the Airoha AN8855 Ethernet switch
	  chip.
	  To compile this driver as a module, choose M here.
```

## target/linux/mediatek/files/drivers/net/dsa/mxl862xx/Kconfig
```kconfig
# SPDX-License-Identifier: GPL-2.0-only
config NET_DSA_MXL862
	tristate "MaxLinear MxL862xx"
	depends on NET_DSA
	select FW_LOADER
	help
	  This enables support for the MaxLinear MxL862xx switch family.
```

## target/linux/mediatek/image/Config.in
```kconfig
config MTK_BOOT_PARTSIZE
       int "Boot (SD Card/eMMC) filesystem partition size (in MiB)"
       depends on TARGET_mediatek_mt7623_DEVICE_bpi_bananapi-r2 || TARGET_DEVICE_mediatek_mt7623_DEVICE_bpi_bananapi-r2
       default 32
```

## target/linux/mxs/image/Config.in
```kconfig
config MXS_SD_BOOT_PARTSIZE
	int "Boot (SD Card) filesystem partition size (in MB)"
	depends on TARGET_mxs
	default 8
```

## target/linux/olpc/image/Config.in
```kconfig
config OLPC_BOOTSCRIPT_IMAGES
    bool "Build images with bootscript"
    depends TARGET_olpc
    depends TARGET_ROOTFS_EXT2FS || TARGET_ROOTFS_JFFS2 || TARGET_ROOTFS_SQUASHFS || TARGET_ROOTFS_ISO
    default y

config OLPC_BOOTSCRIPT_IMAGES_PAD
	bool "Pad bootscript images to filesystem size (for JFFS2)"
	depends OLPC_BOOTSCRIPT_IMAGES

config OLPC_BOOTSCRIPT_KERNELPART
    int "Kernel partition size (in MB)"
    depends OLPC_BOOTSCRIPT_IMAGES
    default 4

config OLPC_BOOTSCRIPT_ROOTPART
    string
    prompt "Root partition on target device" if OLPC_BOOTSCRIPT_IMAGES
    default "/dev/sda2"
    help
        The root partition on the final device.  If you don't know,
        you probably want the default (/dev/sda2).
```

## target/linux/package/Config.in
```kconfig
source "target/linux/package/alsa/Config.in"
source "target/linux/package/diag/Config.in"
source "target/linux/package/fuse/Config.in"
source "target/linux/package/hostap/Config.in"
source "target/linux/package/madwifi/Config.in"
source "target/linux/package/mini_fo/Config.in"
source "target/linux/package/openswan/Config.in"
source "target/linux/package/shfs/Config.in"
source "target/linux/package/spca5xx/Config.in"
source "target/linux/package/switch/Config.in"
source "target/linux/package/wlcompat/Config.in"
```

## target/linux/package/alsa/Config.in
```kconfig
config BR2_PACKAGE_KMOD_ALSA
	prompt "kmod-alsa......................... Alsa Sound Drivers"
	tristate
    depends BR2_LINUX_2_4_X86 || BR2_LINUX_2_4_BRCM || BR2_LINUX_2_6_X86 || BR2_LINUX_2_6_BRCM
	depends BR2_PACKAGE_KMOD_USB_CONTROLLER
	select BR2_PACKAGE_KMOD_SOUNDCORE
	default m if CONFIG_DEVEL
	help
	  Alsa Drivers for USB Soundcards
```

## target/linux/package/diag/Config.in
```kconfig
config PACKAGE_KMOD_DIAG
	prompt "kmod-diag......................... Driver for router LEDs and Buttons"
	tristate
	depends LINUX_2_4_BRCM
	default y
	help
	  Driver for router LEDs and Buttons
```

## target/linux/package/hostap/Config.in
```kconfig
config BR2_PACKAGE_KMOD_HOSTAP
	prompt "kmod-hostap....................... Host AP support for Prism2/2.5/3 IEEE 802.11b"
	tristate
	depends BR2_LINUX_2_4_X86 || BR2_LINUX_2_4_BRCM
	default m if CONFIG_DEVEL
	help
	  A driver for 802.11b wireless cards based on Intersil Prism2/2.5/3
	  chipset. This driver supports so called Host AP mode that allows
	  the card to act as an IEEE 802.11 access point.
	  
	  This option includes the base Host AP driver code that is shared by
	  different hardware models. You will also need to enable support for
	  PLX/PCI/CS version of the driver to actually use the driver.
	  
	  http://hostap.epitest.fi/

config BR2_PACKAGE_KMOD_HOSTAP_PCI
	prompt   "kmod-hostap-pci................. Host AP driver for Prism2.5 PCI adaptors"
	tristate
	default m if CONFIG_DEVEL
	depends BR2_PACKAGE_KMOD_HOSTAP
	help
	  Host AP support for Prism2/2.5/3 IEEE 802.11b" is required for this
	  driver and its help text includes more information about the Host AP
	  driver.
	  
	  http://hostap.epitest.fi/

config BR2_PACKAGE_KMOD_HOSTAP_PLX
	prompt   "kmod-hostap-plx................. Host AP driver for Prism2/2.5/3 in PLX9052 based PCI adaptors"
	tristate
	default m if CONFIG_DEVEL
	depends BR2_PACKAGE_KMOD_HOSTAP
	help
	  Host AP support for Prism2/2.5/3 IEEE 802.11b" is required for this
	  driver and its help text includes more information about the Host AP
	  driver.
	  
	  http://hostap.epitest.fi/
```

## target/linux/package/madwifi-old/Config.in
```kconfig
config PACKAGE_KMOD_MADWIFI_OLD
       prompt "kmod-madwifi-old.................. (old) Atheros Wifi driver"
       tristate
       default m if DEVEL
       default n
       help
         Madwifi-old driver for Atheros wireless adapters

         http://www.madwifi.org/
```

## target/linux/package/madwifi/Config.in
```kconfig
config PACKAGE_KMOD_MADWIFI
	prompt "kmod-madwifi...................... Atheros Wifi driver"
	tristate
	default y if LINUX_2_6_BRCM || LINUX_2_6_ARUBA || LINUX_2_4_AR531X
	default m if DEVEL
	default n
	help
	  Driver for Atheros 802.11a/b/g MiniPCI cards
	  
	  http://www.madwifi.org/
```

## target/linux/package/mini_fo/Config.in
```kconfig
config BR2_PACKAGE_KMOD_MINI_FO
	tristate "kmod-mini_fo................... mini fanout overlay file system"
	default m if CONFIG_DEVEL
	help
	  The mini fanout overlay file system.
	  
	  This package contains the mini_fo.o kernel module.
```

## target/linux/package/openswan/Config.in
```kconfig
config BR2_PACKAGE_KMOD_OPENSWAN
	prompt "kmod-openswan..................... Openswan kernel module"
	prompt "kmod-openswan..................... Openswan kernel module (FIXME, does not build on 2.6/mipsel)" if BR2_LINUX_2_6_BRCM
	tristate
	default m if CONFIG_DEVEL
	help
	  Openswan is an implementation of IPsec for Linux.
	  
	  http://www.openswan.org/
	  
	  This package contains the Openswan IPSec module for the kernel
```

## target/linux/package/switch/Config.in
```kconfig
config PACKAGE_KMOD_SWITCH
	prompt "kmod-switch....................... Kernel driver for ROBO and ADMTEK SWITCH"
	tristate
	default y if LINUX_2_6_BRCM || LINUX_2_4_BRCM
	default m if DEVEL
	default n
	help
	  Kernel driver for ROBO and ADMTEK switches.
	  
	  http://www.openwrt.org
	  
```

## target/linux/package/wlcompat/Config.in
```kconfig
config BR2_PACKAGE_KMOD_WLCOMPAT
	tristate "kmod-wlcompat"
	default y
	depends BR2_PACKAGE_KMOD_BRCM_WL
	help
	  A wrapper module, that provides Wireless Extension support for the
	  proprietary Broadcom wl module.

config BR2_PACKAGE_KMOD_WLCOMPAT_DEBUG
	tristate "kmod-wlcompat-debug"
	default m
	depends BR2_PACKAGE_KMOD_BRCM_WL
	help
	  A wrapper module, that provides Wireless Extension support for the
	  proprietary Broadcom wl module. (debug version)
```

## target/linux/qualcommax/image/netgear-rbx-factory.its
```
/dts-v1/;
/ {
	description = "Flashing nand 800 20000";
	#address-cells = <1>;
	images {
		metadata@1 {
			description = "metadata.txt";
			data = /incbin/("metadata.txt");
			type = "firmware";
			arch = "arm";
			os = "linux";
			compression = "none";
			hash@1 { algo = "crc32"; };
		};
		script@1 {
			description = "flash.scr";
			data = /incbin/("flash.scr");
			type = "script";
			compression = "none";
			hash@1 { algo = "crc32"; };
		};
		__UBI_NODE__ {
			description = "openwrt-ubi-root";
			data = /incbin/("ubi.bin");
			type = "firmware";
			arch = "arm";
			os = "linux";
			compression = "none";
			hash@1 { algo = "crc32"; };
		};
	};
	configurations {
		default = "config@1";
		config@1 {
			description = "config";
			firmware = "__UBI_NODE__";
		};
	};
};
```

## target/linux/ramips/files-3.7/drivers/usb/dwc_otg/Kconfig
```kconfig
config DWC_OTG
	tristate "Ralink RT305X DWC_OTG support"
	depends on SOC_RT305X
	---help---
	  This driver supports Ralink DWC_OTG

choice
	prompt "USB Operation Mode"
	depends on DWC_OTG
	default DWC_OTG_HOST_ONLY

config DWC_OTG_HOST_ONLY
	bool "HOST ONLY MODE"
	depends on DWC_OTG

config DWC_OTG_DEVICE_ONLY
	bool "DEVICE ONLY MODE"
	depends on DWC_OTG

endchoice

config DWC_OTG_DEBUG
	bool "Enable debug mode"
	depends on DWC_OTG
```

## target/linux/ramips/files/arch/mips/ralink/Kconfig
```kconfig
if MIPS_RALINK

choice
	prompt "Ralink SoC selection"
	default SOC_RT288X
	help
	  Select Ralink MIPS SoC type.

	config RALINK_RT288X
		bool "RT288x"
		select SOC_RT288X

	config RALINK_RT305X
		bool "RT305x"
		select SOC_RT305X

endchoice

source "arch/mips/ralink/rt288x/Kconfig"
source "arch/mips/ralink/rt305x/Kconfig"

config SOC_RT288X
	bool
	select CEVT_R4K
	select CSRC_R4K
	select DMA_NONCOHERENT
	select IRQ_CPU
	select ARCH_REQUIRE_GPIOLIB
	select SYS_HAS_CPU_MIPS32_R1
	select SYS_HAS_CPU_MIPS32_R2
	select SYS_SUPPORTS_32BIT_KERNEL
	select SYS_SUPPORTS_LITTLE_ENDIAN
	select SYS_HAS_EARLY_PRINTK
	select HW_HAS_PCI
	select MIPS_MACHINE

config SOC_RT305X
	bool
	select CEVT_R4K
	select CSRC_R4K
	select DMA_NONCOHERENT
	select IRQ_CPU
	select ARCH_REQUIRE_GPIOLIB
	select SYS_HAS_CPU_MIPS32_R1
	select SYS_HAS_CPU_MIPS32_R2
	select SYS_SUPPORTS_32BIT_KERNEL
	select SYS_SUPPORTS_LITTLE_ENDIAN
	select SYS_HAS_EARLY_PRINTK
	select MIPS_MACHINE
	select USB_ARCH_HAS_HCD

config RALINK_DEV_GPIO_BUTTONS
	def_bool n

config RALINK_DEV_GPIO_LEDS
	def_bool n

endif
```

## target/linux/ramips/files/arch/mips/ralink/rt288x/Kconfig
```kconfig
if RALINK_RT288X

menu "Ralink RT288x machine selection"

config RT288X_MACH_F5D8235_V1
	bool "Belkin F5D8235 V1 board support"
	select RALINK_DEV_GPIO_LEDS

config RT288X_MACH_BR6524N
	bool "Edimax BR6524N support"
	select RALINK_DEV_GPIO_BUTTONS
	select RALINK_DEV_GPIO_LEDS

config RT288X_MACH_RT_N15
	bool "Asus RT-N15 board support"
	select RALINK_DEV_GPIO_BUTTONS
	select RALINK_DEV_GPIO_LEDS

config RT288X_MACH_V11ST_FE
	bool "Ralink V11ST-FE board support"
	select HW_HAS_PCI
	select RALINK_DEV_GPIO_BUTTONS
	select RALINK_DEV_GPIO_LEDS

config RT288X_MACH_WLI_TX4_AG300N
	bool "Buffalo WLI-TX4-AG300N board support"
	select RALINK_DEV_GPIO_BUTTONS
	select RALINK_DEV_GPIO_LEDS

config RT288X_MACH_WZR_AGL300NH
	bool "Buffalo WZR-AGL300NH board support"
	select RALINK_DEV_GPIO_LEDS

endmenu

endif
```
