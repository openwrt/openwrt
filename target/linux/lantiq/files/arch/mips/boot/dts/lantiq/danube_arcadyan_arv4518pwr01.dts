// SPDX-License-Identifier: GPL-2.0-or-later OR MIT
#include "danube_arcadyan_arv4518pwr01.dtsi"

/ {
	compatible = "arcadyan,arv4518pwr01", "lantiq,xway", "lantiq,danube";
	model = "SMC7908A-ISP";
};
