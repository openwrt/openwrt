// SPDX-License-Identifier: GPL-2.0
/dts-v1/;

#include "vr9_arcadyan_vgv952cjw33-e-ir.dtsi"

/ {
	compatible = "arcadyan,vgv952cjw33-e-ir-smp", "lantiq,xway", "lantiq,vr9";
	model = "Easybox 904xDSL";

	chosen {
		bootargs = "console=ttyLTQ0,115200";
		// Obsolete code when the rootfs partion not right identify:
		//bootargs = "console=ttyLTQ0,115200 ubi.mtd=12,2048 panic=1 DTS-TEST-SEQNO=77 root=/dev/ubiblock0_0 rootdelay=7";
		// When the device should boot from USB (/dev/sda1): First the USB (dw2, usb-starage) and the F2FS driver must be enable in kernel-config
		//bootargs = "console=ttyLTQ0,115200 root=/dev/sda1 rootdelay=7 rootfstype=f2fs";
	};
};
