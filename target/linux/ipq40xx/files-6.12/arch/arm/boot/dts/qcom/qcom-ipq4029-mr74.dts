// SPDX-License-Identifier: GPL-2.0-only
// Device Tree Source for Meraki MR74 (Ladybug)

#include "qcom-ipq4029-insect-common.dtsi"

/ {
	model = "Meraki MR74 Access Point";
	compatible = "meraki,mr74";
};

&tricolor {
	enable-gpios = <&tlmm 14 GPIO_ACTIVE_LOW>;
};

&wifi0 {
	qcom,ath10k-calibration-variant = "Meraki-MR33";
};

&wifi1 {
	qcom,ath10k-calibration-variant = "Meraki-MR33";
};
