// SPDX-License-Identifier: GPL-2.0-only
// Device Tree Source for Meraki MR74 (Ladybug)

#include "qcom-ipq4029-insect-common.dtsi"

/ {
	model = "Meraki MR74 Access Point";
	compatible = "meraki,mr74";
};

&tricolor {
	enable-gpio = <&tlmm 14 GPIO_ACTIVE_LOW>;
};
