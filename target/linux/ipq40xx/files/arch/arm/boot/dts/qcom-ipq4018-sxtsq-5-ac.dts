// SPDX-License-Identifier: GPL-2.0-or-later OR MIT

#include "qcom-ipq4018-mikrotik-5acd.dtsi"

/ {
	model = "MikroTik SXTsq 5 ac (RBSXTsqG-5acD)";
	compatible = "mikrotik,sxtsq-5-ac";
};

&wifi1 {
	status = "okay";

	qcom,ath10k-calibration-variant = "MikroTik-SXTsq-5-ac";
};

&gmac0 {
	qcom,phy_mdio_addr = <4>;
	qcom,poll_required = <1>;
	qcom,forced_speed = <1000>;
	qcom,forced_duplex = <1>;
	vlan_tag = <1 0x20>;
};
