// SPDX-License-Identifier: GPL-2.0-or-later OR MIT
/* Copyright (c) 2021, William Wortel <wwortel@dorpstraat.com> */

#include "qcom-ipq4018-mikrotik_7442a-lhg5acd.dtsi"

/ {
	model = "Mikrotik LDF 5 ac (RBLDFG-5acD)";
	compatible = "mikrotik,ldf-5-ac";
};
