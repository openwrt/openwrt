// SPDX-License-Identifier: GPL-2.0-or-later OR MIT

#include "qcom-ipq4019-orbi.dtsi"

&swport1 {
	status = "okay";

	label = "lan1";
};

&swport2 {
	status = "okay";

	label = "lan2";
};

&swport3 {
	status = "okay";

	label = "lan3";
};

&swport4 {
	status = "okay";

	label = "lan4";
};
