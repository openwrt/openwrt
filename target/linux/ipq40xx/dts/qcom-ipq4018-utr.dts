// SPDX-License-Identifier: GPL-2.0-only OR MIT

#include "qcom-ipq4018-utr.dtsi"

/ {
	model = "Ubiquiti UniFi Travel Router";
	compatible = "ubnt,utr", "qcom,ipq4019";
};

&wifi0 {
	qcom,ath10k-calibration-variant = "Ubiquiti-UniFi-Travel-Router";
};

&wifi1 {
	qcom,ath10k-calibration-variant = "Ubiquiti-UniFi-Travel-Router";
};
