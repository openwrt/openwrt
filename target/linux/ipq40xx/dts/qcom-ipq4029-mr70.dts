// SPDX-License-Identifier: GPL-2.0-only
// Device Tree Source for Meraki MR70 (Toe Biter) / Go GR60 (Dungbeetle)

#include "qcom-ipq4029-meraki-underdog.dtsi"

/ {
	model = "Meraki MR70";
	compatible = "meraki,mr70";
};

