// SPDX-License-Identifier: GPL-2.0-or-later OR MIT

/*
 * Device Tree Source for Zyxel WSQ60(Multy Plus)
 */

#include "qcom-ipq4019-wsq50.dtsi"

/ {
	model = "Zyxel WSQ60";
	compatible = "zyxel,wsq60", "qcom,ipq4019";
};
