// SPDX-License-Identifier: GPL-2.0-or-later OR MIT

/*
 * Device Tree Source for Zyxel WSQ50(Multy X)
 */

#include "qcom-ipq4019-wsq50.dtsi"

/ {
	model = "Zyxel WSQ50";
	compatible = "zyxel,wsq50", "qcom,ipq4019";
};
