// SPDX-License-Identifier: GPL-2.0-only
// Device Tree Source for Meraki MR20 (Grub) / Go GR10 (Maggot)

#include "qcom-ipq4029-meraki-underdog.dtsi"

/ {
	model = "Meraki MR20";
	compatible = "meraki,mr20";
};
