// SPDX-License-Identifier: GPL-2.0-only
// Device Tree Source for Meraki MR33 (Stinkbug)

#include "qcom-ipq4029-wired-qca-common.dtsi"

/ {
	model = "Meraki Z3C LTE Router";
	compatible = "meraki,z3c";
};
