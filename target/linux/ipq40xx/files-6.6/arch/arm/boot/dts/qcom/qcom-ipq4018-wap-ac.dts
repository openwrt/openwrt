// SPDX-License-Identifier: GPL-2.0-or-later OR MIT
/* Copyright (c) 2020, Robert Marko <robimarko@gmail.com> */

#include "qcom-ipq4018-wap-ac.dtsi"

/ {
	model = "MikroTik wAP ac";
	compatible = "mikrotik,wap-ac";
};
