// SPDX-License-Identifier: GPL-2.0-or-later OR MIT
/* Copyright (c) 2024 */

/dts-v1/;

#include "ipq8074-rbx850.dtsi"

/ {
	model = "Netgear RBR850";
	compatible = "netgear,rbr850", "netgear,rbx850", "qcom,ipq8074";
};
