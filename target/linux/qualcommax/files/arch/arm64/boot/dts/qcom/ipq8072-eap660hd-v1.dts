// SPDX-License-Identifier: GPL-2.0-or-later OR BSD-2-Clause

/dts-v1/;

#include "ipq8072-eap660hd.dtsi"

/ {
	model = "TP-Link EAP660 HD v1";
	compatible = "tplink,eap660hd-v1", "qcom,ipq8074";
};

&wifi {
	qcom,ath11k-calibration-variant = "TP-Link-EAP660-HD-v1";
};
