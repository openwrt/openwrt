// SPDX-License-Identifier: GPL-2.0-or-later OR MIT
/* Copyright (c) 2023, Mohammad Sayful Islam <Sayf.mohammad01@gmail.com> */

/dts-v1/;

#include "ipq8174-mx4200.dtsi"

/ {
	model = "Linksys MX4200v2";
	compatible = "linksys,mx4200v2", "qcom,ipq8074";
};

&wifi {
	status = "okay";

	qcom,ath11k-calibration-variant = "Linksys-MX4200v2";
};
