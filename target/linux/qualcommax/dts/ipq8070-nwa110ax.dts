// SPDX-License-Identifier: GPL-2.0-or-later OR MIT
/*
 * Copyright (c) 2026 Michael Lotz <mmlr@mlotz.ch>
 *
 * NWA110AX and WAX510D share the same hardware.
 */

/dts-v1/;

#include "ipq8070-nwa110ax-wax510d.dtsi"

/ {
	model = "Zyxel NWA110AX";
	compatible = "zyxel,nwa110ax", "qcom,ipq8074";
};

&wifi {
	qcom,calibration-variant = "Zyxel-NWA110AX";
};
