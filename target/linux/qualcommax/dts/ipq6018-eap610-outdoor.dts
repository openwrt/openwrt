// SPDX-License-Identifier: GPL-2.0-or-later OR MIT

/dts-v1/;

#include "ipq6018-tplink-eap6xx-outdoor.dtsi"

/ {
	model = "TP-Link EAP610-Outdoor";
	compatible = "tplink,eap610-outdoor", "qcom,ipq6018";
};

&wifi {
	ieee80211-freq-limit = <2402000 5835000>;
	qcom,ath11k-calibration-variant = "TP-Link-EAP610-Outdoor";
};
