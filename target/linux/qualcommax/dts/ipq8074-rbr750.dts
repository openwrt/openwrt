// SPDX-License-Identifier: GPL-2.0-or-later OR MIT
/*
 * Copyright (c) 2026 Michael Lotz <mmlr@mlotz.ch>
 */

/dts-v1/;

#include "ipq8074-rbx750.dtsi"

/ {
	model = "Netgear RBR750";
	compatible = "netgear,rbr750", "qcom,ipq8074";
};
