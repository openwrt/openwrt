// SPDX-License-Identifier: GPL-2.0-or-later OR MIT
/*
 * Copyright (c) 2026 Michael Lotz <mmlr@mlotz.ch>
 * Copyright (c) 2026 Andreas Erhard
 *
 * WAX510D and NWA110AX share the same hardware, so the NWA110AX
 * calibration variant is reused.
 */

/dts-v1/;

#include "ipq8070-nwa110ax-wax510d.dtsi"

/ {
	model = "Zyxel WAX510D";
	compatible = "zyxel,wax510d", "zyxel,nwa110ax", "qcom,ipq8074";
};

&wifi {
	qcom,calibration-variant = "Zyxel-NWA110AX";
};
