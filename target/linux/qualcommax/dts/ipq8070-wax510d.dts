// SPDX-License-Identifier: GPL-2.0-or-later OR MIT
/*
 * Copyright (c) 2025 Pascal Beleiu <pascal@beleiu.de>
 * Copyright (c) 2025 Eric Schäfer <eric@es86.de>
 * Copyright (c) 2026 Andreas Müllner
 *
 * WAX510D and NWA110AX share the same hardware, so the NWA110AX
 * calibration variant is reused.
 */

/dts-v1/;

#include "ipq8070-nwa110ax-wax510d.dtsi"

/ {
	model = "Zyxel WAX510D";
	compatible = "zyxel,wax510d", "zyxel,nwa110ax", "qcom,ipq8074";
};

&wifi {
	qcom,ath11k-calibration-variant = "Zyxel-NWA110AX";
};
