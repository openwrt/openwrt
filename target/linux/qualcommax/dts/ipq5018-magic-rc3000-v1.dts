// SPDX-License-Identifier: GPL-2.0-or-later OR MIT

#include "ipq5018-magic-mp02.dtsi"

/* Connected like the NX30 board; no 5 GHz FEMs, own BDFs. */

/ {
	model = "H3C Magic RC3000 v1";
	compatible = "h3c,magic-rc3000-v1", "qcom,ipq5018";
};

&wifi {
	qcom,calibration-variant = "H3C-Magic-RC3000-v1";
};

&wifi1 {
	qcom,calibration-variant = "H3C-Magic-RC3000-v1";
};
