// SPDX-License-Identifier: GPL-2.0-or-later OR MIT
/*
 * Copyright (c) 2025 Pascal Beleiu <pascal@beleiu.de>
 * Copyright (c) 2025 Eric Schäfer <eric@es86.de>
 *
 * Note: NWA210AX and WAX610D share the same hardware.
 * See Issue #25657 for potential "No TX" problems.
 */

/dts-v1/;

#include "ipq8071-nwa210ax-wax610d.dtsi"

/ {
	model = "Zyxel NWA210AX";
	compatible = "zyxel,nwa210ax", "qcom,ipq8074";
};

&wifi {
	qcom,calibration-variant = "Zyxel-NWA210AX";
};
