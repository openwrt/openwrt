// SPDX-License-Identifier: GPL-2.0-or-later OR MIT

/dts-v1/;

#include "ipq6018-tplink-eap6xx-outdoor.dtsi"

/ {
	model = "TP-Link EAP625-Outdoor HD v1";
	compatible = "tplink,eap625-outdoor-hd-v1", "qcom,ipq6018";
};

&wifi {
	qcom,ath11k-calibration-variant = "TP-Link-EAP625-Outdoor-HD-v1";
};
