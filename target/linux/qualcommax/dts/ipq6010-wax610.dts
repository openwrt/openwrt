// SPDX-License-Identifier: (GPL-2.0+)

/dts-v1/;

#include "ipq6010-wax610-base.dtsi"

/ {
	model = "Netgear WAX610";
	compatible = "netgear,wax610", "qcom,ipq6018";
};

&wifi {
	qcom,calibration-variant = "Netgear-WAX610";
};
