// SPDX-License-Identifier: GPL-2.0-or-later OR MIT
/*
 * Copyright (c) 2025 Pascal Beleiu <pascal@beleiu.de>
 * Copyright (c) 2025 Eric Schäfer <eric@es86.de>
 * Copyright (c) 2026 Andreas Müllner
 *
 * WAX610D and NWA210AX share the same hardware, so the NWA210AX
 * calibration variant is reused.
 */

/dts-v1/;

#include "ipq8071-nwa210ax-wax610d.dtsi"

/ {
	model = "Zyxel WAX610D";
	compatible = "zyxel,wax610d", "zyxel,nwa210ax", "qcom,ipq8074";
};

&wifi {
	qcom,ath11k-calibration-variant = "Zyxel-NWA210AX";
};
