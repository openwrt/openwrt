// SPDX-License-Identifier: GPL-2.0-or-later OR MIT
/*
 * Copyright (c) 2026 Michael Lotz <mmlr@mlotz.ch>
 */

/dts-v1/;

#include "ipq8074-rbx850.dtsi"

/ {
	model = "Netgear RBS850";
	compatible = "netgear,rbs850", "qcom,ipq8074";
};
