// SPDX-License-Identifier: GPL-2.0-or-later OR MIT
/* Copyright (c) 2021, Flole <flole@flole.de> */

/dts-v1/;

#include "ipq8074-sxk80.dtsi"

/ {
	model = "Netgear SXS80";
	compatible = "netgear,sxs80", "qcom,ipq8074";
};
