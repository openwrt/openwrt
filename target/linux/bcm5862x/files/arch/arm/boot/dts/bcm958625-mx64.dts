// SPDX-License-Identifier: GPL-2.0-or-later OR MIT
/*
 * Device Tree Bindings for Cisco Meraki MX64.
 *
 * Copyright (C) 2021 Matthew Hagan <mnhagan88@gmail.com>
 */

/dts-v1/;

#include "bcm958625-mx64x.dtsi"

/ {
	model = "Cisco Meraki MX64";
	compatible = "meraki,mx64", "brcm,bcm58625", "brcm,nsp";
};
