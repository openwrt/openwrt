// SPDX-License-Identifier: GPL-2.0
/dts-v1/;

#include "imx6q.dtsi"
#include "imx6qdl-swordtail.dtsi"

#include <dt-bindings/gpio/gpio.h>

/ {
	model = "Versalogic Swordtail";
	compatible = "versalogic,imx6q-swordtail", "fsl,imx6q";
};
