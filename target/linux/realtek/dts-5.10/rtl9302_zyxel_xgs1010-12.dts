// SPDX-License-Identifier: (GPL-2.0-or-later or MIT)
/dts-v1/;

#include "rtl9302_zyxel_xgs1210-12.dts"

/ {
	compatible = "zyxel,xgs1010-12", "realtek,rtl9302-soc";
	model = "Zyxel XGS1010-12 Switch";

	keys {
		/delete-node/ reset;
	};
};

&firmware_partition {
	openwrt,ih-magic = <0x93001010>;
};
