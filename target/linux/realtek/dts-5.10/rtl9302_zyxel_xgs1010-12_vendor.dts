// SPDX-License-Identifier: (GPL-2.0-or-later OR MIT)
/dts-v1/;

#include "rtl9302_zyxel_xgs1010-12.dts"
#include "zyxel_16m_vendor_unmanaged_partitionlayout.dtsi"

/ {
	model = "Zyxel XGS1010-12 Switch (vendor)";
};
