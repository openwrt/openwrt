// SPDX-License-Identifier: GPL-2.0-or-later OR MIT

#include "rtl839x.dtsi"

#include <dt-bindings/input/input.h>
#include <dt-bindings/gpio/gpio.h>

/* Combo ports not working if unused during u-boot */
/* #define DGS1210_52_TEST_SFP */

#ifdef DGS1210_52_TEST_SFP
#define COMBO_SFP_PHY(n, s) \
	phy##n: ethernet-phy@##n { \
		compatible = "ethernet-phy-ieee802.3-c22"; \
		sfp = <&sfp##s>; \
		reg = <##n>; \
	};

#define COMBO_PORT(n, s, m) \
	port@##n { \
		reg = <##n>; \
		label = SWITCH_PORT_LABEL(s) ; \
		phy-handle = <&phy##n>; \
		phy-mode = #m ; \
	};
#endif

/ {
	compatible = "d-link,dgs-1210-52", "realtek,rtl8393-soc";
	model = "D-Link DGS-1210-52";

	aliases {
		led-boot = &led_power;
		led-failsafe = &led_power;
		led-running = &led_power;
		led-upgrade = &led_power;
	};

	memory@0 {
		device_type = "memory";
		reg = <0x0 0x8000000>;
	};

	leds {
		compatible = "gpio-leds";

		led_power: power {
			label = "green:power";
			gpios = <&gpio0 0 GPIO_ACTIVE_LOW>;
		};
	};

	gpio1: rtl8231-gpio {
		compatible = "realtek,rtl8231-gpio";
		#gpio-cells = <2>;
		indirect-access-bus-id = <0>;
		gpio-controller;
	};

	gpio-restart {
		compatible = "gpio-restart";
		gpios = <&gpio1 34 GPIO_ACTIVE_LOW>;
		open-source;
	};

	keys {
		compatible = "gpio-keys-polled";
		poll-interval = <20>;

		reset {
			label = "reset";
			gpios = <&gpio1 33 GPIO_ACTIVE_LOW>;
			linux,code = <KEY_RESTART>;
		};
	};

#ifdef DGS1210_52_TEST_SFP
	/*
	 *
	 * GPIO when SFP is connected:
	 *
	 * rtl8231: base 451
	 * gpio459 : LAN49
	 * gpio454 : LAN50
	 * gpio475 : LAN51
	 * gpio464 : LAN52
	 *
	 * sda-gpios, scl-gpios, los-gpio and other settings are just guesses based on dsg-1210-16
	 * from https://github.com/openwrt/openwrt/commit/b05cc25704f554d73b8b6772e844c3afddc4821c
	 */

	/* Lan 49 */
	i2c0: i2c-gpio-0 {
		compatible = "i2c-gpio";
		sda-gpios = <&gpio1 6 (GPIO_ACTIVE_HIGH | GPIO_OPEN_DRAIN)>;
		scl-gpios = <&gpio1 7 (GPIO_ACTIVE_HIGH | GPIO_OPEN_DRAIN)>;
		i2c-gpio,delay-us = <2>;
		#address-cells = <1>;
		#size-cells = <0>;
	};

	sfp0: sfp-p49 {
		compatible = "sff,sfp";
		i2c-bus = <&i2c0>;
		los-gpio = <&gpio1 9 GPIO_ACTIVE_HIGH>;
		mod-def0-gpio = <&gpio1 8 GPIO_ACTIVE_LOW>;
		/* tx-disable-gpio handled by RTL8214FC based on media setting */
	};

	/* Lan 50 */
	i2c1: i2c-gpio-1 {
		compatible = "i2c-gpio";
		sda-gpios = <&gpio1 1 (GPIO_ACTIVE_HIGH | GPIO_OPEN_DRAIN)>;
		scl-gpios = <&gpio1 2 (GPIO_ACTIVE_HIGH | GPIO_OPEN_DRAIN)>;
		i2c-gpio,delay-us = <2>;
		#address-cells = <1>;
		#size-cells = <0>;
	};

	sfp1: sfp-p50 {
		compatible = "sff,sfp";
		i2c-bus = <&i2c1>;
		los-gpio = <&gpio1 4 GPIO_ACTIVE_HIGH>;
		mod-def0-gpio = <&gpio1 3 GPIO_ACTIVE_LOW>;
		/* tx-disable-gpio handled by RTL8214FC based on media setting */
	};

	/* Lan 51 */
	i2c2: i2c-gpio-2 {
		compatible = "i2c-gpio";
		sda-gpios = <&gpio1 22 (GPIO_ACTIVE_HIGH | GPIO_OPEN_DRAIN)>;
		scl-gpios = <&gpio1 23 (GPIO_ACTIVE_HIGH | GPIO_OPEN_DRAIN)>;
		i2c-gpio,delay-us = <2>;
		#address-cells = <1>;
		#size-cells = <0>;
	};

	sfp2: sfp-p51 {
		compatible = "sff,sfp";
		i2c-bus = <&i2c2>;
		los-gpio = <&gpio1 25 GPIO_ACTIVE_HIGH>;
		mod-def0-gpio = <&gpio1 24 GPIO_ACTIVE_LOW>;
		// tx-disable-gpio handled by RTL8214FC based on media setting
	};

	/* Lan 52 */
	i2c3: i2c-gpio-3 {
		compatible = "i2c-gpio";
		sda-gpios = <&gpio1 11 (GPIO_ACTIVE_HIGH | GPIO_OPEN_DRAIN)>;
		scl-gpios = <&gpio1 12 (GPIO_ACTIVE_HIGH | GPIO_OPEN_DRAIN)>;
		i2c-gpio,delay-us = <2>;
		#address-cells = <1>;
		#size-cells = <0>;
	};

	sfp3: sfp-p52 {
		compatible = "sff,sfp";
		i2c-bus = <&i2c3>;
		los-gpio = <&gpio1 14 GPIO_ACTIVE_HIGH>;
		mod-def0-gpio = <&gpio1 13 GPIO_ACTIVE_LOW>;
		/* tx-disable-gpio handled by RTL8214FC based on media setting */
	};
#endif
};

&spi0 {
	status = "okay";
	flash@0 {
		compatible = "jedec,spi-nor";
		reg = <0>;
		spi-max-frequency = <10000000>;

		partitions {
			compatible = "fixed-partitions";
			#address-cells = <1>;
			#size-cells = <1>;

			partition@0 {
				label = "u-boot";
				reg = <0x00000000 0x80000>;
				read-only;
			};
			partition@80000 {
				label = "u-boot-env";
				reg = <0x00080000 0x40000>;
			};
			partition@c0000 {
				label = "board-name";
				reg = <0x000c0000 0x40000>;
			};
			partition@280000 {
				label = "firmware";
				compatible = "denx,uimage";
				reg = <0x00100000 0xd80000>;
			};
			partition@be80000 {
				label = "kernel2";
				reg = <0x00e80000 0x180000>;
			};
			partition@1000000 {
				label = "sysinfo";
				reg = <0x01000000 0x40000>;
			};
			partition@1040000 {
				label = "rootfs2";
				reg = <0x01040000 0xc00000>;
			};
			partition@1c40000 {
				label = "jffs2";
				reg = <0x01c40000 0x3c0000>;
			};
		};
	};
};

&ethernet0 {
	mdio: mdio-bus {
		compatible = "realtek,rtl838x-mdio";
		regmap = <&ethernet0>;
		#address-cells = <1>;
		#size-cells = <0>;

		/* External phy RTL8218B #1 */
		EXTERNAL_PHY(0)
		EXTERNAL_PHY(1)
		EXTERNAL_PHY(2)
		EXTERNAL_PHY(3)
		EXTERNAL_PHY(4)
		EXTERNAL_PHY(5)
		EXTERNAL_PHY(6)
		EXTERNAL_PHY(7)

		/* External phy RTL8218B #2 */
		EXTERNAL_PHY(8)
		EXTERNAL_PHY(9)
		EXTERNAL_PHY(10)
		EXTERNAL_PHY(11)
		EXTERNAL_PHY(12)
		EXTERNAL_PHY(13)
		EXTERNAL_PHY(14)
		EXTERNAL_PHY(15)

		/* External phy RTL8218B #3 */
		EXTERNAL_PHY(16)
		EXTERNAL_PHY(17)
		EXTERNAL_PHY(18)
		EXTERNAL_PHY(19)
		EXTERNAL_PHY(20)
		EXTERNAL_PHY(21)
		EXTERNAL_PHY(22)
		EXTERNAL_PHY(23)

		/* External phy RTL8218B #4 */
		EXTERNAL_PHY(24)
		EXTERNAL_PHY(25)
		EXTERNAL_PHY(26)
		EXTERNAL_PHY(27)
		EXTERNAL_PHY(28)
		EXTERNAL_PHY(29)
		EXTERNAL_PHY(30)
		EXTERNAL_PHY(31)

		/* External phy RTL8218B #5 */
		EXTERNAL_PHY(32)
		EXTERNAL_PHY(33)
		EXTERNAL_PHY(34)
		EXTERNAL_PHY(35)
		EXTERNAL_PHY(36)
		EXTERNAL_PHY(37)
		EXTERNAL_PHY(38)
		EXTERNAL_PHY(39)

		/* External phy RTL8218B #6 */
		EXTERNAL_PHY(40)
		EXTERNAL_PHY(41)
		EXTERNAL_PHY(42)
		EXTERNAL_PHY(43)
		EXTERNAL_PHY(44)
		EXTERNAL_PHY(45)
		EXTERNAL_PHY(46)
		EXTERNAL_PHY(47)

#ifdef DGS1210_52_TEST_SFP
		/* External phy RTL8214FC? or
		  2xRTL8393 SERDES + 2xRealtek RTL8218B (external)? */
		COMBO_SFP_PHY(48, 0)
		COMBO_SFP_PHY(49, 1)
		COMBO_SFP_PHY(50, 2)
		COMBO_SFP_PHY(51, 3)
#endif
	};
};

&switch0 {
	ports {
		#address-cells = <1>;
		#size-cells = <0>;

		SWITCH_PORT(0, 1, qsgmii)
		SWITCH_PORT(1, 2, qsgmii)
		SWITCH_PORT(2, 3, qsgmii)
		SWITCH_PORT(3, 4, qsgmii)
		SWITCH_PORT(4, 5, qsgmii)
		SWITCH_PORT(5, 6, qsgmii)
		SWITCH_PORT(6, 7, qsgmii)
		SWITCH_PORT(7, 8, qsgmii)

		SWITCH_PORT(8, 9, qsgmii)
		SWITCH_PORT(9, 10, qsgmii)
		SWITCH_PORT(10, 11, qsgmii)
		SWITCH_PORT(11, 12, qsgmii)
		SWITCH_PORT(12, 13, qsgmii)
		SWITCH_PORT(13, 14, qsgmii)
		SWITCH_PORT(14, 15, qsgmii)
		SWITCH_PORT(15, 16, qsgmii)

		SWITCH_PORT(16, 17, qsgmii)
		SWITCH_PORT(17, 18, qsgmii)
		SWITCH_PORT(18, 19, qsgmii)
		SWITCH_PORT(19, 20, qsgmii)
		SWITCH_PORT(20, 21, qsgmii)
		SWITCH_PORT(21, 22, qsgmii)
		SWITCH_PORT(22, 23, qsgmii)
		SWITCH_PORT(23, 24, qsgmii)

		SWITCH_PORT(24, 25, qsgmii)
		SWITCH_PORT(25, 26, qsgmii)
		SWITCH_PORT(26, 27, qsgmii)
		SWITCH_PORT(27, 28, qsgmii)
		SWITCH_PORT(28, 29, qsgmii)
		SWITCH_PORT(29, 30, qsgmii)
		SWITCH_PORT(30, 31, qsgmii)
		SWITCH_PORT(31, 32, qsgmii)

		SWITCH_PORT(32, 33, qsgmii)
		SWITCH_PORT(33, 34, qsgmii)
		SWITCH_PORT(34, 35, qsgmii)
		SWITCH_PORT(35, 36, qsgmii)
		SWITCH_PORT(36, 37, qsgmii)
		SWITCH_PORT(37, 38, qsgmii)
		SWITCH_PORT(38, 39, qsgmii)
		SWITCH_PORT(39, 40, qsgmii)

		SWITCH_PORT(40, 41, qsgmii)
		SWITCH_PORT(41, 42, qsgmii)
		SWITCH_PORT(42, 43, qsgmii)
		SWITCH_PORT(43, 44, qsgmii)
		SWITCH_PORT(44, 45, qsgmii)
		SWITCH_PORT(45, 46, qsgmii)
		SWITCH_PORT(46, 47, qsgmii)
		SWITCH_PORT(47, 48, qsgmii)

#ifdef DGS1210_52_TEST_SFP
		COMBO_PORT(48, 49, qsgmii)
		COMBO_PORT(49, 50, qsgmii)
		COMBO_PORT(50, 51, qsgmii)
		COMBO_PORT(51, 52, qsgmii)
#endif
		/* CPU-Port */
		port@52 {
			ethernet = <&ethernet0>;
			reg = <52>;
			phy-mode = "qsgmii";
			fixed-link {
				speed = <1000>;
				full-duplex;
			};
		};
	};
};
