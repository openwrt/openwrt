// SPDX-License-Identifier: (GPL-2.0-or-later OR MIT)
/dts-v1/;

#include "rtl9302_zyxel_xgs1250-12.dts"
#include "zyxel_16m_vendor_managed_partitionlayout.dtsi"

/ {
	model = "Zyxel XGS1250-12 Switch (vendor)";
};
