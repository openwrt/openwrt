// SPDX-License-Identifier: GPL-2.0-or-later

#include "rtl8380_zyxel_gs1900.dtsi"

/ {
	compatible = "zyxel,gs1900-10hp", "realtek,rtl838x-soc";
	model = "ZyXEL GS1900-10HP Switch";

	led_set: led_set@0 {
		compatible = "realtek,rtl8380-leds";
		led_mode = "serial";
		led_set0 = <0x0a 0x0b>;  // 10/100 (yellow) and 1000MBit (green)
		led_set1 = <0x0f 0x0a>;  // 10/100 (yellow) and 1000MBit (green)
	};

	/* i2c of the left SFP cage: port 9 */
	i2c0: i2c-gpio-0 {
		compatible = "i2c-gpio";
		sda-gpios = <&gpio1 24 (GPIO_ACTIVE_HIGH | GPIO_OPEN_DRAIN)>;
		scl-gpios = <&gpio1 25 (GPIO_ACTIVE_HIGH | GPIO_OPEN_DRAIN)>;
		i2c-gpio,delay-us = <2>;
		#address-cells = <1>;
		#size-cells = <0>;
	};

	sfp0: sfp-p9 {
		compatible = "sff,sfp";
		i2c-bus = <&i2c0>;
		los-gpio = <&gpio1 27 GPIO_ACTIVE_HIGH>;
		tx-fault-gpio = <&gpio1 22 GPIO_ACTIVE_HIGH>;
		mod-def0-gpio = <&gpio1 26 GPIO_ACTIVE_LOW>;
		tx-disable-gpio = <&gpio1 23 GPIO_ACTIVE_HIGH>;
	};

	/* i2c of the right SFP cage: port 10 */
	i2c1: i2c-gpio-1 {
		compatible = "i2c-gpio";
		sda-gpios = <&gpio1 30 (GPIO_ACTIVE_HIGH | GPIO_OPEN_DRAIN)>;
		scl-gpios = <&gpio1 31 (GPIO_ACTIVE_HIGH | GPIO_OPEN_DRAIN)>;
		i2c-gpio,delay-us = <2>;
		#address-cells = <1>;
		#size-cells = <0>;
	};

	sfp1: sfp-p10 {
		compatible = "sff,sfp";
		i2c-bus = <&i2c1>;
		los-gpio = <&gpio1 33 GPIO_ACTIVE_HIGH>;
		tx-fault-gpio = <&gpio1 28 GPIO_ACTIVE_HIGH>;
		mod-def0-gpio = <&gpio1 32 GPIO_ACTIVE_LOW>;
		tx-disable-gpio = <&gpio1 29 GPIO_ACTIVE_HIGH>;
	};
};

&uart1 {
	status = "okay";
};

&mdio {
	INTERNAL_PHY(24)
	INTERNAL_PHY(26)
};

&switch0 {
	ports {
		port@24 {
			reg = <24>;
			label = "lan9";
			phy-mode = "1000base-x";
			phy-handle = <&phy24>;
			managed = "in-band-status";
			sfp = <&sfp0>;
		};

		port@26 {
			reg = <26>;
			label = "lan10";
			phy-mode = "1000base-x";
			phy-handle = <&phy26>;
			managed = "in-band-status";
			sfp = <&sfp1>;
		};
	};
};
