// SPDX-License-Identifier: GPL-2.0-or-later OR MIT

#include "rtl8393_hpe_1920.dtsi"

/ {
	compatible = "hpe,1920-48g-poe", "realtek,rtl8393-soc";
	model = "HPE 1920-48G-PoE (JG928A)";
};

&uart1 {
	status = "okay";
};
