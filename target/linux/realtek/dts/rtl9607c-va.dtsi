// SPDX-License-Identifier: GPL-2.0-or-later OR MIT

#include "rtl960x.dtsi"

&pcie0_phy {
	compatible = "realtek,rtl9607c-revA-gen2x1-pcie-phy";
};

&pcie1_phy {
	compatible = "realtek,rtl9607c-revA-gen1x1-pcie-phy";
};
