// SPDX-License-Identifier: GPL-2.0-or-later

#include "rtl8380_netgear_gigabit.dtsi"

#include <dt-bindings/leds/common.h>

/ {
	compatible = "netgear,gs310tp-v1", "realtek,rtl838x-soc";
	model = "Netgear GS310TP v1";

	aliases {
		led-boot = &led_power_green;
		led-failsafe = &led_power_amber;
		led-running = &led_power_green;
		led-upgrade = &led_power_amber;
	};

	leds {
		compatible = "gpio-leds";

		led_power_amber: led-0 {
			color = <LED_COLOR_ID_AMBER>;
			function = LED_FUNCTION_POWER;
			gpios = <&gpio1 32 GPIO_ACTIVE_LOW>;
		};

		led_power_green: led-1 {
			color = <LED_COLOR_ID_GREEN>;
			function = LED_FUNCTION_POWER;
			gpios = <&gpio1 31 GPIO_ACTIVE_LOW>;
		};
	};

	/* The PoE MCU (Nuvoton M05xx in front of a BCM59121) answers only on this bus, not on UART */
	i2c_poe: i2c-poe {
		compatible = "i2c-gpio";
		sda-gpios = <&gpio0 5 (GPIO_ACTIVE_HIGH | GPIO_OPEN_DRAIN)>;
		scl-gpios = <&gpio0 4 (GPIO_ACTIVE_HIGH | GPIO_OPEN_DRAIN)>;
		i2c-gpio,delay-us = <5>;
		#address-cells = <1>;
		#size-cells = <0>;

		pse: ethernet-pse@20 {
			compatible = "netgear,gs310tp-v1-pse", "realtek,pse-mcu-gen1-smbus";
			reg = <0x20>;
			/* RTL8231 pin 10 gates all ports; the bootloader leaves it asserted, the driver releases it once the MCU has answered, as the vendor firmware does */
			disable-ports-gpios = <&gpio1 10 GPIO_ACTIVE_LOW>;

			pse-pis {
				#address-cells = <1>;
				#size-cells = <0>;

				PSE_PI(0)
				PSE_PI(1)
				PSE_PI(2)
				PSE_PI(3)
				PSE_PI(4)
				PSE_PI(5)
				PSE_PI(6)
				PSE_PI(7)
			};
		};
	};
};

/* Copper ports lan1..lan8 (phy8..phy15) -> MCU PoE ports 0..7 */
&phy8  { pses = <&pse_pi0>; };
&phy9  { pses = <&pse_pi1>; };
&phy10 { pses = <&pse_pi2>; };
&phy11 { pses = <&pse_pi3>; };
&phy12 { pses = <&pse_pi4>; };
&phy13 { pses = <&pse_pi5>; };
&phy14 { pses = <&pse_pi6>; };
&phy15 { pses = <&pse_pi7>; };

&firmware {
	openwrt,ih-magic = <0x4e474335>;
};

&switch0 {
	ethernet-ports {
		/* TODO: fixed link SFP is not right */

		port24: port@24 {
			reg = <24>;
			label = SWITCH_PORT_LABEL(9);
			pcs-handle = <&serdes4 0>;
			phy-mode = "1000base-x";
			fixed-link {
				speed = <1000>;
				full-duplex;
			};
		};
		port26: port@26 {
			reg = <26>;
			label = SWITCH_PORT_LABEL(10);
			pcs-handle = <&serdes5 0>;
			phy-mode = "1000base-x";
			fixed-link {
				speed = <1000>;
				full-duplex;
			};
		};
	};
};
