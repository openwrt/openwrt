/dts-v1/;

#include "rtl839x_zyxel_gs1920-24-common.dtsi"

&i2c4 {
	pse: ethernet-pse@20 {
		reg = <0x20>;

		pse-pis {
			#address-cells = <1>;
			#size-cells = <0>;

			PSE_PI(0)
			PSE_PI(1)
			PSE_PI(2)
			PSE_PI(3)
			PSE_PI(4)
			PSE_PI(5)
			PSE_PI(6)
			PSE_PI(7)
			PSE_PI(8)
			PSE_PI(9)
			PSE_PI(10)
			PSE_PI(11)
			PSE_PI(12)
			PSE_PI(13)
			PSE_PI(14)
			PSE_PI(15)
			PSE_PI(16)
			PSE_PI(17)
			PSE_PI(18)
			PSE_PI(19)
			PSE_PI(20)
			PSE_PI(21)
			PSE_PI(22)
			PSE_PI(23)
		};
	};
};

&phy0 { pses = <&pse_pi0>; };
&phy1 { pses = <&pse_pi1>; };
&phy2 { pses = <&pse_pi2>; };
&phy3 { pses = <&pse_pi3>; };
&phy4 { pses = <&pse_pi4>; };
&phy5 { pses = <&pse_pi5>; };
&phy6 { pses = <&pse_pi6>; };
&phy7 { pses = <&pse_pi7>; };
&phy8 { pses = <&pse_pi8>; };
&phy9 { pses = <&pse_pi9>; };
&phy10 { pses = <&pse_pi10>; };
&phy11 { pses = <&pse_pi11>; };
&phy12 { pses = <&pse_pi12>; };
&phy13 { pses = <&pse_pi13>; };
&phy14 { pses = <&pse_pi14>; };
&phy15 { pses = <&pse_pi15>; };
&phy16 { pses = <&pse_pi16>; };
&phy17 { pses = <&pse_pi17>; };
&phy18 { pses = <&pse_pi18>; };
&phy19 { pses = <&pse_pi19>; };
&phy20 { pses = <&pse_pi20>; };
&phy21 { pses = <&pse_pi21>; };
&phy22 { pses = <&pse_pi22>; };
&phy23 { pses = <&pse_pi23>; };
