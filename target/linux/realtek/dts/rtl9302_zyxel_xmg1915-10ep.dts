// SPDX-License-Identifier: GPL-2.0-or-later
/dts-v1/;

#include "rtl9302_zyxel_xmg1915.dtsi"

#include <dt-bindings/input/input.h>
#include <dt-bindings/gpio/gpio.h>
#include <dt-bindings/leds/common.h>

/ {
	compatible = "zyxel,xmg1915-10ep", "realtek,rtl9302c-soc";
	model = "Zyxel XMG1915-10EP Switch";

	keys {
		compatible = "gpio-keys";

		led-mode {
			label = "led-mode";
			gpios = <&gpio0 11 GPIO_ACTIVE_LOW>;
			linux,code = <BTN_1>;
		};
	};
};

&led_set {
	/*
	 * The PoE indicator, next to CLOUD:
	 *   slot 23 LED 1: PoE blue, never used by the stock firmware
	 *   slot 24 LED 0: PoE green
	 *   slot 24 LED 1: PoE red, lit together with green for amber
	 *
	 * The copper port LEDs (slots 0-3 and 8-11) have their blue, green and
	 * red elements at LED 0, 1 and 2. In its PoE display mode the stock
	 * firmware takes those over as well and shows the PD class: yellow for
	 * 802.3af, green for 802.3at, blue for 802.3bt.
	 */
	software-leds {
		led@17,1 {
			reg = <23 1>;
			color = <LED_COLOR_ID_BLUE>;
			function = "poe";
		};

		led@18,0 {
			reg = <24 0>;
			color = <LED_COLOR_ID_GREEN>;
			function = "poe";
		};

		led@18,1 {
			reg = <24 1>;
			color = <LED_COLOR_ID_RED>;
			function = "poe";
		};
	};
};

&uart1 {
	status = "okay";

	pse: ethernet-pse {
		compatible = "zyxel,xmg1915-10ep-pse", "realtek,pse-mcu-gen2";
		current-speed = <115200>;

		reset-gpios = <&gpio0 4 GPIO_ACTIVE_LOW>;

		pse-pis {
			#address-cells = <1>;
			#size-cells = <0>;

			PSE_PI(0)
			PSE_PI(1)
			PSE_PI(2)
			PSE_PI(3)
			PSE_PI(4)
			PSE_PI(5)
			PSE_PI(6)
			PSE_PI(7)
		};
	};
};

&phy0 { pses = <&pse_pi0>; };
&phy1 { pses = <&pse_pi1>; };
&phy2 { pses = <&pse_pi2>; };
&phy3 { pses = <&pse_pi3>; };
&phy8 { pses = <&pse_pi4>; };
&phy9 { pses = <&pse_pi5>; };
&phy10 { pses = <&pse_pi6>; };
&phy11 { pses = <&pse_pi7>; };
