// SPDX-License-Identifier: GPL-2.0-or-later OR MIT

#include "rtl8382_hpe_1920-24g.dtsi"

/ {
	compatible = "hpe,1920-24g-poe-180w", "realtek,rtl838x-soc";
	model = "HPE 1920-24G-PoE+ 180W (JG925A)";
};

&uart1 {
	status = "okay";
};
