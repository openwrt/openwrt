// SPDX-License-Identifier: GPL-2.0-or-later OR MIT

#include "rtl839x.dtsi"
#include "rtl83xx_d-link_dgs-1210_common.dtsi"
#include "rtl83xx_d-link_dgs-1210_gpio.dtsi"
#include "rtl83xx_d-link_dgs-1210_gpio_sfp.dtsi"
#include "rtl8382_d-link_dgs-1210-52_common.dtsi"
#include "rtl8382_d-link_dgs-1210-52p_common.dtsi"

/ {
	compatible = "d-link,dgs-1210-52mp-f", "realtek,rtl8393-soc", "realtek,rtl839x-soc";
	model = "D-Link DGS-1210-52MP F";

};
