// SPDX-License-Identifier: GPL-2.0-or-later

#include "bcm63167-sagem-fast-4353.dtsi"

/ {
	model = "Sagemcom F@ST 4353";
	compatible = "sagem,fast-4353-cfe-spi-nor", "sagem,fast-4353", "brcm,bcm63167", "brcm,bcm63268";
};
